/* Hot-text alignment pad for DELTARUNE, Old 3DS, generated by tools/analysis/mkpin.py from the base
   ELF deltarune-3ds.elf, the candidate and its profiles; do not edit by hand.

   Puts the platform functions back at their base addresses where forward-only zero fill can, and pins the engine,
   vendor and library code after them (one block in link order) at its base address, so the Old models' 16 KB
   4-way I-cache sees the base's set mapping. Functions keep the candidate's link order; the pads are zero fill
   between functions and never execute. A few unsampled functions move to .text.pinrest, after .heapfrag, where
   their growth would keep a sampled function off its base address. Read after late_reserve.ld, so .text.late.*
   stays in .late.text.

   This only holds until the next text change ahead of the hot set. The durable fix is profile-driven hot-text
   placement (docs/3ds-hardware.md, "Old-model I-cache layout luck").

   The ASSERTs at the end stop the link when a hot platform function, the engine block, .fini or .fatalflush would
   start past its pinned address (text ahead of it grew beyond the fill), and hotpin/check_hot.cmake checks every hot
   function's address after the link. When either fires, regenerate this file and its .hot list from the new tree
   (docs/3ds-hardware.md says how), or configure with -DCTRPORT_HOTPIN=OFF to build without the pad. */

/* Slot aliases (SLOT_ALIASES in tools/analysis/mkpin.py): each slot also takes the same-size body its
   function was renamed to, so the slot stays filled and .text.pinrest keeps its size.
     __wrap_linearAlloc -> CtrMemory_linearAllocOnce (titanthrash)
     __wrap_vramAlloc -> CtrMemory_vramAllocOnce (titanthrash)
     __wrap_vramAllocAt -> CtrMemory_vramAllocAtOnce (titanthrash) */

/* Library functions the candidate no longer calls, kept so the library tail keeps its base layout. */
EXTERN(hidTouchRead irrstCstickRead)
SECTIONS
{
  .text.pinned :
  {
    . += (ABSOLUTE(.) < ABSOLUTE(0x100000)) ? ABSOLUTE(0x100000) - ABSOLUTE(.) : 0;
    *(.text._start)
    . += (ABSOLUTE(.) < ABSOLUTE(0x100008)) ? ABSOLUTE(0x100008) - ABSOLUTE(.) : 0;
    *(.text.__service_ptr)
    . += (ABSOLUTE(.) < ABSOLUTE(0x10000c)) ? ABSOLUTE(0x10000c) - ABSOLUTE(.) : 0;
    *(.text.__apt_appid)
    . += (ABSOLUTE(.) < ABSOLUTE(0x100010)) ? ABSOLUTE(0x100010) - ABSOLUTE(.) : 0;
    *(.text.__heap_size)
    . += (ABSOLUTE(.) < ABSOLUTE(0x100014)) ? ABSOLUTE(0x100014) - ABSOLUTE(.) : 0;
    *(.text.__linear_heap_size)
    . += (ABSOLUTE(.) < ABSOLUTE(0x100018)) ? ABSOLUTE(0x100018) - ABSOLUTE(.) : 0;
    *(.text.__system_arglist)
    . += (ABSOLUTE(.) < ABSOLUTE(0x10001c)) ? ABSOLUTE(0x10001c) - ABSOLUTE(.) : 0;
    *(.text.__system_runflags)
    . += (ABSOLUTE(.) < ABSOLUTE(0x100020)) ? ABSOLUTE(0x100020) - ABSOLUTE(.) : 0;
    *(.text.startup)
    . += (ABSOLUTE(.) < ABSOLUTE(0x100058)) ? ABSOLUTE(0x100058) - ABSOLUTE(.) : 0;
    *(.text.ClearMem)
    . += (ABSOLUTE(.) < ABSOLUTE(0x10006c)) ? ABSOLUTE(0x10006c) - ABSOLUTE(.) : 0;
    *(.text.ClrLoop)
    . += (ABSOLUTE(.) < ABSOLUTE(0x100094)) ? ABSOLUTE(0x100094) - ABSOLUTE(.) : 0;
    *(.text._init)
    . += (ABSOLUTE(.) < ABSOLUTE(0x1000ac)) ? ABSOLUTE(0x1000ac) - ABSOLUTE(.) : 0;
    *(.text..udivsi3_skip_div0_test)
    . += (ABSOLUTE(.) < ABSOLUTE(0x100298)) ? ABSOLUTE(0x100298) - ABSOLUTE(.) : 0;
    *(.text.__aeabi_uidivmod)
    . += (ABSOLUTE(.) < ABSOLUTE(0x1002b8)) ? ABSOLUTE(0x1002b8) - ABSOLUTE(.) : 0;
    *(.text.__aeabi_idiv)
    . += (ABSOLUTE(.) < ABSOLUTE(0x1002c0)) ? ABSOLUTE(0x1002c0) - ABSOLUTE(.) : 0;
    *(.text..divsi3_skip_div0_test)
    . += (ABSOLUTE(.) < ABSOLUTE(0x1004d8)) ? ABSOLUTE(0x1004d8) - ABSOLUTE(.) : 0;
    *(.text.__aeabi_idivmod)
    . += (ABSOLUTE(.) < ABSOLUTE(0x1004fc)) ? ABSOLUTE(0x1004fc) - ABSOLUTE(.) : 0;
    *(.text.__aeabi_drsub)
    . += (ABSOLUTE(.) < ABSOLUTE(0x100504)) ? ABSOLUTE(0x100504) - ABSOLUTE(.) : 0;
    *(.text.__aeabi_dsub)
    . += (ABSOLUTE(.) < ABSOLUTE(0x100508)) ? ABSOLUTE(0x100508) - ABSOLUTE(.) : 0;
    *(.text.__adddf3)
    . += (ABSOLUTE(.) < ABSOLUTE(0x1007b4)) ? ABSOLUTE(0x1007b4) - ABSOLUTE(.) : 0;
    *(.text.__aeabi_ui2d)
    . += (ABSOLUTE(.) < ABSOLUTE(0x1007d8)) ? ABSOLUTE(0x1007d8) - ABSOLUTE(.) : 0;
    *(.text.__aeabi_i2d)
    . += (ABSOLUTE(.) < ABSOLUTE(0x100800)) ? ABSOLUTE(0x100800) - ABSOLUTE(.) : 0;
    *(.text.__aeabi_f2d)
    . += (ABSOLUTE(.) < ABSOLUTE(0x100848)) ? ABSOLUTE(0x100848) - ABSOLUTE(.) : 0;
    *(.text.__aeabi_ul2d)
    . += (ABSOLUTE(.) < ABSOLUTE(0x10085c)) ? ABSOLUTE(0x10085c) - ABSOLUTE(.) : 0;
    *(.text.__aeabi_l2d)
    . += (ABSOLUTE(.) < ABSOLUTE(0x1008bc)) ? ABSOLUTE(0x1008bc) - ABSOLUTE(.) : 0;
    *(.text.__aeabi_frsub)
    . += (ABSOLUTE(.) < ABSOLUTE(0x1008c4)) ? ABSOLUTE(0x1008c4) - ABSOLUTE(.) : 0;
    *(.text.__aeabi_fsub)
    . += (ABSOLUTE(.) < ABSOLUTE(0x1008c8)) ? ABSOLUTE(0x1008c8) - ABSOLUTE(.) : 0;
    *(.text.__addsf3)
    . += (ABSOLUTE(.) < ABSOLUTE(0x100a58)) ? ABSOLUTE(0x100a58) - ABSOLUTE(.) : 0;
    *(.text.__aeabi_ui2f)
    . += (ABSOLUTE(.) < ABSOLUTE(0x100a60)) ? ABSOLUTE(0x100a60) - ABSOLUTE(.) : 0;
    *(.text.__aeabi_i2f)
    . += (ABSOLUTE(.) < ABSOLUTE(0x100a80)) ? ABSOLUTE(0x100a80) - ABSOLUTE(.) : 0;
    *(.text.__aeabi_ul2f)
    . += (ABSOLUTE(.) < ABSOLUTE(0x100a90)) ? ABSOLUTE(0x100a90) - ABSOLUTE(.) : 0;
    *(.text.__aeabi_l2f)
    . += (ABSOLUTE(.) < ABSOLUTE(0x100b0c)) ? ABSOLUTE(0x100b0c) - ABSOLUTE(.) : 0;
    *(.text.__aeabi_ldivmod)
    . += (ABSOLUTE(.) < ABSOLUTE(0x100be0)) ? ABSOLUTE(0x100be0) - ABSOLUTE(.) : 0;
    *(.text.__aeabi_uldivmod)
    . += (ABSOLUTE(.) < ABSOLUTE(0x100c28)) ? ABSOLUTE(0x100c28) - ABSOLUTE(.) : 0;
    *(.text.strcmp)
    . += (ABSOLUTE(.) < ABSOLUTE(0x100fb0)) ? ABSOLUTE(0x100fb0) - ABSOLUTE(.) : 0;
    *(.text.__do_global_dtors_aux)
    . += (ABSOLUTE(.) < ABSOLUTE(0x101000)) ? ABSOLUTE(0x101000) - ABSOLUTE(.) : 0;
    *(.text.frame_dummy)
    . += (ABSOLUTE(.) < ABSOLUTE(0x101030)) ? ABSOLUTE(0x101030) - ABSOLUTE(.) : 0;
    *ctrport.dir/source/ctr_aot_module.o(.text.onEmulator)
    . += (ABSOLUTE(.) < ABSOLUTE(0x1010b4)) ? ABSOLUTE(0x1010b4) - ABSOLUTE(.) : 0;
    *ctrport.dir/source/ctr_aot_module.o(.text.protect.constprop.0)
    . += (ABSOLUTE(.) < ABSOLUTE(0x101120)) ? ABSOLUTE(0x101120) - ABSOLUTE(.) : 0;
    *ctrport.dir/source/ctr_aot_module.o(.text.CtrAotModule_load)
    . += (ABSOLUTE(.) < ABSOLUTE(0x101660)) ? ABSOLUTE(0x101660) - ABSOLUTE(.) : 0;
    *ctrport.dir/source/ctr_apt_trace.o(.text.heartbeatMain)
    . += (ABSOLUTE(.) < ABSOLUTE(0x101710)) ? ABSOLUTE(0x101710) - ABSOLUTE(.) : 0;
    *ctrport.dir/source/ctr_apt_trace.o(.text.onAptEvent)
    . += (ABSOLUTE(.) < ABSOLUTE(0x1017c8)) ? ABSOLUTE(0x1017c8) - ABSOLUTE(.) : 0;
    *ctrport.dir/source/ctr_apt_trace.o(.text.onDspEvent)
    . += (ABSOLUTE(.) < ABSOLUTE(0x101844)) ? ABSOLUTE(0x101844) - ABSOLUTE(.) : 0;
    *ctrport.dir/source/ctr_apt_trace.o(.text.__wrap_GSPGPU_SaveVramSysArea)
    . += (ABSOLUTE(.) < ABSOLUTE(0x1018c4)) ? ABSOLUTE(0x1018c4) - ABSOLUTE(.) : 0;
    *ctrport.dir/source/ctr_apt_trace.o(.text.__wrap_GSPGPU_ImportDisplayCaptureInfo)
    . += (ABSOLUTE(.) < ABSOLUTE(0x101928)) ? ABSOLUTE(0x101928) - ABSOLUTE(.) : 0;
    *ctrport.dir/source/ctr_apt_trace.o(.text.__wrap_GSPGPU_ReleaseRight)
    . += (ABSOLUTE(.) < ABSOLUTE(0x1019a8)) ? ABSOLUTE(0x1019a8) - ABSOLUTE(.) : 0;
    *ctrport.dir/source/ctr_apt_trace.o(.text.__wrap_GSPGPU_AcquireRight)
    . += (ABSOLUTE(.) < ABSOLUTE(0x101a38)) ? ABSOLUTE(0x101a38) - ABSOLUTE(.) : 0;
    *ctrport.dir/source/ctr_apt_trace.o(.text.__wrap_gxCmdQueueWait)
    . += (ABSOLUTE(.) < ABSOLUTE(0x101ab0)) ? ABSOLUTE(0x101ab0) - ABSOLUTE(.) : 0;
    *ctrport.dir/source/ctr_apt_trace.o(.text.CtrAptTrace_init)
    . += (ABSOLUTE(.) < ABSOLUTE(0x101b40)) ? ABSOLUTE(0x101b40) - ABSOLUTE(.) : 0;
    *ctrport.dir/source/ctr_apt_trace.o(.text.CtrAptTrace_stop)
    . += (ABSOLUTE(.) < ABSOLUTE(0x101b5c)) ? ABSOLUTE(0x101b5c) - ABSOLUTE(.) : 0;
    *ctrport.dir/source/ctr_audio_decoder.o(.text.tremorClose)
    . += (ABSOLUTE(.) < ABSOLUTE(0x101b64)) ? ABSOLUTE(0x101b64) - ABSOLUTE(.) : 0;
    *ctrport.dir/source/ctr_audio_decoder.o(.text.openSource)
    . += (ABSOLUTE(.) < ABSOLUTE(0x101ce4)) ? ABSOLUTE(0x101ce4) - ABSOLUTE(.) : 0;
    *ctrport.dir/source/ctr_audio_decoder.o(.text.srcRead)
    . += (ABSOLUTE(.) < ABSOLUTE(0x101dcc)) ? ABSOLUTE(0x101dcc) - ABSOLUTE(.) : 0;
    *ctrport.dir/source/ctr_audio_decoder.o(.text.srcSeek)
    . += (ABSOLUTE(.) < ABSOLUTE(0x101f00)) ? ABSOLUTE(0x101f00) - ABSOLUTE(.) : 0;
    *ctrport.dir/source/ctr_audio_decoder.o(.text.tremorSeek)
    . += (ABSOLUTE(.) < ABSOLUTE(0x101f18)) ? ABSOLUTE(0x101f18) - ABSOLUTE(.) : 0;
    *ctrport.dir/source/ctr_audio_decoder.o(.text.aacDecodeNext)
    . += (ABSOLUTE(.) < ABSOLUTE(0x102054)) ? ABSOLUTE(0x102054) - ABSOLUTE(.) : 0;
    *ctrport.dir/source/ctr_audio_decoder.o(.text.oggProbeTail.part.0)
    . += (ABSOLUTE(.) < ABSOLUTE(0x1020ec)) ? ABSOLUTE(0x1020ec) - ABSOLUTE(.) : 0;
    *ctrport.dir/source/ctr_audio_decoder.o(.text.tremorRead)
    . += (ABSOLUTE(.) < ABSOLUTE(0x10212c)) ? ABSOLUTE(0x10212c) - ABSOLUTE(.) : 0;
    *ctrport.dir/source/ctr_audio_decoder.o(.text.oggProbeHead.part.0.constprop.0)
    . += (ABSOLUTE(.) < ABSOLUTE(0x1021d8)) ? ABSOLUTE(0x1021d8) - ABSOLUTE(.) : 0;
    *ctrport.dir/source/ctr_audio_decoder.o(.text.tremorTell)
    . += (ABSOLUTE(.) < ABSOLUTE(0x102228)) ? ABSOLUTE(0x102228) - ABSOLUTE(.) : 0;
    *ctrport.dir/source/ctr_audio_decoder.o(.text.CtrDecoder_sectionPath)
    . += (ABSOLUTE(.) < ABSOLUTE(0x102294)) ? ABSOLUTE(0x102294) - ABSOLUTE(.) : 0;
    *ctrport.dir/source/ctr_audio_decoder.o(.text.CtrDecoder_vorbisBackendName)
    . += (ABSOLUTE(.) < ABSOLUTE(0x1022a0)) ? ABSOLUTE(0x1022a0) - ABSOLUTE(.) : 0;
    *ctrport.dir/source/ctr_audio_decoder.o(.text.CtrDecoder_sniff)
    . += (ABSOLUTE(.) < ABSOLUTE(0x102340)) ? ABSOLUTE(0x102340) - ABSOLUTE(.) : 0;
    *ctrport.dir/source/ctr_audio_decoder.o(.text.CtrDecoder_startReadAhead)
    . += (ABSOLUTE(.) < ABSOLUTE(0x1023c0)) ? ABSOLUTE(0x1023c0) - ABSOLUTE(.) : 0;
    *ctrport.dir/source/ctr_audio_decoder.o(.text.CtrDecoder_read)
    . += (ABSOLUTE(.) < ABSOLUTE(0x1025d4)) ? ABSOLUTE(0x1025d4) - ABSOLUTE(.) : 0;
    *ctrport.dir/source/ctr_audio_decoder.o(.text.CtrDecoder_seek)
    . += (ABSOLUTE(.) < ABSOLUTE(0x1027bc)) ? ABSOLUTE(0x1027bc) - ABSOLUTE(.) : 0;
    *ctrport.dir/source/ctr_audio_decoder.o(.text.CtrDecoder_close)
    . += (ABSOLUTE(.) < ABSOLUTE(0x102854)) ? ABSOLUTE(0x102854) - ABSOLUTE(.) : 0;
    *ctrport.dir/source/ctr_audio_decoder.o(.text.openCommon)
    . += (ABSOLUTE(.) < ABSOLUTE(0x102d6c)) ? ABSOLUTE(0x102d6c) - ABSOLUTE(.) : 0;
    *ctrport.dir/source/ctr_audio_decoder.o(.text.CtrDecoder_openFile)
    . += (ABSOLUTE(.) < ABSOLUTE(0x102df0)) ? ABSOLUTE(0x102df0) - ABSOLUTE(.) : 0;
    *ctrport.dir/source/ctr_audio_decoder.o(.text.CtrDecoder_openMemory)
    . += (ABSOLUTE(.) < ABSOLUTE(0x102e34)) ? ABSOLUTE(0x102e34) - ABSOLUTE(.) : 0;
    *ctrport.dir/source/ctr_audio_decoder.o(.text.CtrDecoder_probeFile)
    . += (ABSOLUTE(.) < ABSOLUTE(0x10319c)) ? ABSOLUTE(0x10319c) - ABSOLUTE(.) : 0;
    *ctrport.dir/source/ctr_audio_decoder.o(.text.CtrDecoder_probeMemory)
    . += (ABSOLUTE(.) < ABSOLUTE(0x103300)) ? ABSOLUTE(0x103300) - ABSOLUTE(.) : 0;
    *ctrport.dir/source/ctr_audio_system.o(.text.voiceLive)
    . += (ABSOLUTE(.) < ABSOLUTE(0x103418)) ? ABSOLUTE(0x103418) - ABSOLUTE(.) : 0;
    *ctrport.dir/source/ctr_audio_system.o(.text.ctrSetListenerPosition)
    . += (ABSOLUTE(.) < ABSOLUTE(0x103428)) ? ABSOLUTE(0x103428) - ABSOLUTE(.) : 0;
    *ctrport.dir/source/ctr_audio_system.o(.text.ctrSetChannelCount)
    . += (ABSOLUTE(.) < ABSOLUTE(0x103444)) ? ABSOLUTE(0x103444) - ABSOLUTE(.) : 0;
    *ctrport.dir/source/ctr_audio_system.o(.text.ctrGroupIsLoaded)
    . += (ABSOLUTE(.) < ABSOLUTE(0x103460)) ? ABSOLUTE(0x103460) - ABSOLUTE(.) : 0;
    *ctrport.dir/source/ctr_audio_system.o(.text.evictSfx)
    . += (ABSOLUTE(.) < ABSOLUTE(0x103574)) ? ABSOLUTE(0x103574) - ABSOLUTE(.) : 0;
    *ctrport.dir/source/ctr_audio_system.o(.text.voiceGain)
    . += (ABSOLUTE(.) < ABSOLUTE(0x1037d0)) ? ABSOLUTE(0x1037d0) - ABSOLUTE(.) : 0;
    *ctrport.dir/source/ctr_audio_system.o(.text.applyVoice)
    . += (ABSOLUTE(.) < ABSOLUTE(0x103e58)) ? ABSOLUTE(0x103e58) - ABSOLUTE(.) : 0;
    *ctrport.dir/source/ctr_audio_system.o(.text.ctrSuspend)
    . += (ABSOLUTE(.) < ABSOLUTE(0x103ea0)) ? ABSOLUTE(0x103ea0) - ABSOLUTE(.) : 0;
    *ctrport.dir/source/ctr_audio_system.o(.text.ndspFrameCallback)
    . += (ABSOLUTE(.) < ABSOLUTE(0x103eac)) ? ABSOLUTE(0x103eac) - ABSOLUTE(.) : 0;
    *ctrport.dir/source/ctr_audio_system.o(.text.postMessage)
    . += (ABSOLUTE(.) < ABSOLUTE(0x103f4c)) ? ABSOLUTE(0x103f4c) - ABSOLUTE(.) : 0;
    *ctrport.dir/source/ctr_audio_system.o(.text.logQuiet)
    . += (ABSOLUTE(.) < ABSOLUTE(0x103fa8)) ? ABSOLUTE(0x103fa8) - ABSOLUTE(.) : 0;
    *ctrport.dir/source/ctr_audio_system.o(.text.missingAudio)
    . += (ABSOLUTE(.) < ABSOLUTE(0x104028)) ? ABSOLUTE(0x104028) - ABSOLUTE(.) : 0;
    *ctrport.dir/source/ctr_audio_system.o(.text.ctrCreateStream)
    . += (ABSOLUTE(.) < ABSOLUTE(0x104100)) ? ABSOLUTE(0x104100) - ABSOLUTE(.) : 0;
    *ctrport.dir/source/ctr_audio_system.o(.text.drainMessages)
    . += (ABSOLUTE(.) < ABSOLUTE(0x104208)) ? ABSOLUTE(0x104208) - ABSOLUTE(.) : 0;
    *ctrport.dir/source/ctr_audio_system.o(.text.ctrSetMasterGainForListener)
    . += (ABSOLUTE(.) < ABSOLUTE(0x104244)) ? ABSOLUTE(0x104244) - ABSOLUTE(.) : 0;
    *ctrport.dir/source/ctr_audio_system.o(.text.streamEntryLength)
    . += (ABSOLUTE(.) < ABSOLUTE(0x1042f4)) ? ABSOLUTE(0x1042f4) - ABSOLUTE(.) : 0;
    *ctrport.dir/source/ctr_audio_system.o(.text.audoSectionPath)
    . += (ABSOLUTE(.) < ABSOLUTE(0x10438c)) ? ABSOLUTE(0x10438c) - ABSOLUTE(.) : 0;
    *ctrport.dir/source/ctr_audio_system.o(.text.loadAudoBlob)
    . += (ABSOLUTE(.) < ABSOLUTE(0x104594)) ? ABSOLUTE(0x104594) - ABSOLUTE(.) : 0;
    *ctrport.dir/source/ctr_audio_system.o(.text.queueSfxBuffers)
    . += (ABSOLUTE(.) < ABSOLUTE(0x1046c8)) ? ABSOLUTE(0x1046c8) - ABSOLUTE(.) : 0;
    *ctrport.dir/source/ctr_audio_system.o(.text.seekStream)
    . += (ABSOLUTE(.) < ABSOLUTE(0x1047e4)) ? ABSOLUTE(0x1047e4) - ABSOLUTE(.) : 0;
    *ctrport.dir/source/ctr_audio_system.o(.text.runPrepDecode)
    . += (ABSOLUTE(.) < ABSOLUTE(0x10492c)) ? ABSOLUTE(0x10492c) - ABSOLUTE(.) : 0;
    *ctrport.dir/source/ctr_audio_system.o(.text.loaderThreadMain)
    . += (ABSOLUTE(.) < ABSOLUTE(0x104e1c)) ? ABSOLUTE(0x104e1c) - ABSOLUTE(.) : 0;
    *ctrport.dir/source/ctr_audio_system.o(.text.audoEntryFor.constprop.0)
    . += (ABSOLUTE(.) < ABSOLUTE(0x104eb8)) ? ABSOLUTE(0x104eb8) - ABSOLUTE(.) : 0;
    *ctrport.dir/source/ctr_audio_system.o(.text.voiceName.isra.0)
    . += (ABSOLUTE(.) < ABSOLUTE(0x104f54)) ? ABSOLUTE(0x104f54) - ABSOLUTE(.) : 0;
    *ctrport.dir/source/ctr_audio_system.o(.text.resolveExternalPath.isra.0)
    . += (ABSOLUTE(.) < ABSOLUTE(0x104fd8)) ? ABSOLUTE(0x104fd8) - ABSOLUTE(.) : 0;
    *ctrport.dir/source/ctr_audio_system.o(.text.soundLength)
    . += (ABSOLUTE(.) < ABSOLUTE(0x1052b4)) ? ABSOLUTE(0x1052b4) - ABSOLUTE(.) : 0;
    *ctrport.dir/source/ctr_audio_system.o(.text.stopVoice)
    . += (ABSOLUTE(.) < ABSOLUTE(0x10549c)) ? ABSOLUTE(0x10549c) - ABSOLUTE(.) : 0;
    *ctrport.dir/source/ctr_audio_system.o(.text.ctrStopAll)
    . += (ABSOLUTE(.) < ABSOLUTE(0x105520)) ? ABSOLUTE(0x105520) - ABSOLUTE(.) : 0;
    *ctrport.dir/source/ctr_audio_system.o(.text.beginStreamVoice)
    . += (ABSOLUTE(.) < ABSOLUTE(0x105994)) ? ABSOLUTE(0x105994) - ABSOLUTE(.) : 0;
    *ctrport.dir/source/ctr_audio_system.o(.text.startVoiceSource)
    . += (ABSOLUTE(.) < ABSOLUTE(0x105a7c)) ? ABSOLUTE(0x105a7c) - ABSOLUTE(.) : 0;
    *ctrport.dir/source/ctr_audio_system.o(.text.shutdownAudio.part.0.constprop.0)
    . += (ABSOLUTE(.) < ABSOLUTE(0x105cf8)) ? ABSOLUTE(0x105cf8) - ABSOLUTE(.) : 0;
    *ctrport.dir/source/ctr_audio_system.o(.text.ctrDestroy)
    . += (ABSOLUTE(.) < ABSOLUTE(0x105e44)) ? ABSOLUTE(0x105e44) - ABSOLUTE(.) : 0;
    *ctrport.dir/source/ctr_audio_system.o(.text.shutdownAtExit)
    . += (ABSOLUTE(.) < ABSOLUTE(0x105e7c)) ? ABSOLUTE(0x105e7c) - ABSOLUTE(.) : 0;
    *ctrport.dir/source/ctr_audio_system.o(.text.ctrSetGroupGain)
    . += (ABSOLUTE(.) < ABSOLUTE(0x106028)) ? ABSOLUTE(0x106028) - ABSOLUTE(.) : 0;
    *ctrport.dir/source/ctr_audio_system.o(.text.ctrSetMasterGain)
    . += (ABSOLUTE(.) < ABSOLUTE(0x106060)) ? ABSOLUTE(0x106060) - ABSOLUTE(.) : 0;
    *ctrport.dir/source/ctr_audio_system.o(.text.ctrGetTrackPosition)
    . += (ABSOLUTE(.) < ABSOLUTE(0x106438)) ? ABSOLUTE(0x106438) - ABSOLUTE(.) : 0;
    *ctrport.dir/source/ctr_audio_system.o(.text.ctrResume)
    . += (ABSOLUTE(.) < ABSOLUTE(0x106480)) ? ABSOLUTE(0x106480) - ABSOLUTE(.) : 0;
    *ctrport.dir/source/ctr_audio_system.o(.text.ctrResumeAll)
    . += (ABSOLUTE(.) < ABSOLUTE(0x1064cc)) ? ABSOLUTE(0x1064cc) - ABSOLUTE(.) : 0;
    *ctrport.dir/source/ctr_audio_system.o(.text.ctrPauseAll)
    . += (ABSOLUTE(.) < ABSOLUTE(0x106518)) ? ABSOLUTE(0x106518) - ABSOLUTE(.) : 0;
    *ctrport.dir/source/ctr_audio_system.o(.text.ctrStopSound)
    . += (ABSOLUTE(.) < ABSOLUTE(0x1065d8)) ? ABSOLUTE(0x1065d8) - ABSOLUTE(.) : 0;
    *ctrport.dir/source/ctr_audio_system.o(.text.ctrSetSoundPitch)
    . += (ABSOLUTE(.) < ABSOLUTE(0x1066ac)) ? ABSOLUTE(0x1066ac) - ABSOLUTE(.) : 0;
    *ctrport.dir/source/ctr_audio_system.o(.text.streamWhileCaching)
    . += (ABSOLUTE(.) < ABSOLUTE(0x1068e4)) ? ABSOLUTE(0x1068e4) - ABSOLUTE(.) : 0;
    *ctrport.dir/source/ctr_audio_system.o(.text.ctrIsPlaying)
    . += (ABSOLUTE(.) < ABSOLUTE(0x106968)) ? ABSOLUTE(0x106968) - ABSOLUTE(.) : 0;
    *ctrport.dir/source/ctr_audio_system.o(.text.ctrDestroyStream)
    . += (ABSOLUTE(.) < ABSOLUTE(0x106a0c)) ? ABSOLUTE(0x106a0c) - ABSOLUTE(.) : 0;
    *ctrport.dir/source/ctr_audio_system.o(.text.ctrPauseSound)
    . += (ABSOLUTE(.) < ABSOLUTE(0x106a90)) ? ABSOLUTE(0x106a90) - ABSOLUTE(.) : 0;
    *ctrport.dir/source/ctr_audio_system.o(.text.ctrResumeSound)
    . += (ABSOLUTE(.) < ABSOLUTE(0x106b14)) ? ABSOLUTE(0x106b14) - ABSOLUTE(.) : 0;
    *ctrport.dir/source/ctr_audio_system.o(.text.ctrSetSoundEmitterGain)
    . += (ABSOLUTE(.) < ABSOLUTE(0x106b94)) ? ABSOLUTE(0x106b94) - ABSOLUTE(.) : 0;
    *ctrport.dir/source/ctr_audio_system.o(.text.ctrSetSoundGain)
    . += (ABSOLUTE(.) < ABSOLUTE(0x106cd8)) ? ABSOLUTE(0x106cd8) - ABSOLUTE(.) : 0;
    *ctrport.dir/source/ctr_audio_system.o(.text.ctrSetSoundSpatial)
    . += (ABSOLUTE(.) < ABSOLUTE(0x106da8)) ? ABSOLUTE(0x106da8) - ABSOLUTE(.) : 0;
    *ctrport.dir/source/ctr_audio_system.o(.text.ctrSetTrackPosition)
    . += (ABSOLUTE(.) < ABSOLUTE(0x106f38)) ? ABSOLUTE(0x106f38) - ABSOLUTE(.) : 0;
    *ctrport.dir/source/ctr_audio_system.o(.text.ctrGetSoundPitch)
    . += (ABSOLUTE(.) < ABSOLUTE(0x107004)) ? ABSOLUTE(0x107004) - ABSOLUTE(.) : 0;
    *ctrport.dir/source/ctr_audio_system.o(.text.ctrGetSoundGain)
    . += (ABSOLUTE(.) < ABSOLUTE(0x1070d8)) ? ABSOLUTE(0x1070d8) - ABSOLUTE(.) : 0;
    *ctrport.dir/source/ctr_audio_system.o(.text.ctrInit)
    . += (ABSOLUTE(.) < ABSOLUTE(0x10774c)) ? ABSOLUTE(0x10774c) - ABSOLUTE(.) : 0;
    *ctrport.dir/source/ctr_audio_system.o(.text.ctrGroupLoad)
    . += (ABSOLUTE(.) < ABSOLUTE(0x107af0)) ? ABSOLUTE(0x107af0) - ABSOLUTE(.) : 0;
    *ctrport.dir/source/ctr_audio_system.o(.text.ctrGetSoundLength)
    . += (ABSOLUTE(.) < ABSOLUTE(0x107c18)) ? ABSOLUTE(0x107c18) - ABSOLUTE(.) : 0;
    *ctrport.dir/source/ctr_audio_system.o(.text.openStream)
    . += (ABSOLUTE(.) < ABSOLUTE(0x108280)) ? ABSOLUTE(0x108280) - ABSOLUTE(.) : 0;
    *ctrport.dir/source/ctr_audio_system.o(.text.openerThreadMain)
    . += (ABSOLUTE(.) < ABSOLUTE(0x108328)) ? ABSOLUTE(0x108328) - ABSOLUTE(.) : 0;
    *ctrport.dir/source/ctr_audio_system.o(.text.decodeThreadMain)
    . += (ABSOLUTE(.) < ABSOLUTE(0x108fb0)) ? ABSOLUTE(0x108fb0) - ABSOLUTE(.) : 0;
    *ctrport.dir/source/ctr_audio_system.o(.text.prepareAudoSource)
    . += (ABSOLUTE(.) < ABSOLUTE(0x109608)) ? ABSOLUTE(0x109608) - ABSOLUTE(.) : 0;
    *ctrport.dir/source/ctr_audio_system.o(.text.resolveSoundSource)
    . += (ABSOLUTE(.) < ABSOLUTE(0x109afc)) ? ABSOLUTE(0x109afc) - ABSOLUTE(.) : 0;
    *ctrport.dir/source/ctr_audio_system.o(.text.ctrPlaySound)
    . += (ABSOLUTE(.) < ABSOLUTE(0x10a058)) ? ABSOLUTE(0x10a058) - ABSOLUTE(.) : 0;
    HIDDEN(__hotpin_0 = ABSOLUTE(.));
    *ctrport.dir/source/ctr_audio_system.o(.text.ctrUpdate)
    . += (ABSOLUTE(.) < ABSOLUTE(0x10aec4)) ? ABSOLUTE(0x10aec4) - ABSOLUTE(.) : 0;
    *ctrport.dir/source/ctr_audio_system.o(.text.CtrAudioSystem_underruns)
    . += (ABSOLUTE(.) < ABSOLUTE(0x10af00)) ? ABSOLUTE(0x10af00) - ABSOLUTE(.) : 0;
    *ctrport.dir/source/ctr_audio_system.o(.text.CtrAudioSystem_shedSfx)
    . += (ABSOLUTE(.) < ABSOLUTE(0x10b0dc)) ? ABSOLUTE(0x10b0dc) - ABSOLUTE(.) : 0;
    *ctrport.dir/source/ctr_audio_system.o(.text.CtrAudioSystem_create)
    . += (ABSOLUTE(.) < ABSOLUTE(0x10b220)) ? ABSOLUTE(0x10b220) - ABSOLUTE(.) : 0;
    *ctrport.dir/source/ctr_audio_system.o(.text.CtrAudioSystem_setDataWinPath)
    . += (ABSOLUTE(.) < ABSOLUTE(0x10b27c)) ? ABSOLUTE(0x10b27c) - ABSOLUTE(.) : 0;
    *ctrport.dir/source/ctr_benchmark.o(.text.compareSlowestFirst)
    . += (ABSOLUTE(.) < ABSOLUTE(0x10b2ac)) ? ABSOLUTE(0x10b2ac) - ABSOLUTE(.) : 0;
    *ctrport.dir/source/ctr_benchmark.o(.text.onAptEvent)
    . += (ABSOLUTE(.) < ABSOLUTE(0x10b2c4)) ? ABSOLUTE(0x10b2c4) - ABSOLUTE(.) : 0;
    *ctrport.dir/source/ctr_benchmark.o(.text.objectExists)
    . += (ABSOLUTE(.) < ABSOLUTE(0x10b3b4)) ? ABSOLUTE(0x10b3b4) - ABSOLUTE(.) : 0;
    *ctrport.dir/source/ctr_benchmark.o(.text.sweepDescribeAttack)
    . += (ABSOLUTE(.) < ABSOLUTE(0x10b4d8)) ? ABSOLUTE(0x10b4d8) - ABSOLUTE(.) : 0;
    *ctrport.dir/source/ctr_benchmark.o(.text.resetMeasuring)
    . += (ABSOLUTE(.) < ABSOLUTE(0x10b5fc)) ? ABSOLUTE(0x10b5fc) - ABSOLUTE(.) : 0;
    *ctrport.dir/source/ctr_benchmark.o(.text.tourWriteRow)
    . += (ABSOLUTE(.) < ABSOLUTE(0x10baa8)) ? ABSOLUTE(0x10baa8) - ABSOLUTE(.) : 0;
    *ctrport.dir/source/ctr_benchmark.o(.text.sweepSavePosition)
    . += (ABSOLUTE(.) < ABSOLUTE(0x10bb38)) ? ABSOLUTE(0x10bb38) - ABSOLUTE(.) : 0;
    *ctrport.dir/source/ctr_benchmark.o(.text.tourSavePosition)
    . += (ABSOLUTE(.) < ABSOLUTE(0x10bbdc)) ? ABSOLUTE(0x10bbdc) - ABSOLUTE(.) : 0;
    *ctrport.dir/source/ctr_benchmark.o(.text.sweepFreeRecipe)
    . += (ABSOLUTE(.) < ABSOLUTE(0x10bdf8)) ? ABSOLUTE(0x10bdf8) - ABSOLUTE(.) : 0;
    *ctrport.dir/source/ctr_benchmark.o(.text.drawResults)
    . += (ABSOLUTE(.) < ABSOLUTE(0x10c130)) ? ABSOLUTE(0x10c130) - ABSOLUTE(.) : 0;
    *ctrport.dir/source/ctr_benchmark.o(.text.emit)
    . += (ABSOLUTE(.) < ABSOLUTE(0x10c1ac)) ? ABSOLUTE(0x10c1ac) - ABSOLUTE(.) : 0;
    *ctrport.dir/source/ctr_benchmark.o(.text.saveResults)
    . += (ABSOLUTE(.) < ABSOLUTE(0x10c790)) ? ABSOLUTE(0x10c790) - ABSOLUTE(.) : 0;
    *ctrport.dir/source/ctr_benchmark.o(.text.sweepRestore)
    . += (ABSOLUTE(.) < ABSOLUTE(0x10c874)) ? ABSOLUTE(0x10c874) - ABSOLUTE(.) : 0;
    *ctrport.dir/source/ctr_benchmark.o(.text.sweepTopUpParty)
    . += (ABSOLUTE(.) < ABSOLUTE(0x10c8e4)) ? ABSOLUTE(0x10c8e4) - ABSOLUTE(.) : 0;
    *ctrport.dir/source/ctr_benchmark.o(.text.sweepDescribePins)
    . += (ABSOLUTE(.) < ABSOLUTE(0x10c9e0)) ? ABSOLUTE(0x10c9e0) - ABSOLUTE(.) : 0;
    *ctrport.dir/source/ctr_benchmark.o(.text.sweepAddParty.part.0)
    . += (ABSOLUTE(.) < ABSOLUTE(0x10cac0)) ? ABSOLUTE(0x10cac0) - ABSOLUTE(.) : 0;
    *ctrport.dir/source/ctr_benchmark.o(.text.drawStatus)
    . += (ABSOLUTE(.) < ABSOLUTE(0x10cee8)) ? ABSOLUTE(0x10cee8) - ABSOLUTE(.) : 0;
    *ctrport.dir/source/ctr_benchmark.o(.text.requestGameChange)
    . += (ABSOLUTE(.) < ABSOLUTE(0x10cf88)) ? ABSOLUTE(0x10cf88) - ABSOLUTE(.) : 0;
    *ctrport.dir/source/ctr_benchmark.o(.text.loadScenes)
    . += (ABSOLUTE(.) < ABSOLUTE(0x10d1c8)) ? ABSOLUTE(0x10d1c8) - ABSOLUTE(.) : 0;
    *ctrport.dir/source/ctr_benchmark.o(.text.computeResult)
    . += (ABSOLUTE(.) < ABSOLUTE(0x10d91c)) ? ABSOLUTE(0x10d91c) - ABSOLUTE(.) : 0;
    *ctrport.dir/source/ctr_benchmark.o(.text.beginTest)
    . += (ABSOLUTE(.) < ABSOLUTE(0x10dbbc)) ? ABSOLUTE(0x10dbbc) - ABSOLUTE(.) : 0;
    *ctrport.dir/source/ctr_benchmark.o(.text.drawPicker)
    . += (ABSOLUTE(.) < ABSOLUTE(0x10de5c)) ? ABSOLUTE(0x10de5c) - ABSOLUTE(.) : 0;
    *ctrport.dir/source/ctr_benchmark.o(.text.finish)
    . += (ABSOLUTE(.) < ABSOLUTE(0x10deec)) ? ABSOLUTE(0x10deec) - ABSOLUTE(.) : 0;
    *ctrport.dir/source/ctr_benchmark.o(.text.beginMeasuring)
    . += (ABSOLUTE(.) < ABSOLUTE(0x10dfa8)) ? ABSOLUTE(0x10dfa8) - ABSOLUTE(.) : 0;
    *ctrport.dir/source/ctr_benchmark.o(.text.sweepWriteRowFor)
    . += (ABSOLUTE(.) < ABSOLUTE(0x10e564)) ? ABSOLUTE(0x10e564) - ABSOLUTE(.) : 0;
    *ctrport.dir/source/ctr_benchmark.o(.text.sweepCut)
    . += (ABSOLUTE(.) < ABSOLUTE(0x10e9a8)) ? ABSOLUTE(0x10e9a8) - ABSOLUTE(.) : 0;
    *ctrport.dir/source/ctr_benchmark.o(.text.endScene)
    . += (ABSOLUTE(.) < ABSOLUTE(0x10efd4)) ? ABSOLUTE(0x10efd4) - ABSOLUTE(.) : 0;
    *ctrport.dir/source/ctr_benchmark.o(.text.startScript)
    . += (ABSOLUTE(.) < ABSOLUTE(0x10f060)) ? ABSOLUTE(0x10f060) - ABSOLUTE(.) : 0;
    *ctrport.dir/source/ctr_benchmark.o(.text.sweepFinishBattle)
    . += (ABSOLUTE(.) < ABSOLUTE(0x10f1ec)) ? ABSOLUTE(0x10f1ec) - ABSOLUTE(.) : 0;
    *ctrport.dir/source/ctr_benchmark.o(.text.CtrBench_sessionStarted)
    . += (ABSOLUTE(.) < ABSOLUTE(0x10f2e0)) ? ABSOLUTE(0x10f2e0) - ABSOLUTE(.) : 0;
    *ctrport.dir/source/ctr_benchmark.o(.text.CtrBench_openPicker)
    . += (ABSOLUTE(.) < ABSOLUTE(0x10f344)) ? ABSOLUTE(0x10f344) - ABSOLUTE(.) : 0;
    *ctrport.dir/source/ctr_benchmark.o(.text.CtrBench_autorunList)
    . += (ABSOLUTE(.) < ABSOLUTE(0x110120)) ? ABSOLUTE(0x110120) - ABSOLUTE(.) : 0;
    *ctrport.dir/source/ctr_benchmark.o(.text.CtrBench_autorun)
    . += (ABSOLUTE(.) < ABSOLUTE(0x110204)) ? ABSOLUTE(0x110204) - ABSOLUTE(.) : 0;
    *ctrport.dir/source/ctr_benchmark.o(.text.CtrBench_takeFinished)
    . += (ABSOLUTE(.) < ABSOLUTE(0x11021c)) ? ABSOLUTE(0x11021c) - ABSOLUTE(.) : 0;
    *ctrport.dir/source/ctr_benchmark.o(.text.CtrBench_returnedToGame)
    . += (ABSOLUTE(.) < ABSOLUTE(0x11022c)) ? ABSOLUTE(0x11022c) - ABSOLUTE(.) : 0;
    *ctrport.dir/source/ctr_benchmark.o(.text.CtrBench_pickerOpen)
    . += (ABSOLUTE(.) < ABSOLUTE(0x110248)) ? ABSOLUTE(0x110248) - ABSOLUTE(.) : 0;
    *ctrport.dir/source/ctr_benchmark.o(.text.CtrBench_running)
    . += (ABSOLUTE(.) < ABSOLUTE(0x110264)) ? ABSOLUTE(0x110264) - ABSOLUTE(.) : 0;
    *ctrport.dir/source/ctr_benchmark.o(.text.CtrBench_wantsBottomScreen)
    . += (ABSOLUTE(.) < ABSOLUTE(0x110288)) ? ABSOLUTE(0x110288) - ABSOLUTE(.) : 0;
    *ctrport.dir/source/ctr_benchmark.o(.text.CtrBench_beginFrame)
    . += (ABSOLUTE(.) < ABSOLUTE(0x113098)) ? ABSOLUTE(0x113098) - ABSOLUTE(.) : 0;
    *ctrport.dir/source/ctr_benchmark.o(.text.CtrBench_endFrame)
    . += (ABSOLUTE(.) < ABSOLUTE(0x113500)) ? ABSOLUTE(0x113500) - ABSOLUTE(.) : 0;
    *ctrport.dir/source/ctr_boot_trail.o(.text.CtrBootTrail_open)
    . += (ABSOLUTE(.) < ABSOLUTE(0x113798)) ? ABSOLUTE(0x113798) - ABSOLUTE(.) : 0;
    *ctrport.dir/source/ctr_boot_trail.o(.text.CtrBootTrail_mark)
    . += (ABSOLUTE(.) < ABSOLUTE(0x1139f8)) ? ABSOLUTE(0x1139f8) - ABSOLUTE(.) : 0;
    *ctrport.dir/source/ctr_boot_trail.o(.text.CtrBootTrail_last)
    . += (ABSOLUTE(.) < ABSOLUTE(0x113a08)) ? ABSOLUTE(0x113a08) - ABSOLUTE(.) : 0;
    *ctrport.dir/source/ctr_bz2.o(.text.decodeLong)
    . += (ABSOLUTE(.) < ABSOLUTE(0x113adc)) ? ABSOLUTE(0x113adc) - ABSOLUTE(.) : 0;
    *ctrport.dir/source/ctr_bz2.o(.text.CtrBz2_workBytes)
    . += (ABSOLUTE(.) < ABSOLUTE(0x113b3c)) ? ABSOLUTE(0x113b3c) - ABSOLUTE(.) : 0;
    *ctrport.dir/source/ctr_bz2.o(.text.CtrBz2_open)
    . += (ABSOLUTE(.) < ABSOLUTE(0x113bec)) ? ABSOLUTE(0x113bec) - ABSOLUTE(.) : 0;
    *ctrport.dir/source/ctr_bz2.o(.text.CtrBz2_read)
    . += (ABSOLUTE(.) < ABSOLUTE(0x11520c)) ? ABSOLUTE(0x11520c) - ABSOLUTE(.) : 0;
    *ctrport.dir/source/ctr_cache_publish.o(.text.deleteIfPresent)
    . += (ABSOLUTE(.) < ABSOLUTE(0x1152e8)) ? ABSOLUTE(0x1152e8) - ABSOLUTE(.) : 0;
    *ctrport.dir/source/ctr_cache_publish.o(.text.CtrCachePublish_begin)
    . += (ABSOLUTE(.) < ABSOLUTE(0x115380)) ? ABSOLUTE(0x115380) - ABSOLUTE(.) : 0;
    *ctrport.dir/source/ctr_cache_publish.o(.text.CtrCachePublish_run)
    . += (ABSOLUTE(.) < ABSOLUTE(0x115588)) ? ABSOLUTE(0x115588) - ABSOLUTE(.) : 0;
    *ctrport.dir/source/ctr_cache_publish.o(.text.CtrCachePublish_close)
    . += (ABSOLUTE(.) < ABSOLUTE(0x1155d4)) ? ABSOLUTE(0x1155d4) - ABSOLUTE(.) : 0;
    *ctrport.dir/source/ctr_chapters.o(.text.storeSession)
    . += (ABSOLUTE(.) < ABSOLUTE(0x11577c)) ? ABSOLUTE(0x11577c) - ABSOLUTE(.) : 0;
    *ctrport.dir/source/ctr_chapters.o(.text.joinNormalized)
    . += (ABSOLUTE(.) < ABSOLUTE(0x115964)) ? ABSOLUTE(0x115964) - ABSOLUTE(.) : 0;
    *ctrport.dir/source/ctr_chapters.o(.text.applyGameChange)
    . += (ABSOLUTE(.) < ABSOLUTE(0x115b78)) ? ABSOLUTE(0x115b78) - ABSOLUTE(.) : 0;
    *ctrport.dir/source/ctr_chapters.o(.text.applyBootFile)
    . += (ABSOLUTE(.) < ABSOLUTE(0x115cbc)) ? ABSOLUTE(0x115cbc) - ABSOLUTE(.) : 0;
    *ctrport.dir/source/ctr_chapters.o(.text.CtrChapters_init)
    . += (ABSOLUTE(.) < ABSOLUTE(0x115d70)) ? ABSOLUTE(0x115d70) - ABSOLUTE(.) : 0;
    *ctrport.dir/source/ctr_chapters.o(.text.CtrChapters_changeRequested)
    . += (ABSOLUTE(.) < ABSOLUTE(0x115d90)) ? ABSOLUTE(0x115d90) - ABSOLUTE(.) : 0;
    *ctrport.dir/source/ctr_chapters.o(.text.CtrChapters_returnToLauncher)
    . += (ABSOLUTE(.) < ABSOLUTE(0x115e04)) ? ABSOLUTE(0x115e04) - ABSOLUTE(.) : 0;
    *ctrport.dir/source/ctr_chapters.o(.text.CtrChapters_takeGameChange)
    . += (ABSOLUTE(.) < ABSOLUTE(0x115f04)) ? ABSOLUTE(0x115f04) - ABSOLUTE(.) : 0;
    *ctrport.dir/source/ctr_chapters.o(.text.CtrChapters_unloadGame)
    . += (ABSOLUTE(.) < ABSOLUTE(0x115f64)) ? ABSOLUTE(0x115f64) - ABSOLUTE(.) : 0;
    *ctrport.dir/source/ctr_data_version.o(.text.shaBlock)
    . += (ABSOLUTE(.) < ABSOLUTE(0x116128)) ? ABSOLUTE(0x116128) - ABSOLUTE(.) : 0;
    *ctrport.dir/source/ctr_data_version.o(.text.shaUpdate)
    . += (ABSOLUTE(.) < ABSOLUTE(0x116200)) ? ABSOLUTE(0x116200) - ABSOLUTE(.) : 0;
    *ctrport.dir/source/ctr_data_version.o(.text.CtrDataVersion_check)
    . += (ABSOLUTE(.) < ABSOLUTE(0x116658)) ? ABSOLUTE(0x116658) - ABSOLUTE(.) : 0;
    *ctrport.dir/source/ctr_dialogue.o(.text.anyExists)
    . += (ABSOLUTE(.) < ABSOLUTE(0x1166d8)) ? ABSOLUTE(0x1166d8) - ABSOLUTE(.) : 0;
    *ctrport.dir/source/ctr_dialogue.o(.text.findAll)
    . += (ABSOLUTE(.) < ABSOLUTE(0x116780)) ? ABSOLUTE(0x116780) - ABSOLUTE(.) : 0;
    *ctrport.dir/source/ctr_dialogue.o(.text.RValue_toRealOther)
    . += (ABSOLUTE(.) < ABSOLUTE(0x116824)) ? ABSOLUTE(0x116824) - ABSOLUTE(.) : 0;
    *ctrport.dir/source/ctr_dialogue.o(.text.CtrDialogue_init)
    . += (ABSOLUTE(.) < ABSOLUTE(0x1169e0)) ? ABSOLUTE(0x1169e0) - ABSOLUTE(.) : 0;
    *ctrport.dir/source/ctr_dialogue.o(.text.CtrDialogue_free)
    . += (ABSOLUTE(.) < ABSOLUTE(0x116a04)) ? ABSOLUTE(0x116a04) - ABSOLUTE(.) : 0;
    *ctrport.dir/source/ctr_dialogue.o(.text.CtrDialogue_allowed)
    . += (ABSOLUTE(.) < ABSOLUTE(0x116a68)) ? ABSOLUTE(0x116a68) - ABSOLUTE(.) : 0;
    *ctrport.dir/source/ctr_dialogue.o(.text.CtrDialogue_holdAllowed)
    . += (ABSOLUTE(.) < ABSOLUTE(0x116b30)) ? ABSOLUTE(0x116b30) - ABSOLUTE(.) : 0;
    *ctrport.dir/source/ctr_display.o(.text.applyLine)
    . += (ABSOLUTE(.) < ABSOLUTE(0x117248)) ? ABSOLUTE(0x117248) - ABSOLUTE(.) : 0;
    *ctrport.dir/source/ctr_display.o(.text.CtrDisplay_queryCaps)
    . += (ABSOLUTE(.) < ABSOLUTE(0x1172a8)) ? ABSOLUTE(0x1172a8) - ABSOLUTE(.) : 0;
    *ctrport.dir/source/ctr_display.o(.text.CtrDisplay_defaults)
    . += (ABSOLUTE(.) < ABSOLUTE(0x117334)) ? ABSOLUTE(0x117334) - ABSOLUTE(.) : 0;
    *ctrport.dir/source/ctr_display.o(.text.CtrDisplay_load)
    . += (ABSOLUTE(.) < ABSOLUTE(0x1173f4)) ? ABSOLUTE(0x1173f4) - ABSOLUTE(.) : 0;
    *ctrport.dir/source/ctr_display.o(.text.CtrDisplay_override)
    . += (ABSOLUTE(.) < ABSOLUTE(0x117434)) ? ABSOLUTE(0x117434) - ABSOLUTE(.) : 0;
    *ctrport.dir/source/ctr_display.o(.text.CtrDisplay_save)
    . += (ABSOLUTE(.) < ABSOLUTE(0x117650)) ? ABSOLUTE(0x117650) - ABSOLUTE(.) : 0;
    *ctrport.dir/source/ctr_display.o(.text.CtrDisplay_saveEdits)
    . += (ABSOLUTE(.) < ABSOLUTE(0x1177bc)) ? ABSOLUTE(0x1177bc) - ABSOLUTE(.) : 0;
    *ctrport.dir/source/ctr_display.o(.text.CtrDisplay_topModeName)
    . += (ABSOLUTE(.) < ABSOLUTE(0x11788c)) ? ABSOLUTE(0x11788c) - ABSOLUTE(.) : 0;
    *ctrport.dir/source/ctr_display.o(.text.CtrDisplay_drawingName)
    . += (ABSOLUTE(.) < ABSOLUTE(0x1178bc)) ? ABSOLUTE(0x1178bc) - ABSOLUTE(.) : 0;
    *ctrport.dir/source/ctr_display.o(.text.CtrDisplay_stereoModeName)
    . += (ABSOLUTE(.) < ABSOLUTE(0x1178dc)) ? ABSOLUTE(0x1178dc) - ABSOLUTE(.) : 0;
    *ctrport.dir/source/ctr_display.o(.text.CtrDisplay_frameSkipName)
    . += (ABSOLUTE(.) < ABSOLUTE(0x1178fc)) ? ABSOLUTE(0x1178fc) - ABSOLUTE(.) : 0;
    *ctrport.dir/source/ctr_display.o(.text.CtrDisplay_smoothingName)
    . += (ABSOLUTE(.) < ABSOLUTE(0x11791c)) ? ABSOLUTE(0x11791c) - ABSOLUTE(.) : 0;
    *ctrport.dir/source/ctr_display.o(.text.CtrDisplay_bottomModeName)
    . += (ABSOLUTE(.) < ABSOLUTE(0x11793c)) ? ABSOLUTE(0x11793c) - ABSOLUTE(.) : 0;
    *ctrport.dir/source/ctr_file_system.o(.text.isTopLevel)
    . += (ABSOLUTE(.) < ABSOLUTE(0x1179cc)) ? ABSOLUTE(0x1179cc) - ABSOLUTE(.) : 0;
    *ctrport.dir/source/ctr_file_system.o(.text.cacheDrop)
    . += (ABSOLUTE(.) < ABSOLUTE(0x117a50)) ? ABSOLUTE(0x117a50) - ABSOLUTE(.) : 0;
    *ctrport.dir/source/ctr_file_system.o(.text.ctrBinarySeek)
    . += (ABSOLUTE(.) < ABSOLUTE(0x117acc)) ? ABSOLUTE(0x117acc) - ABSOLUTE(.) : 0;
    *ctrport.dir/source/ctr_file_system.o(.text.ctrBinaryRead)
    . += (ABSOLUTE(.) < ABSOLUTE(0x117b8c)) ? ABSOLUTE(0x117b8c) - ABSOLUTE(.) : 0;
    *ctrport.dir/source/ctr_file_system.o(.text.cachePut)
    . += (ABSOLUTE(.) < ABSOLUTE(0x117c28)) ? ABSOLUTE(0x117c28) - ABSOLUTE(.) : 0;
    *ctrport.dir/source/ctr_file_system.o(.text.readWhole)
    . += (ABSOLUTE(.) < ABSOLUTE(0x117d40)) ? ABSOLUTE(0x117d40) - ABSOLUTE(.) : 0;
    *ctrport.dir/source/ctr_file_system.o(.text.adoptPreloaded.part.0)
    . += (ABSOLUTE(.) < ABSOLUTE(0x117e30)) ? ABSOLUTE(0x117e30) - ABSOLUTE(.) : 0;
    *ctrport.dir/source/ctr_file_system.o(.text.lowerDup)
    . += (ABSOLUTE(.) < ABSOLUTE(0x117e9c)) ? ABSOLUTE(0x117e9c) - ABSOLUTE(.) : 0;
    *ctrport.dir/source/ctr_file_system.o(.text.makeKey)
    . += (ABSOLUTE(.) < ABSOLUTE(0x117f20)) ? ABSOLUTE(0x117f20) - ABSOLUTE(.) : 0;
    *ctrport.dir/source/ctr_file_system.o(.text.copyWithNul)
    . += (ABSOLUTE(.) < ABSOLUTE(0x117f98)) ? ABSOLUTE(0x117f98) - ABSOLUTE(.) : 0;
    *ctrport.dir/source/ctr_file_system.o(.text.joinDir)
    . += (ABSOLUTE(.) < ABSOLUTE(0x118014)) ? ABSOLUTE(0x118014) - ABSOLUTE(.) : 0;
    *ctrport.dir/source/ctr_file_system.o(.text.saveWritePath)
    . += (ABSOLUTE(.) < ABSOLUTE(0x1180cc)) ? ABSOLUTE(0x1180cc) - ABSOLUTE(.) : 0;
    *ctrport.dir/source/ctr_file_system.o(.text.withSlash)
    . += (ABSOLUTE(.) < ABSOLUTE(0x118130)) ? ABSOLUTE(0x118130) - ABSOLUTE(.) : 0;
    *ctrport.dir/source/ctr_file_system.o(.text.readQueued)
    . += (ABSOLUTE(.) < ABSOLUTE(0x118220)) ? ABSOLUTE(0x118220) - ABSOLUTE(.) : 0;
    *ctrport.dir/source/ctr_file_system.o(.text.lookup.part.0.constprop.0)
    . += (ABSOLUTE(.) < ABSOLUTE(0x1182d0)) ? ABSOLUTE(0x1182d0) - ABSOLUTE(.) : 0;
    *ctrport.dir/source/ctr_file_system.o(.text.ctrFileExists)
    . += (ABSOLUTE(.) < ABSOLUTE(0x11842c)) ? ABSOLUTE(0x11842c) - ABSOLUTE(.) : 0;
    *ctrport.dir/source/ctr_file_system.o(.text.readIndexed)
    . += (ABSOLUTE(.) < ABSOLUTE(0x118620)) ? ABSOLUTE(0x118620) - ABSOLUTE(.) : 0;
    *ctrport.dir/source/ctr_file_system.o(.text.noteRemoved.part.0)
    . += (ABSOLUTE(.) < ABSOLUTE(0x1186ec)) ? ABSOLUTE(0x1186ec) - ABSOLUTE(.) : 0;
    *ctrport.dir/source/ctr_file_system.o(.text.noteWritten.part.0)
    . += (ABSOLUTE(.) < ABSOLUTE(0x1188b0)) ? ABSOLUTE(0x1188b0) - ABSOLUTE(.) : 0;
    *ctrport.dir/source/ctr_file_system.o(.text.runJob)
    . += (ABSOLUTE(.) < ABSOLUTE(0x118978)) ? ABSOLUTE(0x118978) - ABSOLUTE(.) : 0;
    *ctrport.dir/source/ctr_file_system.o(.text.writerMain)
    . += (ABSOLUTE(.) < ABSOLUTE(0x118d24)) ? ABSOLUTE(0x118d24) - ABSOLUTE(.) : 0;
    *ctrport.dir/source/ctr_file_system.o(.text.queueWrite)
    . += (ABSOLUTE(.) < ABSOLUTE(0x11906c)) ? ABSOLUTE(0x11906c) - ABSOLUTE(.) : 0;
    *ctrport.dir/source/ctr_file_system.o(.text.ctrBinaryClose)
    . += (ABSOLUTE(.) < ABSOLUTE(0x119100)) ? ABSOLUTE(0x119100) - ABSOLUTE(.) : 0;
    *ctrport.dir/source/ctr_file_system.o(.text.ctrWriteFileBinary)
    . += (ABSOLUTE(.) < ABSOLUTE(0x119194)) ? ABSOLUTE(0x119194) - ABSOLUTE(.) : 0;
    *ctrport.dir/source/ctr_file_system.o(.text.ctrWriteFileText)
    . += (ABSOLUTE(.) < ABSOLUTE(0x119228)) ? ABSOLUTE(0x119228) - ABSOLUTE(.) : 0;
    *ctrport.dir/source/ctr_file_system.o(.text.ctrResolvePath)
    . += (ABSOLUTE(.) < ABSOLUTE(0x1192e8)) ? ABSOLUTE(0x1192e8) - ABSOLUTE(.) : 0;
    *ctrport.dir/source/ctr_file_system.o(.text.binaryWriteKey)
    . += (ABSOLUTE(.) < ABSOLUTE(0x1193a0)) ? ABSOLUTE(0x1193a0) - ABSOLUTE(.) : 0;
    *ctrport.dir/source/ctr_file_system.o(.text.ctrBinaryRewrite)
    . += (ABSOLUTE(.) < ABSOLUTE(0x119470)) ? ABSOLUTE(0x119470) - ABSOLUTE(.) : 0;
    *ctrport.dir/source/ctr_file_system.o(.text.ctrReadFileBinary)
    . += (ABSOLUTE(.) < ABSOLUTE(0x119578)) ? ABSOLUTE(0x119578) - ABSOLUTE(.) : 0;
    *ctrport.dir/source/ctr_file_system.o(.text.ctrReadFileText)
    . += (ABSOLUTE(.) < ABSOLUTE(0x119698)) ? ABSOLUTE(0x119698) - ABSOLUTE(.) : 0;
    *ctrport.dir/source/ctr_file_system.o(.text.ctrBinaryWrite.part.0)
    . += (ABSOLUTE(.) < ABSOLUTE(0x119894)) ? ABSOLUTE(0x119894) - ABSOLUTE(.) : 0;
    *ctrport.dir/source/ctr_file_system.o(.text.ctrBinaryWrite)
    . += (ABSOLUTE(.) < ABSOLUTE(0x1198ac)) ? ABSOLUTE(0x1198ac) - ABSOLUTE(.) : 0;
    *ctrport.dir/source/ctr_file_system.o(.text.ctrBinarySize)
    . += (ABSOLUTE(.) < ABSOLUTE(0x11997c)) ? ABSOLUTE(0x11997c) - ABSOLUTE(.) : 0;
    *ctrport.dir/source/ctr_file_system.o(.text.ctrBinaryTell)
    . += (ABSOLUTE(.) < ABSOLUTE(0x119a4c)) ? ABSOLUTE(0x119a4c) - ABSOLUTE(.) : 0;
    *ctrport.dir/source/ctr_file_system.o(.text.CtrFileSystem_flush)
    . += (ABSOLUTE(.) < ABSOLUTE(0x119ae4)) ? ABSOLUTE(0x119ae4) - ABSOLUTE(.) : 0;
    *ctrport.dir/source/ctr_file_system.o(.text.ctrDeleteDirectory)
    . += (ABSOLUTE(.) < ABSOLUTE(0x119ba0)) ? ABSOLUTE(0x119ba0) - ABSOLUTE(.) : 0;
    *ctrport.dir/source/ctr_file_system.o(.text.ctrCreateDirectory)
    . += (ABSOLUTE(.) < ABSOLUTE(0x119c58)) ? ABSOLUTE(0x119c58) - ABSOLUTE(.) : 0;
    *ctrport.dir/source/ctr_file_system.o(.text.ctrBinaryOpen)
    . += (ABSOLUTE(.) < ABSOLUTE(0x119e1c)) ? ABSOLUTE(0x119e1c) - ABSOLUTE(.) : 0;
    *ctrport.dir/source/ctr_file_system.o(.text.ctrRenameFile)
    . += (ABSOLUTE(.) < ABSOLUTE(0x119fac)) ? ABSOLUTE(0x119fac) - ABSOLUTE(.) : 0;
    *ctrport.dir/source/ctr_file_system.o(.text.ctrDeleteFile)
    . += (ABSOLUTE(.) < ABSOLUTE(0x11a0dc)) ? ABSOLUTE(0x11a0dc) - ABSOLUTE(.) : 0;
    *ctrport.dir/source/ctr_file_system.o(.text.ctrListDirectory)
    . += (ABSOLUTE(.) < ABSOLUTE(0x11a254)) ? ABSOLUTE(0x11a254) - ABSOLUTE(.) : 0;
    *ctrport.dir/source/ctr_file_system.o(.text.ctrDirectoryExists)
    . += (ABSOLUTE(.) < ABSOLUTE(0x11a3d0)) ? ABSOLUTE(0x11a3d0) - ABSOLUTE(.) : 0;
    *ctrport.dir/source/ctr_file_system.o(.text.CtrFileSystem_create)
    . += (ABSOLUTE(.) < ABSOLUTE(0x11a884)) ? ABSOLUTE(0x11a884) - ABSOLUTE(.) : 0;
    *ctrport.dir/source/ctr_file_system.o(.text.CtrFileSystem_destroy)
    . += (ABSOLUTE(.) < ABSOLUTE(0x11aa64)) ? ABSOLUTE(0x11aa64) - ABSOLUTE(.) : 0;
    *ctrport.dir/source/ctr_frame_pacer.o(.text.levelProjection)
    . += (ABSOLUTE(.) < ABSOLUTE(0x11aca0)) ? ABSOLUTE(0x11aca0) - ABSOLUTE(.) : 0;
    *ctrport.dir/source/ctr_frame_pacer.o(.text.levelSet)
    . += (ABSOLUTE(.) < ABSOLUTE(0x11ae30)) ? ABSOLUTE(0x11ae30) - ABSOLUTE(.) : 0;
    *ctrport.dir/source/ctr_frame_pacer.o(.text.flip)
    . += (ABSOLUTE(.) < ABSOLUTE(0x11b01c)) ? ABSOLUTE(0x11b01c) - ABSOLUTE(.) : 0;
    *ctrport.dir/source/ctr_frame_pacer.o(.text.releaseHeld.part.0)
    . += (ABSOLUTE(.) < ABSOLUTE(0x11b08c)) ? ABSOLUTE(0x11b08c) - ABSOLUTE(.) : 0;
    *ctrport.dir/source/ctr_frame_pacer.o(.text.onAptEvent)
    . += (ABSOLUTE(.) < ABSOLUTE(0x11b0ec)) ? ABSOLUTE(0x11b0ec) - ABSOLUTE(.) : 0;
    *ctrport.dir/source/ctr_frame_pacer.o(.text.__wrap_gfxScreenSwapBuffers)
    . += (ABSOLUTE(.) < ABSOLUTE(0x11b254)) ? ABSOLUTE(0x11b254) - ABSOLUTE(.) : 0;
    *ctrport.dir/source/ctr_frame_pacer.o(.text.CtrPacer_onVBlank)
    . += (ABSOLUTE(.) < ABSOLUTE(0x11b2ac)) ? ABSOLUTE(0x11b2ac) - ABSOLUTE(.) : 0;
    *ctrport.dir/source/ctr_frame_pacer.o(.text.CtrPacer_screenReady)
    . += (ABSOLUTE(.) < ABSOLUTE(0x11b358)) ? ABSOLUTE(0x11b358) - ABSOLUTE(.) : 0;
    *ctrport.dir/source/ctr_frame_pacer.o(.text.CtrPacer_backFramebuffer)
    . += (ABSOLUTE(.) < ABSOLUTE(0x11b3e0)) ? ABSOLUTE(0x11b3e0) - ABSOLUTE(.) : 0;
    *ctrport.dir/source/ctr_frame_pacer.o(.text.CtrPacer_shownFramebuffer)
    . += (ABSOLUTE(.) < ABSOLUTE(0x11b46c)) ? ABSOLUTE(0x11b46c) - ABSOLUTE(.) : 0;
    *ctrport.dir/source/ctr_frame_pacer.o(.text.CtrPacer_loadStress)
    . += (ABSOLUTE(.) < ABSOLUTE(0x11b6f4)) ? ABSOLUTE(0x11b6f4) - ABSOLUTE(.) : 0;
    *ctrport.dir/source/ctr_frame_pacer.o(.text.CtrPacer_describeStall)
    . += (ABSOLUTE(.) < ABSOLUTE(0x11b788)) ? ABSOLUTE(0x11b788) - ABSOLUTE(.) : 0;
    *ctrport.dir/source/ctr_frame_pacer.o(.text.CtrPacer_init)
    . += (ABSOLUTE(.) < ABSOLUTE(0x11b7e8)) ? ABSOLUTE(0x11b7e8) - ABSOLUTE(.) : 0;
    *ctrport.dir/source/ctr_frame_pacer.o(.text.CtrPacer_setFrameRate)
    . += (ABSOLUTE(.) < ABSOLUTE(0x11b838)) ? ABSOLUTE(0x11b838) - ABSOLUTE(.) : 0;
    *ctrport.dir/source/ctr_frame_pacer.o(.text.CtrPacer_setSkipPolicy)
    . += (ABSOLUTE(.) < ABSOLUTE(0x11b848)) ? ABSOLUTE(0x11b848) - ABSOLUTE(.) : 0;
    *ctrport.dir/source/ctr_frame_pacer.o(.text.CtrPacer_setHalfRateOverlap)
    . += (ABSOLUTE(.) < ABSOLUTE(0x11b858)) ? ABSOLUTE(0x11b858) - ABSOLUTE(.) : 0;
    *ctrport.dir/source/ctr_frame_pacer.o(.text.CtrPacer_getFlipTotals)
    . += (ABSOLUTE(.) < ABSOLUTE(0x11b8a4)) ? ABSOLUTE(0x11b8a4) - ABSOLUTE(.) : 0;
    *ctrport.dir/source/ctr_frame_pacer.o(.text.CtrPacer_skipSlot)
    . += (ABSOLUTE(.) < ABSOLUTE(0x11b968)) ? ABSOLUTE(0x11b968) - ABSOLUTE(.) : 0;
    *ctrport.dir/source/ctr_frame_pacer.o(.text.CtrPacer_waitForSlot)
    . += (ABSOLUTE(.) < ABSOLUTE(0x11bbb4)) ? ABSOLUTE(0x11bbb4) - ABSOLUTE(.) : 0;
    *ctrport.dir/source/ctr_frame_pacer.o(.text.CtrPacer_frameBegun)
    . += (ABSOLUTE(.) < ABSOLUTE(0x11bea0)) ? ABSOLUTE(0x11bea0) - ABSOLUTE(.) : 0;
    *ctrport.dir/source/ctr_frame_pacer.o(.text.CtrPacer_frameEnding)
    . += (ABSOLUTE(.) < ABSOLUTE(0x11bfe4)) ? ABSOLUTE(0x11bfe4) - ABSOLUTE(.) : 0;
    *ctrport.dir/source/ctr_frame_pacer.o(.text.CtrPacer_frameEnded)
    . += (ABSOLUTE(.) < ABSOLUTE(0x11c0d0)) ? ABSOLUTE(0x11c0d0) - ABSOLUTE(.) : 0;
    *ctrport.dir/source/ctr_frame_pacer.o(.text.CtrPacer_logStats)
    . += (ABSOLUTE(.) < ABSOLUTE(0x11c540)) ? ABSOLUTE(0x11c540) - ABSOLUTE(.) : 0;
    *ctrport.dir/source/ctr_frame_pacer.o(.text.CtrPacer_setLevelMode)
    . += (ABSOLUTE(.) < ABSOLUTE(0x11c5c8)) ? ABSOLUTE(0x11c5c8) - ABSOLUTE(.) : 0;
    *ctrport.dir/source/ctr_frame_pacer.o(.text.CtrPacer_levelReset)
    . += (ABSOLUTE(.) < ABSOLUTE(0x11c638)) ? ABSOLUTE(0x11c638) - ABSOLUTE(.) : 0;
    *ctrport.dir/source/ctr_frame_pacer.o(.text.CtrPacer_levelRoomChanged)
    . += (ABSOLUTE(.) < ABSOLUTE(0x11c670)) ? ABSOLUTE(0x11c670) - ABSOLUTE(.) : 0;
    *ctrport.dir/source/ctr_frame_pacer.o(.text.CtrPacer_levelWait)
    . += (ABSOLUTE(.) < ABSOLUTE(0x11ced0)) ? ABSOLUTE(0x11ced0) - ABSOLUTE(.) : 0;
    *ctrport.dir/source/ctr_frame_pacer.o(.text.CtrPacer_levelGpu)
    . += (ABSOLUTE(.) < ABSOLUTE(0x11cf74)) ? ABSOLUTE(0x11cf74) - ABSOLUTE(.) : 0;
    *ctrport.dir/source/ctr_frame_pacer.o(.text.CtrPacer_getLevelTotals)
    . += (ABSOLUTE(.) < ABSOLUTE(0x11cfa8)) ? ABSOLUTE(0x11cfa8) - ABSOLUTE(.) : 0;
    *ctrport.dir/source/ctr_frame_pacer.o(.text.CtrPacer_logLevelStats)
    . += (ABSOLUTE(.) < ABSOLUTE(0x11d0d0)) ? ABSOLUTE(0x11d0d0) - ABSOLUTE(.) : 0;
    *ctrport.dir/source/ctr_frame_pacer.o(.text.CtrPacer_logLevels)
    . += (ABSOLUTE(.) < ABSOLUTE(0x11d324)) ? ABSOLUTE(0x11d324) - ABSOLUTE(.) : 0;
    *ctrport.dir/source/ctr_frame_pacer.o(.text.CtrPacer_stressStep)
    . += (ABSOLUTE(.) < ABSOLUTE(0x11d364)) ? ABSOLUTE(0x11d364) - ABSOLUTE(.) : 0;
    *ctrport.dir/source/ctr_gpu_queue.o(.text.noteEvent)
    . += (ABSOLUTE(.) < ABSOLUTE(0x11d404)) ? ABSOLUTE(0x11d404) - ABSOLUTE(.) : 0;
    *ctrport.dir/source/ctr_gpu_queue.o(.text.startQueue)
    . += (ABSOLUTE(.) < ABSOLUTE(0x11d58c)) ? ABSOLUTE(0x11d58c) - ABSOLUTE(.) : 0;
    *ctrport.dir/source/ctr_gpu_queue.o(.text.finishFrame)
    . += (ABSOLUTE(.) < ABSOLUTE(0x11d754)) ? ABSOLUTE(0x11d754) - ABSOLUTE(.) : 0;
    *ctrport.dir/source/ctr_gpu_queue.o(.text.releaseReady)
    . += (ABSOLUTE(.) < ABSOLUTE(0x11dbb4)) ? ABSOLUTE(0x11dbb4) - ABSOLUTE(.) : 0;
    *ctrport.dir/source/ctr_gpu_queue.o(.text.onVBlank1)
    . += (ABSOLUTE(.) < ABSOLUTE(0x11dc48)) ? ABSOLUTE(0x11dc48) - ABSOLUTE(.) : 0;
    *ctrport.dir/source/ctr_gpu_queue.o(.text.onVBlank0)
    . += (ABSOLUTE(.) < ABSOLUTE(0x11dcec)) ? ABSOLUTE(0x11dcec) - ABSOLUTE(.) : 0;
    *ctrport.dir/source/ctr_gpu_queue.o(.text.C3Di_RenderTargetDestroy)
    . += (ABSOLUTE(.) < ABSOLUTE(0x11dd84)) ? ABSOLUTE(0x11dd84) - ABSOLUTE(.) : 0;
    *ctrport.dir/source/ctr_gpu_queue.o(.text.onQueueFinishLocked)
    . += (ABSOLUTE(.) < ABSOLUTE(0x11de5c)) ? ABSOLUTE(0x11de5c) - ABSOLUTE(.) : 0;
    *ctrport.dir/source/ctr_gpu_queue.o(.text.onQueueFinish)
    . += (ABSOLUTE(.) < ABSOLUTE(0x11df40)) ? ABSOLUTE(0x11df40) - ABSOLUTE(.) : 0;
    *ctrport.dir/source/ctr_gpu_queue.o(.text.simThreadMain)
    . += (ABSOLUTE(.) < ABSOLUTE(0x11dfd8)) ? ABSOLUTE(0x11dfd8) - ABSOLUTE(.) : 0;
    *ctrport.dir/source/ctr_gpu_queue.o(.text.CtrGpu_waitIdle.part.0)
    . += (ABSOLUTE(.) < ABSOLUTE(0x11e1d0)) ? ABSOLUTE(0x11e1d0) - ABSOLUTE(.) : 0;
    *ctrport.dir/source/ctr_gpu_queue.o(.text.CtrGpu_waitIdle)
    . += (ABSOLUTE(.) < ABSOLUTE(0x11e1e8)) ? ABSOLUTE(0x11e1e8) - ABSOLUTE(.) : 0;
    *ctrport.dir/source/ctr_gpu_queue.o(.text.CtrGpu_busy)
    . += (ABSOLUTE(.) < ABSOLUTE(0x11e1f8)) ? ABSOLUTE(0x11e1f8) - ABSOLUTE(.) : 0;
    *ctrport.dir/source/ctr_gpu_queue.o(.text.CtrGpu_takePaceStats)
    . += (ABSOLUTE(.) < ABSOLUTE(0x11e254)) ? ABSOLUTE(0x11e254) - ABSOLUTE(.) : 0;
    *ctrport.dir/source/ctr_gpu_queue.o(.text.CtrGpu_logShownWrites)
    . += (ABSOLUTE(.) < ABSOLUTE(0x11e34c)) ? ABSOLUTE(0x11e34c) - ABSOLUTE(.) : 0;
    *ctrport.dir/source/ctr_gpu_queue.o(.text.CtrGpu_setGateEnabled)
    . += (ABSOLUTE(.) < ABSOLUTE(0x11e388)) ? ABSOLUTE(0x11e388) - ABSOLUTE(.) : 0;
    *ctrport.dir/source/ctr_gpu_queue.o(.text.CtrGpu_describeStall)
    . += (ABSOLUTE(.) < ABSOLUTE(0x11e540)) ? ABSOLUTE(0x11e540) - ABSOLUTE(.) : 0;
    *ctrport.dir/source/ctr_gpu_queue.o(.text.CtrGpu_describeEvents)
    . += (ABSOLUTE(.) < ABSOLUTE(0x11e66c)) ? ABSOLUTE(0x11e66c) - ABSOLUTE(.) : 0;
    *ctrport.dir/source/ctr_gpu_queue.o(.text.CtrGpu_completions)
    . += (ABSOLUTE(.) < ABSOLUTE(0x11e67c)) ? ABSOLUTE(0x11e67c) - ABSOLUTE(.) : 0;
    *ctrport.dir/source/ctr_gpu_queue.o(.text.CtrGpu_queueCapacity)
    . += (ABSOLUTE(.) < ABSOLUTE(0x11e6c4)) ? ABSOLUTE(0x11e6c4) - ABSOLUTE(.) : 0;
    *ctrport.dir/source/ctr_gpu_queue.o(.text.CtrGpu_lastQueued)
    . += (ABSOLUTE(.) < ABSOLUTE(0x11e704)) ? ABSOLUTE(0x11e704) - ABSOLUTE(.) : 0;
    *ctrport.dir/source/ctr_gpu_queue.o(.text.CtrGpu_cancelCopy)
    . += (ABSOLUTE(.) < ABSOLUTE(0x11e7c4)) ? ABSOLUTE(0x11e7c4) - ABSOLUTE(.) : 0;
    *ctrport.dir/source/ctr_gpu_queue.o(.text.CtrGpu_queuedCopyInto)
    . += (ABSOLUTE(.) < ABSOLUTE(0x11e86c)) ? ABSOLUTE(0x11e86c) - ABSOLUTE(.) : 0;
    *ctrport.dir/source/ctr_gpu_queue.o(.text.CtrGpu_frameCommands)
    . += (ABSOLUTE(.) < ABSOLUTE(0x11e908)) ? ABSOLUTE(0x11e908) - ABSOLUTE(.) : 0;
    *ctrport.dir/source/ctr_gpu_queue.o(.text.CtrGpu_completionDue)
    . += (ABSOLUTE(.) < ABSOLUTE(0x11e938)) ? ABSOLUTE(0x11e938) - ABSOLUTE(.) : 0;
    *ctrport.dir/source/ctr_gpu_queue.o(.text.CtrGpu_takeFrameGpuStats)
    . += (ABSOLUTE(.) < ABSOLUTE(0x11ea00)) ? ABSOLUTE(0x11ea00) - ABSOLUTE(.) : 0;
    *ctrport.dir/source/ctr_gpu_queue.o(.text.CtrGpu_waitTotalTicks)
    . += (ABSOLUTE(.) < ABSOLUTE(0x11ea10)) ? ABSOLUTE(0x11ea10) - ABSOLUTE(.) : 0;
    *ctrport.dir/source/ctr_gpu_queue.o(.text.CtrGpu_takeWaitTicks)
    . += (ABSOLUTE(.) < ABSOLUTE(0x11ea34)) ? ABSOLUTE(0x11ea34) - ABSOLUTE(.) : 0;
    *ctrport.dir/source/ctr_gpu_queue.o(.text.CtrGpu_frameStartWord)
    . += (ABSOLUTE(.) < ABSOLUTE(0x11ea44)) ? ABSOLUTE(0x11ea44) - ABSOLUTE(.) : 0;
    *ctrport.dir/source/ctr_gpu_queue.o(.text.CtrGpu_commandBuffer)
    . += (ABSOLUTE(.) < ABSOLUTE(0x11ea94)) ? ABSOLUTE(0x11ea94) - ABSOLUTE(.) : 0;
    *ctrport.dir/source/ctr_gpu_queue.o(.text.CtrGpu_canWrapCommandBuffer)
    . += (ABSOLUTE(.) < ABSOLUTE(0x11eacc)) ? ABSOLUTE(0x11eacc) - ABSOLUTE(.) : 0;
    *ctrport.dir/source/ctr_gpu_queue.o(.text.CtrGpu_wrapCommandBuffer)
    . += (ABSOLUTE(.) < ABSOLUTE(0x11eb74)) ? ABSOLUTE(0x11eb74) - ABSOLUTE(.) : 0;
    *ctrport.dir/source/ctr_gpu_queue.o(.text.CtrGpu_frameEndBehind)
    . += (ABSOLUTE(.) < ABSOLUTE(0x11edd8)) ? ABSOLUTE(0x11edd8) - ABSOLUTE(.) : 0;
    *ctrport.dir/source/ctr_gpu_queue.o(.text.CtrGpu_setSimulatedGpu)
    . += (ABSOLUTE(.) < ABSOLUTE(0x11eed4)) ? ABSOLUTE(0x11eed4) - ABSOLUTE(.) : 0;
    *ctrport.dir/source/ctr_gpu_queue.o(.text.C3D_FrameCounter)
    . += (ABSOLUTE(.) < ABSOLUTE(0x11eee8)) ? ABSOLUTE(0x11eee8) - ABSOLUTE(.) : 0;
    *ctrport.dir/source/ctr_gpu_queue.o(.text.C3Di_RenderQueueEnableVBlank)
    . += (ABSOLUTE(.) < ABSOLUTE(0x11ef20)) ? ABSOLUTE(0x11ef20) - ABSOLUTE(.) : 0;
    *ctrport.dir/source/ctr_gpu_queue.o(.text.C3Di_RenderQueueDisableVBlank)
    . += (ABSOLUTE(.) < ABSOLUTE(0x11ef50)) ? ABSOLUTE(0x11ef50) - ABSOLUTE(.) : 0;
    *ctrport.dir/source/ctr_gpu_queue.o(.text.C3Di_RenderQueueInit)
    . += (ABSOLUTE(.) < ABSOLUTE(0x11f0e0)) ? ABSOLUTE(0x11f0e0) - ABSOLUTE(.) : 0;
    *ctrport.dir/source/ctr_gpu_queue.o(.text.C3Di_RenderQueueExit)
    . += (ABSOLUTE(.) < ABSOLUTE(0x11f230)) ? ABSOLUTE(0x11f230) - ABSOLUTE(.) : 0;
    *ctrport.dir/source/ctr_gpu_queue.o(.text.C3Di_RenderQueueWaitDone)
    . += (ABSOLUTE(.) < ABSOLUTE(0x11f2a0)) ? ABSOLUTE(0x11f2a0) - ABSOLUTE(.) : 0;
    *ctrport.dir/source/ctr_gpu_queue.o(.text.C3D_FrameRate)
    . += (ABSOLUTE(.) < ABSOLUTE(0x11f2ec)) ? ABSOLUTE(0x11f2ec) - ABSOLUTE(.) : 0;
    *ctrport.dir/source/ctr_gpu_queue.o(.text.C3D_FrameBegin)
    . += (ABSOLUTE(.) < ABSOLUTE(0x11f44c)) ? ABSOLUTE(0x11f44c) - ABSOLUTE(.) : 0;
    *ctrport.dir/source/ctr_gpu_queue.o(.text.CtrGpu_frameBeginOverlapped)
    . += (ABSOLUTE(.) < ABSOLUTE(0x11f690)) ? ABSOLUTE(0x11f690) - ABSOLUTE(.) : 0;
    *ctrport.dir/source/ctr_gpu_queue.o(.text.C3D_FrameDrawOn)
    . += (ABSOLUTE(.) < ABSOLUTE(0x11f6e8)) ? ABSOLUTE(0x11f6e8) - ABSOLUTE(.) : 0;
    *ctrport.dir/source/ctr_gpu_queue.o(.text.C3D_FrameSplit)
    . += (ABSOLUTE(.) < ABSOLUTE(0x11f740)) ? ABSOLUTE(0x11f740) - ABSOLUTE(.) : 0;
    *ctrport.dir/source/ctr_gpu_queue.o(.text.C3D_FrameEnd)
    . += (ABSOLUTE(.) < ABSOLUTE(0x11f9d0)) ? ABSOLUTE(0x11f9d0) - ABSOLUTE(.) : 0;
    *ctrport.dir/source/ctr_gpu_queue.o(.text.C3D_GetDrawingTime)
    . += (ABSOLUTE(.) < ABSOLUTE(0x11fa04)) ? ABSOLUTE(0x11fa04) - ABSOLUTE(.) : 0;
    *ctrport.dir/source/ctr_gpu_queue.o(.text.C3D_RenderTargetCreate)
    . += (ABSOLUTE(.) < ABSOLUTE(0x11fb7c)) ? ABSOLUTE(0x11fb7c) - ABSOLUTE(.) : 0;
    *ctrport.dir/source/ctr_gpu_queue.o(.text.C3D_RenderTargetCreateFromTex)
    . += (ABSOLUTE(.) < ABSOLUTE(0x11fca8)) ? ABSOLUTE(0x11fca8) - ABSOLUTE(.) : 0;
    *ctrport.dir/source/ctr_gpu_queue.o(.text.CtrGpu_renderTargetAnywhere)
    . += (ABSOLUTE(.) < ABSOLUTE(0x11fd0c)) ? ABSOLUTE(0x11fd0c) - ABSOLUTE(.) : 0;
    *ctrport.dir/source/ctr_gpu_queue.o(.text.C3D_RenderTargetDelete)
    . += (ABSOLUTE(.) < ABSOLUTE(0x11fe2c)) ? ABSOLUTE(0x11fe2c) - ABSOLUTE(.) : 0;
    *ctrport.dir/source/ctr_gpu_queue.o(.text.C3D_RenderTargetSetOutput)
    . += (ABSOLUTE(.) < ABSOLUTE(0x11ff1c)) ? ABSOLUTE(0x11ff1c) - ABSOLUTE(.) : 0;
    *ctrport.dir/source/ctr_gpu_queue.o(.text.C3D_SyncDisplayTransfer)
    . += (ABSOLUTE(.) < ABSOLUTE(0x120098)) ? ABSOLUTE(0x120098) - ABSOLUTE(.) : 0;
    *ctrport.dir/source/ctr_gpu_queue.o(.text.C3D_SyncTextureCopy)
    . += (ABSOLUTE(.) < ABSOLUTE(0x12021c)) ? ABSOLUTE(0x12021c) - ABSOLUTE(.) : 0;
    *ctrport.dir/source/ctr_hbldr.o(.text.CtrHbldr_fileLoadable)
    . += (ABSOLUTE(.) < ABSOLUTE(0x120338)) ? ABSOLUTE(0x120338) - ABSOLUTE(.) : 0;
    *ctrport.dir/source/ctr_hbldr.o(.text.CtrHbldr_setNext)
    . += (ABSOLUTE(.) < ABSOLUTE(0x1204a0)) ? ABSOLUTE(0x1204a0) - ABSOLUTE(.) : 0;
    *ctrport.dir/source/ctr_inflate.o(.text.slowByte)
    . += (ABSOLUTE(.) < ABSOLUTE(0x120548)) ? ABSOLUTE(0x120548) - ABSOLUTE(.) : 0;
    *ctrport.dir/source/ctr_inflate.o(.text.buildHuffman)
    . += (ABSOLUTE(.) < ABSOLUTE(0x120710)) ? ABSOLUTE(0x120710) - ABSOLUTE(.) : 0;
    *ctrport.dir/source/ctr_inflate.o(.text.buildFixed)
    . += (ABSOLUTE(.) < ABSOLUTE(0x120798)) ? ABSOLUTE(0x120798) - ABSOLUTE(.) : 0;
    *ctrport.dir/source/ctr_inflate.o(.text.flush)
    . += (ABSOLUTE(.) < ABSOLUTE(0x12086c)) ? ABSOLUTE(0x12086c) - ABSOLUTE(.) : 0;
    *ctrport.dir/source/ctr_inflate.o(.text.codedBlock)
    . += (ABSOLUTE(.) < ABSOLUTE(0x120e2c)) ? ABSOLUTE(0x120e2c) - ABSOLUTE(.) : 0;
    *ctrport.dir/source/ctr_inflate.o(.text.buildDynamic)
    . += (ABSOLUTE(.) < ABSOLUTE(0x12138c)) ? ABSOLUTE(0x12138c) - ABSOLUTE(.) : 0;
    *ctrport.dir/source/ctr_inflate.o(.text.CtrInflate_workBytes)
    . += (ABSOLUTE(.) < ABSOLUTE(0x121398)) ? ABSOLUTE(0x121398) - ABSOLUTE(.) : 0;
    *ctrport.dir/source/ctr_inflate.o(.text.CtrInflate_decode)
    . += (ABSOLUTE(.) < ABSOLUTE(0x121764)) ? ABSOLUTE(0x121764) - ABSOLUTE(.) : 0;
    *ctrport.dir/source/ctr_lab.o(.text.switchStack)
    . += (ABSOLUTE(.) < ABSOLUTE(0x12176c)) ? ABSOLUTE(0x12176c) - ABSOLUTE(.) : 0;
    *ctrport.dir/source/ctr_lab.o(.text.put)
    . += (ABSOLUTE(.) < ABSOLUTE(0x121790)) ? ABSOLUTE(0x121790) - ABSOLUTE(.) : 0;
    *ctrport.dir/source/ctr_lab.o(.text.crashThreadMain)
    . += (ABSOLUTE(.) < ABSOLUTE(0x1217c8)) ? ABSOLUTE(0x1217c8) - ABSOLUTE(.) : 0;
    *ctrport.dir/source/ctr_lab.o(.text.standAside)
    . += (ABSOLUTE(.) < ABSOLUTE(0x121804)) ? ABSOLUTE(0x121804) - ABSOLUTE(.) : 0;
    *ctrport.dir/source/ctr_lab.o(.text.entryHandler)
    . += (ABSOLUTE(.) < ABSOLUTE(0x121880)) ? ABSOLUTE(0x121880) - ABSOLUTE(.) : 0;
    *ctrport.dir/source/ctr_lab.o(.text.leave)
    . += (ABSOLUTE(.) < ABSOLUTE(0x121b80)) ? ABSOLUTE(0x121b80) - ABSOLUTE(.) : 0;
    *ctrport.dir/source/ctr_lab.o(.text.fallbackMain)
    . += (ABSOLUTE(.) < ABSOLUTE(0x121bac)) ? ABSOLUTE(0x121bac) - ABSOLUTE(.) : 0;
    *ctrport.dir/source/ctr_lab.o(.text.putLogTail)
    . += (ABSOLUTE(.) < ABSOLUTE(0x121c34)) ? ABSOLUTE(0x121c34) - ABSOLUTE(.) : 0;
    *ctrport.dir/source/ctr_lab.o(.text.onExit)
    . += (ABSOLUTE(.) < ABSOLUTE(0x121d4c)) ? ABSOLUTE(0x121d4c) - ABSOLUTE(.) : 0;
    *ctrport.dir/source/ctr_lab.o(.text.readable.constprop.0)
    . += (ABSOLUTE(.) < ABSOLUTE(0x121da8)) ? ABSOLUTE(0x121da8) - ABSOLUTE(.) : 0;
    *ctrport.dir/source/ctr_lab.o(.text.putThread)
    . += (ABSOLUTE(.) < ABSOLUTE(0x121ee0)) ? ABSOLUTE(0x121ee0) - ABSOLUTE(.) : 0;
    *ctrport.dir/source/ctr_lab.o(.text.putHeader)
    . += (ABSOLUTE(.) < ABSOLUTE(0x122008)) ? ABSOLUTE(0x122008) - ABSOLUTE(.) : 0;
    *ctrport.dir/source/ctr_lab.o(.text.putStack)
    . += (ABSOLUTE(.) < ABSOLUTE(0x1222b4)) ? ABSOLUTE(0x1222b4) - ABSOLUTE(.) : 0;
    *ctrport.dir/source/ctr_lab.o(.text.failMain)
    . += (ABSOLUTE(.) < ABSOLUTE(0x12239c)) ? ABSOLUTE(0x12239c) - ABSOLUTE(.) : 0;
    *ctrport.dir/source/ctr_lab.o(.text.crashMain)
    . += (ABSOLUTE(.) < ABSOLUTE(0x1226d0)) ? ABSOLUTE(0x1226d0) - ABSOLUTE(.) : 0;
    *ctrport.dir/source/ctr_lab.o(.text.hangLeave)
    . += (ABSOLUTE(.) < ABSOLUTE(0x122800)) ? ABSOLUTE(0x122800) - ABSOLUTE(.) : 0;
    *ctrport.dir/source/ctr_lab.o(.text.guardMain)
    . += (ABSOLUTE(.) < ABSOLUTE(0x122a70)) ? ABSOLUTE(0x122a70) - ABSOLUTE(.) : 0;
    *ctrport.dir/source/ctr_lab.o(.text.CtrLab_fail)
    . += (ABSOLUTE(.) < ABSOLUTE(0x122ae8)) ? ABSOLUTE(0x122ae8) - ABSOLUTE(.) : 0;
    *ctrport.dir/source/ctr_lab.o(.text.CtrLab_start)
    . += (ABSOLUTE(.) < ABSOLUTE(0x122e98)) ? ABSOLUTE(0x122e98) - ABSOLUTE(.) : 0;
    *ctrport.dir/source/ctr_lab.o(.text.CtrLab_booted)
    . += (ABSOLUTE(.) < ABSOLUTE(0x122eac)) ? ABSOLUTE(0x122eac) - ABSOLUTE(.) : 0;
    *ctrport.dir/source/ctr_lab.o(.text.CtrLab_active)
    . += (ABSOLUTE(.) < ABSOLUTE(0x122ebc)) ? ABSOLUTE(0x122ebc) - ABSOLUTE(.) : 0;
    *ctrport.dir/source/ctr_lab.o(.text.CtrLab_hostReady)
    . += (ABSOLUTE(.) < ABSOLUTE(0x122ed8)) ? ABSOLUTE(0x122ed8) - ABSOLUTE(.) : 0;
    *ctrport.dir/source/ctr_lab.o(.text.CtrLab_runThread)
    . += (ABSOLUTE(.) < ABSOLUTE(0x122f60)) ? ABSOLUTE(0x122f60) - ABSOLUTE(.) : 0;
    *ctrport.dir/source/ctr_lab.o(.text.CtrLab_setExitNote)
    . += (ABSOLUTE(.) < ABSOLUTE(0x122f70)) ? ABSOLUTE(0x122f70) - ABSOLUTE(.) : 0;
    *ctrport.dir/source/ctr_lab.o(.text.CtrLab_exiting)
    . += (ABSOLUTE(.) < ABSOLUTE(0x122fd8)) ? ABSOLUTE(0x122fd8) - ABSOLUTE(.) : 0;
    *ctrport.dir/source/ctr_lab.o(.text.CtrLab_exitProgress)
    . += (ABSOLUTE(.) < ABSOLUTE(0x122ff8)) ? ABSOLUTE(0x122ff8) - ABSOLUTE(.) : 0;
    *ctrport.dir/source/ctr_lab.o(.text.CtrLab_poll)
    . += (ABSOLUTE(.) < ABSOLUTE(0x123048)) ? ABSOLUTE(0x123048) - ABSOLUTE(.) : 0;
    *ctrport.dir/source/ctr_lab.o(.text.CtrLab_crashTest)
    . += (ABSOLUTE(.) < ABSOLUTE(0x1231d4)) ? ABSOLUTE(0x1231d4) - ABSOLUTE(.) : 0;
    *ctrport.dir/source/ctr_lab_proto.o(.text.LabProto_append.part.0)
    . += (ABSOLUTE(.) < ABSOLUTE(0x123254)) ? ABSOLUTE(0x123254) - ABSOLUTE(.) : 0;
    *ctrport.dir/source/ctr_lab_proto.o(.text.LabProto_packArgv)
    . += (ABSOLUTE(.) < ABSOLUTE(0x1232f4)) ? ABSOLUTE(0x1232f4) - ABSOLUTE(.) : 0;
    *ctrport.dir/source/ctr_lab_proto.o(.text.LabProto_check3dsx)
    . += (ABSOLUTE(.) < ABSOLUTE(0x1233fc)) ? ABSOLUTE(0x1233fc) - ABSOLUTE(.) : 0;
    *ctrport.dir/source/ctr_lab_proto.o(.text.LabProto_sdPath)
    . += (ABSOLUTE(.) < ABSOLUTE(0x123578)) ? ABSOLUTE(0x123578) - ABSOLUTE(.) : 0;
    *ctrport.dir/source/ctr_lab_proto.o(.text.LabProto_append)
    . += (ABSOLUTE(.) < ABSOLUTE(0x123584)) ? ABSOLUTE(0x123584) - ABSOLUTE(.) : 0;
    *ctrport.dir/source/ctr_lab_proto.o(.text.LabProto_appendHex)
    . += (ABSOLUTE(.) < ABSOLUTE(0x123604)) ? ABSOLUTE(0x123604) - ABSOLUTE(.) : 0;
    *ctrport.dir/source/ctr_lab_proto.o(.text.LabProto_appendDec)
    . += (ABSOLUTE(.) < ABSOLUTE(0x1236a0)) ? ABSOLUTE(0x1236a0) - ABSOLUTE(.) : 0;
    *ctrport.dir/source/ctr_language.o(.text.CtrLanguage_systemCode)
    . += (ABSOLUTE(.) < ABSOLUTE(0x1236f4)) ? ABSOLUTE(0x1236f4) - ABSOLUTE(.) : 0;
    *ctrport.dir/source/ctr_launch_args.o(.text.problem)
    . += (ABSOLUTE(.) < ABSOLUTE(0x12377c)) ? ABSOLUTE(0x12377c) - ABSOLUTE(.) : 0;
    *ctrport.dir/source/ctr_launch_args.o(.text.addFrames)
    . += (ABSOLUTE(.) < ABSOLUTE(0x12391c)) ? ABSOLUTE(0x12391c) - ABSOLUTE(.) : 0;
    *ctrport.dir/source/ctr_launch_args.o(.text.CtrLaunchArgs_parse)
    . += (ABSOLUTE(.) < ABSOLUTE(0x124c94)) ? ABSOLUTE(0x124c94) - ABSOLUTE(.) : 0;
    *ctrport.dir/source/ctr_launch_args.o(.text.CtrLaunchArgs_describe)
    . += (ABSOLUTE(.) < ABSOLUTE(0x125928)) ? ABSOLUTE(0x125928) - ABSOLUTE(.) : 0;
    *ctrport.dir/source/ctr_launch_args.o(.text.CtrLaunchArgs_sendFilesMB)
    . += (ABSOLUTE(.) < ABSOLUTE(0x125964)) ? ABSOLUTE(0x125964) - ABSOLUTE(.) : 0;
    *ctrport.dir/source/ctr_link_files.o(.text.reportf)
    . += (ABSOLUTE(.) < ABSOLUTE(0x1259b8)) ? ABSOLUTE(0x1259b8) - ABSOLUTE(.) : 0;
    *ctrport.dir/source/ctr_link_files.o(.text.sendText)
    . += (ABSOLUTE(.) < ABSOLUTE(0x125a1c)) ? ABSOLUTE(0x125a1c) - ABSOLUTE(.) : 0;
    *ctrport.dir/source/ctr_link_files.o(.text.CtrLinkFiles_enable)
    . += (ABSOLUTE(.) < ABSOLUTE(0x125a34)) ? ABSOLUTE(0x125a34) - ABSOLUTE(.) : 0;
    *ctrport.dir/source/ctr_link_files.o(.text.CtrLinkFiles_enabled)
    . += (ABSOLUTE(.) < ABSOLUTE(0x125a44)) ? ABSOLUTE(0x125a44) - ABSOLUTE(.) : 0;
    *ctrport.dir/source/ctr_link_files.o(.text.CtrLinkFiles_note)
    . += (ABSOLUTE(.) < ABSOLUTE(0x125b7c)) ? ABSOLUTE(0x125b7c) - ABSOLUTE(.) : 0;
    *ctrport.dir/source/ctr_link_files.o(.text.CtrLinkFiles_prepare)
    . += (ABSOLUTE(.) < ABSOLUTE(0x125fbc)) ? ABSOLUTE(0x125fbc) - ABSOLUTE(.) : 0;
    *ctrport.dir/source/ctr_link_files.o(.text.CtrLinkFiles_pending)
    . += (ABSOLUTE(.) < ABSOLUTE(0x12600c)) ? ABSOLUTE(0x12600c) - ABSOLUTE(.) : 0;
    *ctrport.dir/source/ctr_link_files.o(.text.CtrLinkFiles_progress)
    . += (ABSOLUTE(.) < ABSOLUTE(0x12601c)) ? ABSOLUTE(0x12601c) - ABSOLUTE(.) : 0;
    *ctrport.dir/source/ctr_link_files.o(.text.CtrLinkFiles_busy)
    . += (ABSOLUTE(.) < ABSOLUTE(0x126070)) ? ABSOLUTE(0x126070) - ABSOLUTE(.) : 0;
    *ctrport.dir/source/ctr_link_files.o(.text.CtrLinkFiles_base64)
    . += (ABSOLUTE(.) < ABSOLUTE(0x1261c8)) ? ABSOLUTE(0x1261c8) - ABSOLUTE(.) : 0;
    *ctrport.dir/source/ctr_link_files.o(.text.CtrLinkFiles_send)
    . += (ABSOLUTE(.) < ABSOLUTE(0x126710)) ? ABSOLUTE(0x126710) - ABSOLUTE(.) : 0;
    *ctrport.dir/source/ctr_log.o(.text.linkConnect)
    . += (ABSOLUTE(.) < ABSOLUTE(0x12681c)) ? ABSOLUTE(0x12681c) - ABSOLUTE(.) : 0;
    *ctrport.dir/source/ctr_log.o(.text.linkSend)
    . += (ABSOLUTE(.) < ABSOLUTE(0x126920)) ? ABSOLUTE(0x126920) - ABSOLUTE(.) : 0;
    *ctrport.dir/source/ctr_log.o(.text.linkSendFile)
    . += (ABSOLUTE(.) < ABSOLUTE(0x126944)) ? ABSOLUTE(0x126944) - ABSOLUTE(.) : 0;
    *ctrport.dir/source/ctr_log.o(.text.parseConversion)
    . += (ABSOLUTE(.) < ABSOLUTE(0x126af4)) ? ABSOLUTE(0x126af4) - ABSOLUTE(.) : 0;
    *ctrport.dir/source/ctr_log.o(.text.appendf)
    . += (ABSOLUTE(.) < ABSOLUTE(0x126b6c)) ? ABSOLUTE(0x126b6c) - ABSOLUTE(.) : 0;
    *ctrport.dir/source/ctr_log.o(.text.reportFileDecision)
    *ctrport.dir/source/ctr_log.o(.text.linkMain)
    . += (ABSOLUTE(.) < ABSOLUTE(0x126ed8)) ? ABSOLUTE(0x126ed8) - ABSOLUTE(.) : 0;
    *ctrport.dir/source/ctr_log.o(.text.putDroppedRecord)
    . += (ABSOLUTE(.) < ABSOLUTE(0x126f98)) ? ABSOLUTE(0x126f98) - ABSOLUTE(.) : 0;
    *ctrport.dir/source/ctr_log.o(.text.postRecordBefore)
    . += (ABSOLUTE(.) < ABSOLUTE(0x127130)) ? ABSOLUTE(0x127130) - ABSOLUTE(.) : 0;
    *ctrport.dir/source/ctr_log.o(.text.linkWrite.part.0)
    *ctrport.dir/source/ctr_log.o(.text.writeLine)
    . += (ABSOLUTE(.) < ABSOLUTE(0x1273b8)) ? ABSOLUTE(0x1273b8) - ABSOLUTE(.) : 0;
    *ctrport.dir/source/ctr_log.o(.text.postRecord)
    *ctrport.dir/source/ctr_log.o(.text.writerMain)
    . += (ABSOLUTE(.) < ABSOLUTE(0x127d34)) ? ABSOLUTE(0x127d34) - ABSOLUTE(.) : 0;
    HIDDEN(__hotpin_1 = ABSOLUTE(.));
    *ctrport.dir/source/ctr_log.o(.text.postLine)
    . += (ABSOLUTE(.) < ABSOLUTE(0x128130)) ? ABSOLUTE(0x128130) - ABSOLUTE(.) : 0;
    *ctrport.dir/source/ctr_log.o(.text.postSelect)
    . += (ABSOLUTE(.) < ABSOLUTE(0x128184)) ? ABSOLUTE(0x128184) - ABSOLUTE(.) : 0;
    *ctrport.dir/source/ctr_log.o(.text.CtrLog_linkHost)
    . += (ABSOLUTE(.) < ABSOLUTE(0x12819c)) ? ABSOLUTE(0x12819c) - ABSOLUTE(.) : 0;
    *ctrport.dir/source/ctr_log.o(.text.CtrLog_linkOpen)
    *ctrport.dir/source/ctr_log.o(.text.CtrLog_stopLink)
    *ctrport.dir/source/ctr_log.o(.text.CtrLog_startLink)
    . += (ABSOLUTE(.) < ABSOLUTE(0x128464)) ? ABSOLUTE(0x128464) - ABSOLUTE(.) : 0;
    *ctrport.dir/source/ctr_log.o(.text.CtrLog_tail)
    *ctrport.dir/source/ctr_log.o(.text.CtrLog_openFile)
    . += (ABSOLUTE(.) < ABSOLUTE(0x1286b8)) ? ABSOLUTE(0x1286b8) - ABSOLUTE(.) : 0;
    *ctrport.dir/source/ctr_log.o(.text.CtrLog_setExitProgress)
    *ctrport.dir/source/ctr_log.o(.text.CtrLog_closeFile)
    . += (ABSOLUTE(.) < ABSOLUTE(0x1287c8)) ? ABSOLUTE(0x1287c8) - ABSOLUTE(.) : 0;
    *ctrport.dir/source/ctr_log.o(.text.CtrLog_flush)
    . += (ABSOLUTE(.) < ABSOLUTE(0x1288d4)) ? ABSOLUTE(0x1288d4) - ABSOLUTE(.) : 0;
    *ctrport.dir/source/ctr_log.o(.text.CtrLog_flushSoon)
    . += (ABSOLUTE(.) < ABSOLUTE(0x12894c)) ? ABSOLUTE(0x12894c) - ABSOLUTE(.) : 0;
    *ctrport.dir/source/ctr_log.o(.text.CtrLog_setConsoleEnabled)
    . += (ABSOLUTE(.) < ABSOLUTE(0x12895c)) ? ABSOLUTE(0x12895c) - ABSOLUTE(.) : 0;
    *ctrport.dir/source/ctr_log.o(.text.CtrLog_setFrameTimed)
    . += (ABSOLUTE(.) < ABSOLUTE(0x1289a0)) ? ABSOLUTE(0x1289a0) - ABSOLUTE(.) : 0;
    *ctrport.dir/source/ctr_log.o(.text.CtrLog_consoleEnabled)
    *ctrport.dir/source/ctr_log.o(.text.CtrLog_beginConsole)
    *ctrport.dir/source/ctr_log.o(.text.CtrLog_endConsole)
    . += (ABSOLUTE(.) < ABSOLUTE(0x128a58)) ? ABSOLUTE(0x128a58) - ABSOLUTE(.) : 0;
    *ctrport.dir/source/ctr_log.o(.text.CtrLog_printTo)
    . += (ABSOLUTE(.) < ABSOLUTE(0x128ad8)) ? ABSOLUTE(0x128ad8) - ABSOLUTE(.) : 0;
    *ctrport.dir/source/ctr_log.o(.text.CtrLog_selectConsole)
    . += (ABSOLUTE(.) < ABSOLUTE(0x128af8)) ? ABSOLUTE(0x128af8) - ABSOLUTE(.) : 0;
    *ctrport.dir/source/ctr_log.o(.text.CtrLog_linkWrite)
    *ctrport.dir/source/ctr_log.o(.text.CtrLog_emergency)
    *ctrport.dir/source/ctr_log.o(.text.platformLog)
    . += (ABSOLUTE(.) < ABSOLUTE(0x129220)) ? ABSOLUTE(0x129220) - ABSOLUTE(.) : 0;
    *ctrport.dir/source/ctr_log.o(.text.CtrLog_warningCount)
    . += (ABSOLUTE(.) < ABSOLUTE(0x129230)) ? ABSOLUTE(0x129230) - ABSOLUTE(.) : 0;
    *ctrport.dir/source/ctr_log.o(.text.CtrLog_lastWarning)
    . += (ABSOLUTE(.) < ABSOLUTE(0x12923c)) ? ABSOLUTE(0x12923c) - ABSOLUTE(.) : 0;
    *ctrport.dir/source/ctr_lz.o(.text.CtrLz_bound)
    . += (ABSOLUTE(.) < ABSOLUTE(0x129254)) ? ABSOLUTE(0x129254) - ABSOLUTE(.) : 0;
    *ctrport.dir/source/ctr_lz.o(.text.CtrLz_compress)
    . += (ABSOLUTE(.) < ABSOLUTE(0x1297c8)) ? ABSOLUTE(0x1297c8) - ABSOLUTE(.) : 0;
    HIDDEN(__hotpin_2 = ABSOLUTE(.));
    *ctrport.dir/source/ctr_lz.o(.text.CtrLz_decompress)
    . += (ABSOLUTE(.) < ABSOLUTE(0x12998c)) ? ABSOLUTE(0x12998c) - ABSOLUTE(.) : 0;
    *ctrport.dir/source/ctr_memory.o(.text.relieveHeap)
    . += (ABSOLUTE(.) < ABSOLUTE(0x129a0c)) ? ABSOLUTE(0x129a0c) - ABSOLUTE(.) : 0;
    *ctrport.dir/source/ctr_memory.o(.text.overflowAlloc)
    . += (ABSOLUTE(.) < ABSOLUTE(0x129aa0)) ? ABSOLUTE(0x129aa0) - ABSOLUTE(.) : 0;
    *ctrport.dir/source/ctr_memory.o(.text.lockLinear.part.0)
    . += (ABSOLUTE(.) < ABSOLUTE(0x129af0)) ? ABSOLUTE(0x129af0) - ABSOLUTE(.) : 0;
    *ctrport.dir/source/ctr_memory.o(.text.releaseHeldFrees.part.0)
    . += (ABSOLUTE(.) < ABSOLUTE(0x129bc0)) ? ABSOLUTE(0x129bc0) - ABSOLUTE(.) : 0;
    *ctrport.dir/source/ctr_memory.o(.text.CtrMemory_malloc.part.0)
    . += (ABSOLUTE(.) < ABSOLUTE(0x129c10)) ? ABSOLUTE(0x129c10) - ABSOLUTE(.) : 0;
    *ctrport.dir/source/ctr_memory.o(.text.retryAfterGpu.part.0)
    . += (ABSOLUTE(.) < ABSOLUTE(0x129c74)) ? ABSOLUTE(0x129c74) - ABSOLUTE(.) : 0;
    *ctrport.dir/source/ctr_memory.o(.text.freeWhenGpuDone.part.0)
    . += (ABSOLUTE(.) < ABSOLUTE(0x129e18)) ? ABSOLUTE(0x129e18) - ABSOLUTE(.) : 0;
    *ctrport.dir/source/ctr_memory.o(.text.startup.keepHeapTop)
    . += (ABSOLUTE(.) < ABSOLUTE(0x129e24)) ? ABSOLUTE(0x129e24) - ABSOLUTE(.) : 0;
    *ctrport.dir/source/ctr_memory.o(.text.CtrMemory_linearLockStats)
    . += (ABSOLUTE(.) < ABSOLUTE(0x129e84)) ? ABSOLUTE(0x129e84) - ABSOLUTE(.) : 0;
    *ctrport.dir/source/ctr_memory.o(.text.__wrap_linearAlloc .text.CtrMemory_linearAllocOnce)
    . += (ABSOLUTE(.) < ABSOLUTE(0x129efc)) ? ABSOLUTE(0x129efc) - ABSOLUTE(.) : 0;
    *ctrport.dir/source/ctr_memory.o(.text.__wrap_linearGetSize)
    . += (ABSOLUTE(.) < ABSOLUTE(0x129f38)) ? ABSOLUTE(0x129f38) - ABSOLUTE(.) : 0;
    *ctrport.dir/source/ctr_memory.o(.text.__wrap_linearFree)
    . += (ABSOLUTE(.) < ABSOLUTE(0x129f48)) ? ABSOLUTE(0x129f48) - ABSOLUTE(.) : 0;
    *ctrport.dir/source/ctr_memory.o(.text.__wrap_linearSpaceFree)
    . += (ABSOLUTE(.) < ABSOLUTE(0x129f9c)) ? ABSOLUTE(0x129f9c) - ABSOLUTE(.) : 0;
    *ctrport.dir/source/ctr_memory.o(.text.CtrMemory_vramBlocks)
    . += (ABSOLUTE(.) < ABSOLUTE(0x12a08c)) ? ABSOLUTE(0x12a08c) - ABSOLUTE(.) : 0;
    *ctrport.dir/source/ctr_memory.o(.text.__wrap_vramAlloc .text.CtrMemory_vramAllocOnce)
    . += (ABSOLUTE(.) < ABSOLUTE(0x12a150)) ? ABSOLUTE(0x12a150) - ABSOLUTE(.) : 0;
    *ctrport.dir/source/ctr_memory.o(.text.__wrap_vramAllocAt .text.CtrMemory_vramAllocAtOnce)
    . += (ABSOLUTE(.) < ABSOLUTE(0x12a220)) ? ABSOLUTE(0x12a220) - ABSOLUTE(.) : 0;
    *ctrport.dir/source/ctr_memory.o(.text.__wrap_vramFree)
    . += (ABSOLUTE(.) < ABSOLUTE(0x12a2b4)) ? ABSOLUTE(0x12a2b4) - ABSOLUTE(.) : 0;
    *ctrport.dir/source/ctr_memory.o(.text.__wrap_vramSpaceFree)
    . += (ABSOLUTE(.) < ABSOLUTE(0x12a308)) ? ABSOLUTE(0x12a308) - ABSOLUTE(.) : 0;
    *ctrport.dir/source/ctr_memory.o(.text.CtrMemory_vramAllocNow)
    . += (ABSOLUTE(.) < ABSOLUTE(0x12a3a4)) ? ABSOLUTE(0x12a3a4) - ABSOLUTE(.) : 0;
    *ctrport.dir/source/ctr_memory.o(.text.CtrMemory_vramFreeNow)
    . += (ABSOLUTE(.) < ABSOLUTE(0x12a3f0)) ? ABSOLUTE(0x12a3f0) - ABSOLUTE(.) : 0;
    *ctrport.dir/source/ctr_memory.o(.text.__system_allocateHeaps)
    . += (ABSOLUTE(.) < ABSOLUTE(0x12a694)) ? ABSOLUTE(0x12a694) - ABSOLUTE(.) : 0;
    *ctrport.dir/source/ctr_memory.o(.text.CtrAotModule_regionReserved)
    . += (ABSOLUTE(.) < ABSOLUTE(0x12a6b0)) ? ABSOLUTE(0x12a6b0) - ABSOLUTE(.) : 0;
    *ctrport.dir/source/ctr_memory.o(.text.exit.freeAotRegion)
    . += (ABSOLUTE(.) < ABSOLUTE(0x12a6f8)) ? ABSOLUTE(0x12a6f8) - ABSOLUTE(.) : 0;
    *ctrport.dir/source/ctr_memory.o(.text.CtrMemory_setHeapReliever)
    . += (ABSOLUTE(.) < ABSOLUTE(0x12a708)) ? ABSOLUTE(0x12a708) - ABSOLUTE(.) : 0;
    *ctrport.dir/source/ctr_memory.o(.text.CtrMemory_markGameThread)
    . += (ABSOLUTE(.) < ABSOLUTE(0x12a724)) ? ABSOLUTE(0x12a724) - ABSOLUTE(.) : 0;
    *ctrport.dir/source/ctr_memory.o(.text.CtrMemory_allowRelief)
    . += (ABSOLUTE(.) < ABSOLUTE(0x12a74c)) ? ABSOLUTE(0x12a74c) - ABSOLUTE(.) : 0;
    *ctrport.dir/source/ctr_memory.o(.text.CtrMemory_preferLinearWork)
    . += (ABSOLUTE(.) < ABSOLUTE(0x12a76c)) ? ABSOLUTE(0x12a76c) - ABSOLUTE(.) : 0;
    *ctrport.dir/source/ctr_memory.o(.text.CtrMemory_allocWork)
    . += (ABSOLUTE(.) < ABSOLUTE(0x12a7bc)) ? ABSOLUTE(0x12a7bc) - ABSOLUTE(.) : 0;
    *ctrport.dir/source/ctr_memory.o(.text.CtrMemory_freeWork)
    . += (ABSOLUTE(.) < ABSOLUTE(0x12a7f8)) ? ABSOLUTE(0x12a7f8) - ABSOLUTE(.) : 0;
    *ctrport.dir/source/ctr_memory.o(.text.CtrMemory_failedAllocation)
    . += (ABSOLUTE(.) < ABSOLUTE(0x12a820)) ? ABSOLUTE(0x12a820) - ABSOLUTE(.) : 0;
    *ctrport.dir/source/ctr_memory.o(.text.CtrMemory_malloc)
    . += (ABSOLUTE(.) < ABSOLUTE(0x12a8fc)) ? ABSOLUTE(0x12a8fc) - ABSOLUTE(.) : 0;
    HIDDEN(__hotpin_3 = ABSOLUTE(.));
    *ctrport.dir/source/ctr_memory.o(.text.CtrMemory_calloc)
    . += (ABSOLUTE(.) < ABSOLUTE(0x12a9a4)) ? ABSOLUTE(0x12a9a4) - ABSOLUTE(.) : 0;
    *ctrport.dir/source/ctr_memory.o(.text.CtrMemory_free)
    . += (ABSOLUTE(.) < ABSOLUTE(0x12aa3c)) ? ABSOLUTE(0x12aa3c) - ABSOLUTE(.) : 0;
    *ctrport.dir/source/ctr_memory.o(.text.CtrMemory_realloc)
    . += (ABSOLUTE(.) < ABSOLUTE(0x12ac28)) ? ABSOLUTE(0x12ac28) - ABSOLUTE(.) : 0;
    *ctrport.dir/source/ctr_memory.o(.text.__wrap_malloc)
    . += (ABSOLUTE(.) < ABSOLUTE(0x12ad04)) ? ABSOLUTE(0x12ad04) - ABSOLUTE(.) : 0;
    *ctrport.dir/source/ctr_memory.o(.text.__wrap_calloc)
    . += (ABSOLUTE(.) < ABSOLUTE(0x12ad08)) ? ABSOLUTE(0x12ad08) - ABSOLUTE(.) : 0;
    *ctrport.dir/source/ctr_memory.o(.text.__wrap_realloc)
    . += (ABSOLUTE(.) < ABSOLUTE(0x12ad0c)) ? ABSOLUTE(0x12ad0c) - ABSOLUTE(.) : 0;
    *ctrport.dir/source/ctr_memory.o(.text.__wrap_free)
    . += (ABSOLUTE(.) < ABSOLUTE(0x12ada4)) ? ABSOLUTE(0x12ada4) - ABSOLUTE(.) : 0;
    HIDDEN(__hotpin_4 = ABSOLUTE(.));
    *ctrport.dir/source/ctr_memory.o(.text.__wrap__free_r)
    . += (ABSOLUTE(.) < ABSOLUTE(0x12ae40)) ? ABSOLUTE(0x12ae40) - ABSOLUTE(.) : 0;
    *ctrport.dir/source/ctr_memory.o(.text.CtrMemory_releaseNumberCaches)
    . += (ABSOLUTE(.) < ABSOLUTE(0x12af18)) ? ABSOLUTE(0x12af18) - ABSOLUTE(.) : 0;
    *ctrport.dir/source/ctr_memory.o(.text.threadTrampoline)
    . += (ABSOLUTE(.) < ABSOLUTE(0x12af48)) ? ABSOLUTE(0x12af48) - ABSOLUTE(.) : 0;
    *ctrport.dir/source/ctr_memory.o(.text.__wrap_threadCreate)
    . += (ABSOLUTE(.) < ABSOLUTE(0x12afcc)) ? ABSOLUTE(0x12afcc) - ABSOLUTE(.) : 0;
    *ctrport.dir/source/ctr_memory.o(.text.CtrMemory_reserveFileSlots)
    . += (ABSOLUTE(.) < ABSOLUTE(0x12b050)) ? ABSOLUTE(0x12b050) - ABSOLUTE(.) : 0;
    *ctrport.dir/source/ctr_memory.o(.text.CtrMemory_logHeapLayout)
    . += (ABSOLUTE(.) < ABSOLUTE(0x12b79c)) ? ABSOLUTE(0x12b79c) - ABSOLUTE(.) : 0;
    *ctrport.dir/source/ctr_memory.o(.text.CtrMemory_allocTemporary)
    . += (ABSOLUTE(.) < ABSOLUTE(0x12b7bc)) ? ABSOLUTE(0x12b7bc) - ABSOLUTE(.) : 0;
    *ctrport.dir/source/ctr_menu.o(.text.drawControls)
    . += (ABSOLUTE(.) < ABSOLUTE(0x12b9d4)) ? ABSOLUTE(0x12b9d4) - ABSOLUTE(.) : 0;
    *ctrport.dir/source/ctr_menu.o(.text.draw)
    . += (ABSOLUTE(.) < ABSOLUTE(0x12c098)) ? ABSOLUTE(0x12c098) - ABSOLUTE(.) : 0;
    *ctrport.dir/source/ctr_menu.o(.text.CtrMenu_open)
    . += (ABSOLUTE(.) < ABSOLUTE(0x12c104)) ? ABSOLUTE(0x12c104) - ABSOLUTE(.) : 0;
    *ctrport.dir/source/ctr_menu.o(.text.CtrMenu_close)
    . += (ABSOLUTE(.) < ABSOLUTE(0x12c144)) ? ABSOLUTE(0x12c144) - ABSOLUTE(.) : 0;
    *ctrport.dir/source/ctr_menu.o(.text.CtrMenu_update)
    . += (ABSOLUTE(.) < ABSOLUTE(0x12c6e4)) ? ABSOLUTE(0x12c6e4) - ABSOLUTE(.) : 0;
    *ctrport.dir/source/ctr_mp4.o(.text.freeTrack)
    . += (ABSOLUTE(.) < ABSOLUTE(0x12c728)) ? ABSOLUTE(0x12c728) - ABSOLUTE(.) : 0;
    *ctrport.dir/source/ctr_mp4.o(.text.nextBox)
    . += (ABSOLUTE(.) < ABSOLUTE(0x12c7f8)) ? ABSOLUTE(0x12c7f8) - ABSOLUTE(.) : 0;
    *ctrport.dir/source/ctr_mp4.o(.text.CtrMp4_sniff)
    . += (ABSOLUTE(.) < ABSOLUTE(0x12c854)) ? ABSOLUTE(0x12c854) - ABSOLUTE(.) : 0;
    *ctrport.dir/source/ctr_mp4.o(.text.CtrMp4_open)
    . += (ABSOLUTE(.) < ABSOLUTE(0x12dc78)) ? ABSOLUTE(0x12dc78) - ABSOLUTE(.) : 0;
    *ctrport.dir/source/ctr_mp4.o(.text.CtrMp4_close)
    . += (ABSOLUTE(.) < ABSOLUTE(0x12dcc0)) ? ABSOLUTE(0x12dcc0) - ABSOLUTE(.) : 0;
    *ctrport.dir/source/ctr_mp4.o(.text.CtrMp4_readSample)
    . += (ABSOLUTE(.) < ABSOLUTE(0x12ddf0)) ? ABSOLUTE(0x12ddf0) - ABSOLUTE(.) : 0;
    *ctrport.dir/source/ctr_notice.o(.text.remember)
    . += (ABSOLUTE(.) < ABSOLUTE(0x12ded0)) ? ABSOLUTE(0x12ded0) - ABSOLUTE(.) : 0;
    *ctrport.dir/source/ctr_notice.o(.text.CtrNotice_init)
    . += (ABSOLUTE(.) < ABSOLUTE(0x12df80)) ? ABSOLUTE(0x12df80) - ABSOLUTE(.) : 0;
    *ctrport.dir/source/ctr_notice.o(.text.CtrNotice_report)
    . += (ABSOLUTE(.) < ABSOLUTE(0x12e004)) ? ABSOLUTE(0x12e004) - ABSOLUTE(.) : 0;
    *ctrport.dir/source/ctr_notice.o(.text.CtrNotice_missing)
    . += (ABSOLUTE(.) < ABSOLUTE(0x12e010)) ? ABSOLUTE(0x12e010) - ABSOLUTE(.) : 0;
    *ctrport.dir/source/ctr_notice.o(.text.CtrNotice_first)
    . += (ABSOLUTE(.) < ABSOLUTE(0x12e048)) ? ABSOLUTE(0x12e048) - ABSOLUTE(.) : 0;
    *ctrport.dir/source/ctr_notice.o(.text.CtrNotice_advice)
    . += (ABSOLUTE(.) < ABSOLUTE(0x12e090)) ? ABSOLUTE(0x12e090) - ABSOLUTE(.) : 0;
    *ctrport.dir/source/ctr_notice.o(.text.CtrNotice_dismiss)
    . += (ABSOLUTE(.) < ABSOLUTE(0x12e178)) ? ABSOLUTE(0x12e178) - ABSOLUTE(.) : 0;
    *ctrport.dir/source/ctr_notice.o(.text.CtrNotice_writeDismissals)
    . += (ABSOLUTE(.) < ABSOLUTE(0x12e1c8)) ? ABSOLUTE(0x12e1c8) - ABSOLUTE(.) : 0;
    *ctrport.dir/source/ctr_open_files.o(.text.trackedDirClose)
    . += (ABSOLUTE(.) < ABSOLUTE(0x12e268)) ? ABSOLUTE(0x12e268) - ABSOLUTE(.) : 0;
    *ctrport.dir/source/ctr_open_files.o(.text.attemptOpen)
    . += (ABSOLUTE(.) < ABSOLUTE(0x12e2f4)) ? ABSOLUTE(0x12e2f4) - ABSOLUTE(.) : 0;
    *ctrport.dir/source/ctr_open_files.o(.text.add)
    . += (ABSOLUTE(.) < ABSOLUTE(0x12e374)) ? ABSOLUTE(0x12e374) - ABSOLUTE(.) : 0;
    *ctrport.dir/source/ctr_open_files.o(.text.shedOwn.isra.0)
    . += (ABSOLUTE(.) < ABSOLUTE(0x12e420)) ? ABSOLUTE(0x12e420) - ABSOLUTE(.) : 0;
    *ctrport.dir/source/ctr_open_files.o(.text.askToShed)
    . += (ABSOLUTE(.) < ABSOLUTE(0x12e514)) ? ABSOLUTE(0x12e514) - ABSOLUTE(.) : 0;
    *ctrport.dir/source/ctr_open_files.o(.text.trackedClose)
    . += (ABSOLUTE(.) < ABSOLUTE(0x12e5b4)) ? ABSOLUTE(0x12e5b4) - ABSOLUTE(.) : 0;
    *ctrport.dir/source/ctr_open_files.o(.text.attemptDirOpen)
    . += (ABSOLUTE(.) < ABSOLUTE(0x12e640)) ? ABSOLUTE(0x12e640) - ABSOLUTE(.) : 0;
    *ctrport.dir/source/ctr_open_files.o(.text.CtrOpenFiles_missing)
    . += (ABSOLUTE(.) < ABSOLUTE(0x12e65c)) ? ABSOLUTE(0x12e65c) - ABSOLUTE(.) : 0;
    *ctrport.dir/source/ctr_open_files.o(.text.CtrOpenFiles_track)
    . += (ABSOLUTE(.) < ABSOLUTE(0x12e738)) ? ABSOLUTE(0x12e738) - ABSOLUTE(.) : 0;
    *ctrport.dir/source/ctr_open_files.o(.text.CtrOpenFiles_setLimit)
    . += (ABSOLUTE(.) < ABSOLUTE(0x12e784)) ? ABSOLUTE(0x12e784) - ABSOLUTE(.) : 0;
    *ctrport.dir/source/ctr_open_files.o(.text.CtrOpenFiles_mayKeep)
    . += (ABSOLUTE(.) < ABSOLUTE(0x12e7f0)) ? ABSOLUTE(0x12e7f0) - ABSOLUTE(.) : 0;
    *ctrport.dir/source/ctr_open_files.o(.text.CtrOpenFiles_addKeeper)
    . += (ABSOLUTE(.) < ABSOLUTE(0x12e88c)) ? ABSOLUTE(0x12e88c) - ABSOLUTE(.) : 0;
    *ctrport.dir/source/ctr_open_files.o(.text.CtrOpenFiles_removeKeeper)
    . += (ABSOLUTE(.) < ABSOLUTE(0x12e8d0)) ? ABSOLUTE(0x12e8d0) - ABSOLUTE(.) : 0;
    *ctrport.dir/source/ctr_open_files.o(.text.CtrOpenFiles_poll)
    . += (ABSOLUTE(.) < ABSOLUTE(0x12e8e8)) ? ABSOLUTE(0x12e8e8) - ABSOLUTE(.) : 0;
    *ctrport.dir/source/ctr_open_files.o(.text.CtrOpenFiles_beginCacheOpen)
    . += (ABSOLUTE(.) < ABSOLUTE(0x12e908)) ? ABSOLUTE(0x12e908) - ABSOLUTE(.) : 0;
    *ctrport.dir/source/ctr_open_files.o(.text.CtrOpenFiles_endCacheOpen)
    . += (ABSOLUTE(.) < ABSOLUTE(0x12e928)) ? ABSOLUTE(0x12e928) - ABSOLUTE(.) : 0;
    *ctrport.dir/source/ctr_open_files.o(.text.CtrOpenFiles_log)
    . += (ABSOLUTE(.) < ABSOLUTE(0x12ec00)) ? ABSOLUTE(0x12ec00) - ABSOLUTE(.) : 0;
    *ctrport.dir/source/ctr_open_files.o(.text.noteFailure)
    . += (ABSOLUTE(.) < ABSOLUTE(0x12edf0)) ? ABSOLUTE(0x12edf0) - ABSOLUTE(.) : 0;
    *ctrport.dir/source/ctr_open_files.o(.text.trackedDirOpen)
    . += (ABSOLUTE(.) < ABSOLUTE(0x12f030)) ? ABSOLUTE(0x12f030) - ABSOLUTE(.) : 0;
    *ctrport.dir/source/ctr_open_files.o(.text.trackedOpen)
    . += (ABSOLUTE(.) < ABSOLUTE(0x12f260)) ? ABSOLUTE(0x12f260) - ABSOLUTE(.) : 0;
    *ctrport.dir/source/ctr_png.o(.text.nextIdat)
    . += (ABSOLUTE(.) < ABSOLUTE(0x12f340)) ? ABSOLUTE(0x12f340) - ABSOLUTE(.) : 0;
    *ctrport.dir/source/ctr_png.o(.text.nextInput)
    . += (ABSOLUTE(.) < ABSOLUTE(0x12f36c)) ? ABSOLUTE(0x12f36c) - ABSOLUTE(.) : 0;
    *ctrport.dir/source/ctr_png.o(.text.takeOutput)
    . += (ABSOLUTE(.) < ABSOLUTE(0x12f6f0)) ? ABSOLUTE(0x12f6f0) - ABSOLUTE(.) : 0;
    *ctrport.dir/source/ctr_png.o(.text.CtrPng_info)
    . += (ABSOLUTE(.) < ABSOLUTE(0x12f7e8)) ? ABSOLUTE(0x12f7e8) - ABSOLUTE(.) : 0;
    *ctrport.dir/source/ctr_png.o(.text.CtrPng_decode)
    . += (ABSOLUTE(.) < ABSOLUTE(0x12fab0)) ? ABSOLUTE(0x12fab0) - ABSOLUTE(.) : 0;
    *ctrport.dir/source/ctr_png.o(.text.CtrPng_takeInflateNanos)
    . += (ABSOLUTE(.) < ABSOLUTE(0x12fae4)) ? ABSOLUTE(0x12fae4) - ABSOLUTE(.) : 0;
    *ctrport.dir/source/ctr_qoi.o(.text.bz2HeaderSize)
    . += (ABSOLUTE(.) < ABSOLUTE(0x12fbc8)) ? ABSOLUTE(0x12fbc8) - ABSOLUTE(.) : 0;
    *ctrport.dir/source/ctr_qoi.o(.text.fill)
    . += (ABSOLUTE(.) < ABSOLUTE(0x12fcf8)) ? ABSOLUTE(0x12fcf8) - ABSOLUTE(.) : 0;
    *ctrport.dir/source/ctr_qoi.o(.text.decodePixels)
    . += (ABSOLUTE(.) < ABSOLUTE(0x130380)) ? ABSOLUTE(0x130380) - ABSOLUTE(.) : 0;
    *ctrport.dir/source/ctr_qoi.o(.text.CtrQoi_info.part.0)
    . += (ABSOLUTE(.) < ABSOLUTE(0x1304b0)) ? ABSOLUTE(0x1304b0) - ABSOLUTE(.) : 0;
    *ctrport.dir/source/ctr_qoi.o(.text.CtrQoi_info)
    . += (ABSOLUTE(.) < ABSOLUTE(0x1304c4)) ? ABSOLUTE(0x1304c4) - ABSOLUTE(.) : 0;
    *ctrport.dir/source/ctr_qoi.o(.text.CtrQoi_init)
    . += (ABSOLUTE(.) < ABSOLUTE(0x1304f4)) ? ABSOLUTE(0x1304f4) - ABSOLUTE(.) : 0;
    *ctrport.dir/source/ctr_qoi.o(.text.CtrQoi_releaseWorkspace)
    . += (ABSOLUTE(.) < ABSOLUTE(0x130530)) ? ABSOLUTE(0x130530) - ABSOLUTE(.) : 0;
    *ctrport.dir/source/ctr_qoi.o(.text.CtrQoi_releaseWorkspaceIfIdle)
    . += (ABSOLUTE(.) < ABSOLUTE(0x1305b8)) ? ABSOLUTE(0x1305b8) - ABSOLUTE(.) : 0;
    *ctrport.dir/source/ctr_qoi.o(.text.CtrQoi_yieldWanted)
    . += (ABSOLUTE(.) < ABSOLUTE(0x1305c8)) ? ABSOLUTE(0x1305c8) - ABSOLUTE(.) : 0;
    *ctrport.dir/source/ctr_qoi.o(.text.CtrQoi_takeInflateNanos)
    . += (ABSOLUTE(.) < ABSOLUTE(0x1305fc)) ? ABSOLUTE(0x1305fc) - ABSOLUTE(.) : 0;
    *ctrport.dir/source/ctr_qoi.o(.text.CtrQoi_decode)
    . += (ABSOLUTE(.) < ABSOLUTE(0x130af4)) ? ABSOLUTE(0x130af4) - ABSOLUTE(.) : 0;
    *ctrport.dir/source/ctr_read_ahead.o(.text.wantsRead)
    . += (ABSOLUTE(.) < ABSOLUTE(0x130bc0)) ? ABSOLUTE(0x130bc0) - ABSOLUTE(.) : 0;
    *ctrport.dir/source/ctr_read_ahead.o(.text.threadMain)
    . += (ABSOLUTE(.) < ABSOLUTE(0x130fa0)) ? ABSOLUTE(0x130fa0) - ABSOLUTE(.) : 0;
    *ctrport.dir/source/ctr_read_ahead.o(.text.CtrReadAhead_init)
    . += (ABSOLUTE(.) < ABSOLUTE(0x1310bc)) ? ABSOLUTE(0x1310bc) - ABSOLUTE(.) : 0;
    *ctrport.dir/source/ctr_read_ahead.o(.text.CtrReadAhead_shutdown)
    . += (ABSOLUTE(.) < ABSOLUTE(0x1311c4)) ? ABSOLUTE(0x1311c4) - ABSOLUTE(.) : 0;
    *ctrport.dir/source/ctr_read_ahead.o(.text.CtrReadAhead_slotBytes)
    . += (ABSOLUTE(.) < ABSOLUTE(0x1311cc)) ? ABSOLUTE(0x1311cc) - ABSOLUTE(.) : 0;
    *ctrport.dir/source/ctr_read_ahead.o(.text.CtrReadAhead_slotCount)
    . += (ABSOLUTE(.) < ABSOLUTE(0x1311d4)) ? ABSOLUTE(0x1311d4) - ABSOLUTE(.) : 0;
    *ctrport.dir/source/ctr_read_ahead.o(.text.CtrReadAhead_attach)
    . += (ABSOLUTE(.) < ABSOLUTE(0x131338)) ? ABSOLUTE(0x131338) - ABSOLUTE(.) : 0;
    *ctrport.dir/source/ctr_read_ahead.o(.text.CtrReadAhead_read)
    . += (ABSOLUTE(.) < ABSOLUTE(0x13159c)) ? ABSOLUTE(0x13159c) - ABSOLUTE(.) : 0;
    *ctrport.dir/source/ctr_read_ahead.o(.text.CtrReadAhead_seek)
    . += (ABSOLUTE(.) < ABSOLUTE(0x131634)) ? ABSOLUTE(0x131634) - ABSOLUTE(.) : 0;
    *ctrport.dir/source/ctr_read_ahead.o(.text.CtrReadAhead_tell)
    . += (ABSOLUTE(.) < ABSOLUTE(0x131660)) ? ABSOLUTE(0x131660) - ABSOLUTE(.) : 0;
    *ctrport.dir/source/ctr_read_ahead.o(.text.CtrReadAhead_detach)
    . += (ABSOLUTE(.) < ABSOLUTE(0x13170c)) ? ABSOLUTE(0x13170c) - ABSOLUTE(.) : 0;
    *ctrport.dir/source/ctr_read_ahead.o(.text.CtrReadAhead_takeStats)
    . += (ABSOLUTE(.) < ABSOLUTE(0x131788)) ? ABSOLUTE(0x131788) - ABSOLUTE(.) : 0;
    *ctrport.dir/source/ctr_renderer.o(.text.visibleWorldRect)
    . += (ABSOLUTE(.) < ABSOLUTE(0x1319b4)) ? ABSOLUTE(0x1319b4) - ABSOLUTE(.) : 0;
    *ctrport.dir/source/ctr_renderer.o(.text.edgeRemap)
    . += (ABSOLUTE(.) < ABSOLUTE(0x131a5c)) ? ABSOLUTE(0x131a5c) - ABSOLUTE(.) : 0;
    *ctrport.dir/source/ctr_renderer.o(.text.prophecyBatches)
    . += (ABSOLUTE(.) < ABSOLUTE(0x131ab8)) ? ABSOLUTE(0x131ab8) - ABSOLUTE(.) : 0;
    *ctrport.dir/source/ctr_renderer.o(.text.worldToPixel)
    . += (ABSOLUTE(.) < ABSOLUTE(0x131b48)) ? ABSOLUTE(0x131b48) - ABSOLUTE(.) : 0;
    *ctrport.dir/source/ctr_renderer.o(.text.clipSpan)
    . += (ABSOLUTE(.) < ABSOLUTE(0x131bd0)) ? ABSOLUTE(0x131bd0) - ABSOLUTE(.) : 0;
    *ctrport.dir/source/ctr_renderer.o(.text.recOpBounds)
    . += (ABSOLUTE(.) < ABSOLUTE(0x131cc0)) ? ABSOLUTE(0x131cc0) - ABSOLUTE(.) : 0;
    *ctrport.dir/source/ctr_renderer.o(.text.mulColor)
    . += (ABSOLUTE(.) < ABSOLUTE(0x131d5c)) ? ABSOLUTE(0x131d5c) - ABSOLUTE(.) : 0;
    *ctrport.dir/source/ctr_renderer.o(.text.solidDrawIsNoop)
    . += (ABSOLUTE(.) < ABSOLUTE(0x131f2c)) ? ABSOLUTE(0x131f2c) - ABSOLUTE(.) : 0;
    HIDDEN(__hotpin_5 = ABSOLUTE(.));
    *ctrport.dir/source/ctr_renderer.o(.text.lerpColor)
    . += (ABSOLUTE(.) < ABSOLUTE(0x13201c)) ? ABSOLUTE(0x13201c) - ABSOLUTE(.) : 0;
    *ctrport.dir/source/ctr_renderer.o(.text.recordedPageSurface)
    . += (ABSOLUTE(.) < ABSOLUTE(0x1320b4)) ? ABSOLUTE(0x1320b4) - ABSOLUTE(.) : 0;
    *ctrport.dir/source/ctr_renderer.o(.text.updateGridMap)
    . += (ABSOLUTE(.) < ABSOLUTE(0x13228c)) ? ABSOLUTE(0x13228c) - ABSOLUTE(.) : 0;
    *ctrport.dir/source/ctr_renderer.o(.text.castleClip)
    . += (ABSOLUTE(.) < ABSOLUTE(0x1323dc)) ? ABSOLUTE(0x1323dc) - ABSOLUTE(.) : 0;
    *ctrport.dir/source/ctr_renderer.o(.text.palDrawFrom)
    . += (ABSOLUTE(.) < ABSOLUTE(0x1325ec)) ? ABSOLUTE(0x1325ec) - ABSOLUTE(.) : 0;
    *ctrport.dir/source/ctr_renderer.o(.text.trackWindowView)
    . += (ABSOLUTE(.) < ABSOLUTE(0x132854)) ? ABSOLUTE(0x132854) - ABSOLUTE(.) : 0;
    *ctrport.dir/source/ctr_renderer.o(.text.linearSurfaceBytes)
    . += (ABSOLUTE(.) < ABSOLUTE(0x1328e0)) ? ABSOLUTE(0x1328e0) - ABSOLUTE(.) : 0;
    *ctrport.dir/source/ctr_renderer.o(.text.ctrSurfaceExists)
    . += (ABSOLUTE(.) < ABSOLUTE(0x132910)) ? ABSOLUTE(0x132910) - ABSOLUTE(.) : 0;
    *ctrport.dir/source/ctr_renderer.o(.text.ctrGetSurfaceWidth)
    . += (ABSOLUTE(.) < ABSOLUTE(0x132958)) ? ABSOLUTE(0x132958) - ABSOLUTE(.) : 0;
    *ctrport.dir/source/ctr_renderer.o(.text.ctrGetSurfaceHeight)
    . += (ABSOLUTE(.) < ABSOLUTE(0x1329a0)) ? ABSOLUTE(0x1329a0) - ABSOLUTE(.) : 0;
    *ctrport.dir/source/ctr_renderer.o(.text.smartTexel)
    . += (ABSOLUTE(.) < ABSOLUTE(0x132b2c)) ? ABSOLUTE(0x132b2c) - ABSOLUTE(.) : 0;
    *ctrport.dir/source/ctr_renderer.o(.text.smartRegionClean)
    . += (ABSOLUTE(.) < ABSOLUTE(0x132ce8)) ? ABSOLUTE(0x132ce8) - ABSOLUTE(.) : 0;
    *ctrport.dir/source/ctr_renderer.o(.text.smartRegionOneColour)
    . += (ABSOLUTE(.) < ABSOLUTE(0x132e7c)) ? ABSOLUTE(0x132e7c) - ABSOLUTE(.) : 0;
    *ctrport.dir/source/ctr_renderer.o(.text.pushPrimitiveVertex)
    . += (ABSOLUTE(.) < ABSOLUTE(0x132f40)) ? ABSOLUTE(0x132f40) - ABSOLUTE(.) : 0;
    *ctrport.dir/source/ctr_renderer.o(.text.ctrPrimitiveBegin)
    . += (ABSOLUTE(.) < ABSOLUTE(0x132f60)) ? ABSOLUTE(0x132f60) - ABSOLUTE(.) : 0;
    *ctrport.dir/source/ctr_renderer.o(.text.ctrPrimitiveBeginTexture)
    . += (ABSOLUTE(.) < ABSOLUTE(0x132f84)) ? ABSOLUTE(0x132f84) - ABSOLUTE(.) : 0;
    *ctrport.dir/source/ctr_renderer.o(.text.towerColumn)
    . += (ABSOLUTE(.) < ABSOLUTE(0x132ff8)) ? ABSOLUTE(0x132ff8) - ABSOLUTE(.) : 0;
    *ctrport.dir/source/ctr_renderer.o(.text.layerTextureReady)
    . += (ABSOLUTE(.) < ABSOLUTE(0x133070)) ? ABSOLUTE(0x133070) - ABSOLUTE(.) : 0;
    *ctrport.dir/source/ctr_renderer.o(.text.vramSurfaceOfSprite)
    . += (ABSOLUTE(.) < ABSOLUTE(0x1330e8)) ? ABSOLUTE(0x1330e8) - ABSOLUTE(.) : 0;
    *ctrport.dir/source/ctr_renderer.o(.text.demotable)
    . += (ABSOLUTE(.) < ABSOLUTE(0x1331d4)) ? ABSOLUTE(0x1331d4) - ABSOLUTE(.) : 0;
    *ctrport.dir/source/ctr_renderer.o(.text.ctrSpriteGetTexture)
    . += (ABSOLUTE(.) < ABSOLUTE(0x133214)) ? ABSOLUTE(0x133214) - ABSOLUTE(.) : 0;
    *ctrport.dir/source/ctr_renderer.o(.text.ctrSurfaceGetTexture)
    . += (ABSOLUTE(.) < ABSOLUTE(0x133250)) ? ABSOLUTE(0x133250) - ABSOLUTE(.) : 0;
    *ctrport.dir/source/ctr_renderer.o(.text.ctrGpuGetBlendFactors)
    . += (ABSOLUTE(.) < ABSOLUTE(0x133268)) ? ABSOLUTE(0x133268) - ABSOLUTE(.) : 0;
    *ctrport.dir/source/ctr_renderer.o(.text.ctrGpuGetBlendMode)
    . += (ABSOLUTE(.) < ABSOLUTE(0x133274)) ? ABSOLUTE(0x133274) - ABSOLUTE(.) : 0;
    *ctrport.dir/source/ctr_renderer.o(.text.ctrGpuGetBlendEnable)
    . += (ABSOLUTE(.) < ABSOLUTE(0x133280)) ? ABSOLUTE(0x133280) - ABSOLUTE(.) : 0;
    *ctrport.dir/source/ctr_renderer.o(.text.ctrGpuGetAlphaTestEnable)
    . += (ABSOLUTE(.) < ABSOLUTE(0x13328c)) ? ABSOLUTE(0x13328c) - ABSOLUTE(.) : 0;
    *ctrport.dir/source/ctr_renderer.o(.text.ctrGpuGetColorWriteEnable)
    . += (ABSOLUTE(.) < ABSOLUTE(0x1332bc)) ? ABSOLUTE(0x1332bc) - ABSOLUTE(.) : 0;
    *ctrport.dir/source/ctr_renderer.o(.text.ctrShaderIsCompiled)
    . += (ABSOLUTE(.) < ABSOLUTE(0x1332c4)) ? ABSOLUTE(0x1332c4) - ABSOLUTE(.) : 0;
    *ctrport.dir/source/ctr_renderer.o(.text.ctrShadersSupported)
    . += (ABSOLUTE(.) < ABSOLUTE(0x1332cc)) ? ABSOLUTE(0x1332cc) - ABSOLUTE(.) : 0;
    *ctrport.dir/source/ctr_renderer.o(.text.compareCounts)
    . += (ABSOLUTE(.) < ABSOLUTE(0x1332f0)) ? ABSOLUTE(0x1332f0) - ABSOLUTE(.) : 0;
    *ctrport.dir/source/ctr_renderer.o(.text.skipRecordable)
    . += (ABSOLUTE(.) < ABSOLUTE(0x1333fc)) ? ABSOLUTE(0x1333fc) - ABSOLUTE(.) : 0;
    *ctrport.dir/source/ctr_renderer.o(.text.dlgRedirecting)
    . += (ABSOLUTE(.) < ABSOLUTE(0x1334bc)) ? ABSOLUTE(0x1334bc) - ABSOLUTE(.) : 0;
    HIDDEN(__hotpin_6 = ABSOLUTE(.));
    *ctrport.dir/source/ctr_renderer.o(.text.recordingSurface)
    . += (ABSOLUTE(.) < ABSOLUTE(0x13355c)) ? ABSOLUTE(0x13355c) - ABSOLUTE(.) : 0;
    *ctrport.dir/source/ctr_renderer.o(.text.probeCompareFloats)
    . += (ABSOLUTE(.) < ABSOLUTE(0x13358c)) ? ABSOLUTE(0x13358c) - ABSOLUTE(.) : 0;
    *ctrport.dir/source/ctr_renderer.o(.text.dropLazy)
    . += (ABSOLUTE(.) < ABSOLUTE(0x13361c)) ? ABSOLUTE(0x13361c) - ABSOLUTE(.) : 0;
    *ctrport.dir/source/ctr_renderer.o(.text.skipRecFree)
    . += (ABSOLUTE(.) < ABSOLUTE(0x1336cc)) ? ABSOLUTE(0x1336cc) - ABSOLUTE(.) : 0;
    *ctrport.dir/source/ctr_renderer.o(.text.flickerProbeWord)
    . += (ABSOLUTE(.) < ABSOLUTE(0x133760)) ? ABSOLUTE(0x133760) - ABSOLUTE(.) : 0;
    *ctrport.dir/source/ctr_renderer.o(.text.probeLogTimes)
    . += (ABSOLUTE(.) < ABSOLUTE(0x133880)) ? ABSOLUTE(0x133880) - ABSOLUTE(.) : 0;
    *ctrport.dir/source/ctr_renderer.o(.text.writeFile)
    . += (ABSOLUTE(.) < ABSOLUTE(0x1339ac)) ? ABSOLUTE(0x1339ac) - ABSOLUTE(.) : 0;
    *ctrport.dir/source/ctr_renderer.o(.text.smartTally)
    . += (ABSOLUTE(.) < ABSOLUTE(0x133bc0)) ? ABSOLUTE(0x133bc0) - ABSOLUTE(.) : 0;
    *ctrport.dir/source/ctr_renderer.o(.text.pushRecOp)
    . += (ABSOLUTE(.) < ABSOLUTE(0x133c78)) ? ABSOLUTE(0x133c78) - ABSOLUTE(.) : 0;
    *ctrport.dir/source/ctr_renderer.o(.text.deleteSpareTextures)
    . += (ABSOLUTE(.) < ABSOLUTE(0x133d04)) ? ABSOLUTE(0x133d04) - ABSOLUTE(.) : 0;
    *ctrport.dir/source/ctr_renderer.o(.text.processDeferredFrees)
    . += (ABSOLUTE(.) < ABSOLUTE(0x133f4c)) ? ABSOLUTE(0x133f4c) - ABSOLUTE(.) : 0;
    HIDDEN(__hotpin_7 = ABSOLUTE(.));
    *ctrport.dir/source/ctr_renderer.o(.text.nativeSpans)
    . += (ABSOLUTE(.) < ABSOLUTE(0x134068)) ? ABSOLUTE(0x134068) - ABSOLUTE(.) : 0;
    *ctrport.dir/source/ctr_renderer.o(.text.fullSpans)
    . += (ABSOLUTE(.) < ABSOLUTE(0x134228)) ? ABSOLUTE(0x134228) - ABSOLUTE(.) : 0;
    *ctrport.dir/source/ctr_renderer.o(.text.putDrawArrays)
    . += (ABSOLUTE(.) < ABSOLUTE(0x1342f0)) ? ABSOLUTE(0x1342f0) - ABSOLUTE(.) : 0;
    *ctrport.dir/source/ctr_renderer.o(.text.skipRecData)
    . += (ABSOLUTE(.) < ABSOLUTE(0x1343d4)) ? ABSOLUTE(0x1343d4) - ABSOLUTE(.) : 0;
    *ctrport.dir/source/ctr_renderer.o(.text.applyBottomBacklight)
    . += (ABSOLUTE(.) < ABSOLUTE(0x1344d4)) ? ABSOLUTE(0x1344d4) - ABSOLUTE(.) : 0;
    *ctrport.dir/source/ctr_renderer.o(.text.mirrorTestCount)
    . += (ABSOLUTE(.) < ABSOLUTE(0x134578)) ? ABSOLUTE(0x134578) - ABSOLUTE(.) : 0;
    *ctrport.dir/source/ctr_renderer.o(.text.alphaCutStages)
    . += (ABSOLUTE(.) < ABSOLUTE(0x134600)) ? ABSOLUTE(0x134600) - ABSOLUTE(.) : 0;
    HIDDEN(__hotpin_8 = ABSOLUTE(.));
    *ctrport.dir/source/ctr_renderer.o(.text.setBlendFunc)
    . += (ABSOLUTE(.) < ABSOLUTE(0x1346f8)) ? ABSOLUTE(0x1346f8) - ABSOLUTE(.) : 0;
    *ctrport.dir/source/ctr_renderer.o(.text.applyBlend)
    . += (ABSOLUTE(.) < ABSOLUTE(0x1347c4)) ? ABSOLUTE(0x1347c4) - ABSOLUTE(.) : 0;
    *ctrport.dir/source/ctr_renderer.o(.text.shoujoBase)
    . += (ABSOLUTE(.) < ABSOLUTE(0x134920)) ? ABSOLUTE(0x134920) - ABSOLUTE(.) : 0;
    *ctrport.dir/source/ctr_renderer.o(.text.convertSurfaceTexels)
    . += (ABSOLUTE(.) < ABSOLUTE(0x134d30)) ? ABSOLUTE(0x134d30) - ABSOLUTE(.) : 0;
    *ctrport.dir/source/ctr_renderer.o(.text.logVramCensus)
    . += (ABSOLUTE(.) < ABSOLUTE(0x135194)) ? ABSOLUTE(0x135194) - ABSOLUTE(.) : 0;
    *ctrport.dir/source/ctr_renderer.o(.text.depthDisparity)
    . += (ABSOLUTE(.) < ABSOLUTE(0x13526c)) ? ABSOLUTE(0x13526c) - ABSOLUTE(.) : 0;
    *ctrport.dir/source/ctr_renderer.o(.text.leaveWideMode)
    . += (ABSOLUTE(.) < ABSOLUTE(0x135354)) ? ABSOLUTE(0x135354) - ABSOLUTE(.) : 0;
    *ctrport.dir/source/ctr_renderer.o(.text.onAptEvent)
    . += (ABSOLUTE(.) < ABSOLUTE(0x1353a8)) ? ABSOLUTE(0x1353a8) - ABSOLUTE(.) : 0;
    *ctrport.dir/source/ctr_renderer.o(.text.transparentDrawIsNoop)
    . += (ABSOLUTE(.) < ABSOLUTE(0x135430)) ? ABSOLUTE(0x135430) - ABSOLUTE(.) : 0;
    *ctrport.dir/source/ctr_renderer.o(.text.nativeSizeFor)
    . += (ABSOLUTE(.) < ABSOLUTE(0x1354d0)) ? ABSOLUTE(0x1354d0) - ABSOLUTE(.) : 0;
    *ctrport.dir/source/ctr_renderer.o(.text.noteAppRead)
    . += (ABSOLUTE(.) < ABSOLUTE(0x13555c)) ? ABSOLUTE(0x13555c) - ABSOLUTE(.) : 0;
    *ctrport.dir/source/ctr_renderer.o(.text.ctrEndFrameInit)
    . += (ABSOLUTE(.) < ABSOLUTE(0x1355a4)) ? ABSOLUTE(0x1355a4) - ABSOLUTE(.) : 0;
    *ctrport.dir/source/ctr_renderer.o(.text.releaseShrink.part.0)
    . += (ABSOLUTE(.) < ABSOLUTE(0x135650)) ? ABSOLUTE(0x135650) - ABSOLUTE(.) : 0;
    *ctrport.dir/source/ctr_renderer.o(.text.logNoVramOnce)
    . += (ABSOLUTE(.) < ABSOLUTE(0x13573c)) ? ABSOLUTE(0x13573c) - ABSOLUTE(.) : 0;
    *ctrport.dir/source/ctr_renderer.o(.text.videoStage)
    . += (ABSOLUTE(.) < ABSOLUTE(0x1357c8)) ? ABSOLUTE(0x1357c8) - ABSOLUTE(.) : 0;
    HIDDEN(__hotpin_9 = ABSOLUTE(.));
    *ctrport.dir/source/ctr_renderer.o(.text.smartTexelSide.part.0)
    . += (ABSOLUTE(.) < ABSOLUTE(0x135868)) ? ABSOLUTE(0x135868) - ABSOLUTE(.) : 0;
    HIDDEN(__hotpin_10 = ABSOLUTE(.));
    *ctrport.dir/source/ctr_renderer.o(.text.quadOutsideView.part.0)
    . += (ABSOLUTE(.) < ABSOLUTE(0x135a20)) ? ABSOLUTE(0x135a20) - ABSOLUTE(.) : 0;
    *ctrport.dir/source/ctr_renderer.o(.text.createScreenTarget.constprop.0)
    . += (ABSOLUTE(.) < ABSOLUTE(0x135aa4)) ? ABSOLUTE(0x135aa4) - ABSOLUTE(.) : 0;
    *ctrport.dir/source/ctr_renderer.o(.text.configureScreens)
    . += (ABSOLUTE(.) < ABSOLUTE(0x135db8)) ? ABSOLUTE(0x135db8) - ABSOLUTE(.) : 0;
    *ctrport.dir/source/ctr_renderer.o(.text.placeWindow.constprop.0)
    . += (ABSOLUTE(.) < ABSOLUTE(0x135f04)) ? ABSOLUTE(0x135f04) - ABSOLUTE(.) : 0;
    *ctrport.dir/source/ctr_renderer.o(.text.towerRun.constprop.0)
    . += (ABSOLUTE(.) < ABSOLUTE(0x13601c)) ? ABSOLUTE(0x13601c) - ABSOLUTE(.) : 0;
    *ctrport.dir/source/ctr_renderer.o(.text.takeGap.constprop.0)
    . += (ABSOLUTE(.) < ABSOLUTE(0x1360c4)) ? ABSOLUTE(0x1360c4) - ABSOLUTE(.) : 0;
    *ctrport.dir/source/ctr_renderer.o(.text.demotionCanFit.constprop.0)
    . += (ABSOLUTE(.) < ABSOLUTE(0x136268)) ? ABSOLUTE(0x136268) - ABSOLUTE(.) : 0;
    HIDDEN(__hotpin_11 = ABSOLUTE(.));
    *ctrport.dir/source/ctr_renderer.o(.text.smartNote.constprop.0)
    . += (ABSOLUTE(.) < ABSOLUTE(0x136650)) ? ABSOLUTE(0x136650) - ABSOLUTE(.) : 0;
    *ctrport.dir/source/ctr_renderer.o(.text.palPageTexel)
    . += (ABSOLUTE(.) < ABSOLUTE(0x1368d4)) ? ABSOLUTE(0x1368d4) - ABSOLUTE(.) : 0;
    *ctrport.dir/source/ctr_renderer.o(.text.skipNoteUnrecordable)
    . += (ABSOLUTE(.) < ABSOLUTE(0x136a28)) ? ABSOLUTE(0x136a28) - ABSOLUTE(.) : 0;
    *ctrport.dir/source/ctr_renderer.o(.text.layerTexGen.isra.0)
    . += (ABSOLUTE(.) < ABSOLUTE(0x136bdc)) ? ABSOLUTE(0x136bdc) - ABSOLUTE(.) : 0;
    *ctrport.dir/source/ctr_renderer.o(.text.claimScratch.isra.0)
    . += (ABSOLUTE(.) < ABSOLUTE(0x136c60)) ? ABSOLUTE(0x136c60) - ABSOLUTE(.) : 0;
    *ctrport.dir/source/ctr_renderer.o(.text.putDrawQuads.isra.0)
    . += (ABSOLUTE(.) < ABSOLUTE(0x136d78)) ? ABSOLUTE(0x136d78) - ABSOLUTE(.) : 0;
    *ctrport.dir/source/ctr_renderer.o(.text.ctrEndFrameEnd)
    . += (ABSOLUTE(.) < ABSOLUTE(0x136d7c)) ? ABSOLUTE(0x136d7c) - ABSOLUTE(.) : 0;
    *ctrport.dir/source/ctr_renderer.o(.text.flickerProbeFinish)
    . += (ABSOLUTE(.) < ABSOLUTE(0x137698)) ? ABSOLUTE(0x137698) - ABSOLUTE(.) : 0;
    *ctrport.dir/source/ctr_renderer.o(.text.flickerProbeRead)
    . += (ABSOLUTE(.) < ABSOLUTE(0x13788c)) ? ABSOLUTE(0x13788c) - ABSOLUTE(.) : 0;
    *ctrport.dir/source/ctr_renderer.o(.text.waitWithScreenshotNotice.constprop.0)
    . += (ABSOLUTE(.) < ABSOLUTE(0x137bc4)) ? ABSOLUTE(0x137bc4) - ABSOLUTE(.) : 0;
    *ctrport.dir/source/ctr_renderer.o(.text.skipRecUnref)
    . += (ABSOLUTE(.) < ABSOLUTE(0x137d04)) ? ABSOLUTE(0x137d04) - ABSOLUTE(.) : 0;
    *ctrport.dir/source/ctr_renderer.o(.text.surfacePixelProjection)
    . += (ABSOLUTE(.) < ABSOLUTE(0x137e24)) ? ABSOLUTE(0x137e24) - ABSOLUTE(.) : 0;
    *ctrport.dir/source/ctr_renderer.o(.text.skipRecNew)
    . += (ABSOLUTE(.) < ABSOLUTE(0x137f44)) ? ABSOLUTE(0x137f44) - ABSOLUTE(.) : 0;
    *ctrport.dir/source/ctr_renderer.o(.text.shaderFxFor.part.0)
    . += (ABSOLUTE(.) < ABSOLUTE(0x137fe0)) ? ABSOLUTE(0x137fe0) - ABSOLUTE(.) : 0;
    *ctrport.dir/source/ctr_renderer.o(.text.palKindFor.part.0)
    . += (ABSOLUTE(.) < ABSOLUTE(0x1380e4)) ? ABSOLUTE(0x1380e4) - ABSOLUTE(.) : 0;
    *ctrport.dir/source/ctr_renderer.o(.text.ctrShaderGetSamplerIndex)
    . += (ABSOLUTE(.) < ABSOLUTE(0x13829c)) ? ABSOLUTE(0x13829c) - ABSOLUTE(.) : 0;
    *ctrport.dir/source/ctr_renderer.o(.text.ctrShaderGetUniform)
    . += (ABSOLUTE(.) < ABSOLUTE(0x1383bc)) ? ABSOLUTE(0x1383bc) - ABSOLUTE(.) : 0;
    HIDDEN(__hotpin_12 = ABSOLUTE(.));
    *ctrport.dir/source/ctr_renderer.o(.text.fontReach)
    . += (ABSOLUTE(.) < ABSOLUTE(0x138660)) ? ABSOLUTE(0x138660) - ABSOLUTE(.) : 0;
    *ctrport.dir/source/ctr_renderer.o(.text.allocBmp)
    . += (ABSOLUTE(.) < ABSOLUTE(0x138734)) ? ABSOLUTE(0x138734) - ABSOLUTE(.) : 0;
    *ctrport.dir/source/ctr_renderer.o(.text.saveScreenScreenshot)
    . += (ABSOLUTE(.) < ABSOLUTE(0x138a8c)) ? ABSOLUTE(0x138a8c) - ABSOLUTE(.) : 0;
    *ctrport.dir/source/ctr_renderer.o(.text.saveScreenScreenshots)
    . += (ABSOLUTE(.) < ABSOLUTE(0x138b20)) ? ABSOLUTE(0x138b20) - ABSOLUTE(.) : 0;
    *ctrport.dir/source/ctr_renderer.o(.text.initSurfaceTex)
    . += (ABSOLUTE(.) < ABSOLUTE(0x138c08)) ? ABSOLUTE(0x138c08) - ABSOLUTE(.) : 0;
    *ctrport.dir/source/ctr_renderer.o(.text.initLinearTexture)
    . += (ABSOLUTE(.) < ABSOLUTE(0x138ed8)) ? ABSOLUTE(0x138ed8) - ABSOLUTE(.) : 0;
    HIDDEN(__hotpin_13 = ABSOLUTE(.));
    *ctrport.dir/source/ctr_renderer.o(.text.Renderer_applyProjection)
    . += (ABSOLUTE(.) < ABSOLUTE(0x139128)) ? ABSOLUTE(0x139128) - ABSOLUTE(.) : 0;
    *ctrport.dir/source/ctr_renderer.o(.text.recordParked)
    . += (ABSOLUTE(.) < ABSOLUTE(0x139250)) ? ABSOLUTE(0x139250) - ABSOLUTE(.) : 0;
    *ctrport.dir/source/ctr_renderer.o(.text.fxColor)
    . += (ABSOLUTE(.) < ABSOLUTE(0x139378)) ? ABSOLUTE(0x139378) - ABSOLUTE(.) : 0;
    *ctrport.dir/source/ctr_renderer.o(.text.skipNoteReplay)
    . += (ABSOLUTE(.) < ABSOLUTE(0x139560)) ? ABSOLUTE(0x139560) - ABSOLUTE(.) : 0;
    *ctrport.dir/source/ctr_renderer.o(.text.towerShade.isra.0)
    . += (ABSOLUTE(.) < ABSOLUTE(0x1396f4)) ? ABSOLUTE(0x1396f4) - ABSOLUTE(.) : 0;
    *ctrport.dir/source/ctr_renderer.o(.text.palAllocTex)
    . += (ABSOLUTE(.) < ABSOLUTE(0x139914)) ? ABSOLUTE(0x139914) - ABSOLUTE(.) : 0;
    *ctrport.dir/source/ctr_renderer.o(.text.quadPoint)
    . += (ABSOLUTE(.) < ABSOLUTE(0x139a34)) ? ABSOLUTE(0x139a34) - ABSOLUTE(.) : 0;
    HIDDEN(__hotpin_14 = ABSOLUTE(.));
    *ctrport.dir/source/ctr_renderer.o(.text.uploadProjection)
    . += (ABSOLUTE(.) < ABSOLUTE(0x139fc8)) ? ABSOLUTE(0x139fc8) - ABSOLUTE(.) : 0;
    HIDDEN(__hotpin_15 = ABSOLUTE(.));
    *ctrport.dir/source/ctr_renderer.o(.text.applyEyeViewport)
    . += (ABSOLUTE(.) < ABSOLUTE(0x13a598)) ? ABSOLUTE(0x13a598) - ABSOLUTE(.) : 0;
    *ctrport.dir/source/ctr_renderer.o(.text.screenProjection)
    . += (ABSOLUTE(.) < ABSOLUTE(0x13a618)) ? ABSOLUTE(0x13a618) - ABSOLUTE(.) : 0;
    *ctrport.dir/source/ctr_renderer.o(.text.tryVramTarget)
    . += (ABSOLUTE(.) < ABSOLUTE(0x13a728)) ? ABSOLUTE(0x13a728) - ABSOLUTE(.) : 0;
    *ctrport.dir/source/ctr_renderer.o(.text.skipRectOutsideView)
    . += (ABSOLUTE(.) < ABSOLUTE(0x13a874)) ? ABSOLUTE(0x13a874) - ABSOLUTE(.) : 0;
    *ctrport.dir/source/ctr_renderer.o(.text.palWeightNow)
    . += (ABSOLUTE(.) < ABSOLUTE(0x13a9ac)) ? ABSOLUTE(0x13a9ac) - ABSOLUTE(.) : 0;
    *ctrport.dir/source/ctr_renderer.o(.text.depthmapCut)
    . += (ABSOLUTE(.) < ABSOLUTE(0x13aae8)) ? ABSOLUTE(0x13aae8) - ABSOLUTE(.) : 0;
    *ctrport.dir/source/ctr_renderer.o(.text.drawBothEyes)
    . += (ABSOLUTE(.) < ABSOLUTE(0x13ad40)) ? ABSOLUTE(0x13ad40) - ABSOLUTE(.) : 0;
    *ctrport.dir/source/ctr_renderer.o(.text.itemVerdict)
    . += (ABSOLUTE(.) < ABSOLUTE(0x13b5d4)) ? ABSOLUTE(0x13b5d4) - ABSOLUTE(.) : 0;
    HIDDEN(__hotpin_16 = ABSOLUTE(.));
    *ctrport.dir/source/ctr_renderer.o(.text.gridSnapQuad.part.0)
    . += (ABSOLUTE(.) < ABSOLUTE(0x13b984)) ? ABSOLUTE(0x13b984) - ABSOLUTE(.) : 0;
    HIDDEN(__hotpin_17 = ABSOLUTE(.));
    *ctrport.dir/source/ctr_renderer.o(.text.smartSpriteFine.part.0)
    . += (ABSOLUTE(.) < ABSOLUTE(0x13c29c)) ? ABSOLUTE(0x13c29c) - ABSOLUTE(.) : 0;
    *ctrport.dir/source/ctr_renderer.o(.text.flushVertexCache)
    . += (ABSOLUTE(.) < ABSOLUTE(0x13c354)) ? ABSOLUTE(0x13c354) - ABSOLUTE(.) : 0;
    *ctrport.dir/source/ctr_renderer.o(.text.chromaKeyOpaque)
    . += (ABSOLUTE(.) < ABSOLUTE(0x13c484)) ? ABSOLUTE(0x13c484) - ABSOLUTE(.) : 0;
    *ctrport.dir/source/ctr_renderer.o(.text.recordQuad)
    . += (ABSOLUTE(.) < ABSOLUTE(0x13c68c)) ? ABSOLUTE(0x13c68c) - ABSOLUTE(.) : 0;
    *ctrport.dir/source/ctr_renderer.o(.text.endFrameEarly)
    . += (ABSOLUTE(.) < ABSOLUTE(0x13c788)) ? ABSOLUTE(0x13c788) - ABSOLUTE(.) : 0;
    *ctrport.dir/source/ctr_renderer.o(.text.probeGarbage)
    . += (ABSOLUTE(.) < ABSOLUTE(0x13c86c)) ? ABSOLUTE(0x13c86c) - ABSOLUTE(.) : 0;
    *ctrport.dir/source/ctr_renderer.o(.text.palRecolour)
    . += (ABSOLUTE(.) < ABSOLUTE(0x13cc58)) ? ABSOLUTE(0x13cc58) - ABSOLUTE(.) : 0;
    *ctrport.dir/source/ctr_renderer.o(.text.ctrRectOutsideView)
    . += (ABSOLUTE(.) < ABSOLUTE(0x13cd28)) ? ABSOLUTE(0x13cd28) - ABSOLUTE(.) : 0;
    *ctrport.dir/source/ctr_renderer.o(.text.towerUniforms)
    . += (ABSOLUTE(.) < ABSOLUTE(0x13cfdc)) ? ABSOLUTE(0x13cfdc) - ABSOLUTE(.) : 0;
    *ctrport.dir/source/ctr_renderer.o(.text.palReadyCopy)
    . += (ABSOLUTE(.) < ABSOLUTE(0x13d480)) ? ABSOLUTE(0x13d480) - ABSOLUTE(.) : 0;
    *ctrport.dir/source/ctr_renderer.o(.text.ctrInit)
    . += (ABSOLUTE(.) < ABSOLUTE(0x13de34)) ? ABSOLUTE(0x13de34) - ABSOLUTE(.) : 0;
    *ctrport.dir/source/ctr_renderer.o(.text.drawHologramBatch)
    . += (ABSOLUTE(.) < ABSOLUTE(0x13eba8)) ? ABSOLUTE(0x13eba8) - ABSOLUTE(.) : 0;
    *ctrport.dir/source/ctr_renderer.o(.text.applyTexEnv)
    . += (ABSOLUTE(.) < ABSOLUTE(0x14026c)) ? ABSOLUTE(0x14026c) - ABSOLUTE(.) : 0;
    *ctrport.dir/source/ctr_renderer.o(.text.materializeState)
    . += (ABSOLUTE(.) < ABSOLUTE(0x140470)) ? ABSOLUTE(0x140470) - ABSOLUTE(.) : 0;
    *ctrport.dir/source/ctr_renderer.o(.text.copyState)
    . += (ABSOLUTE(.) < ABSOLUTE(0x1404f4)) ? ABSOLUTE(0x1404f4) - ABSOLUTE(.) : 0;
    *ctrport.dir/source/ctr_renderer.o(.text.applyAllState)
    . += (ABSOLUTE(.) < ABSOLUTE(0x140650)) ? ABSOLUTE(0x140650) - ABSOLUTE(.) : 0;
    *ctrport.dir/source/ctr_renderer.o(.text.resumeFrame)
    . += (ABSOLUTE(.) < ABSOLUTE(0x1406f8)) ? ABSOLUTE(0x1406f8) - ABSOLUTE(.) : 0;
    HIDDEN(__hotpin_18 = ABSOLUTE(.));
    *ctrport.dir/source/ctr_renderer.o(.text.replayRecorded)
    . += (ABSOLUTE(.) < ABSOLUTE(0x141638)) ? ABSOLUTE(0x141638) - ABSOLUTE(.) : 0;
    *ctrport.dir/source/ctr_renderer.o(.text.drawSurfaceQuad)
    . += (ABSOLUTE(.) < ABSOLUTE(0x142f80)) ? ABSOLUTE(0x142f80) - ABSOLUTE(.) : 0;
    *ctrport.dir/source/ctr_renderer.o(.text.drawSurfaceImpl)
    . += (ABSOLUTE(.) < ABSOLUTE(0x145d5c)) ? ABSOLUTE(0x145d5c) - ABSOLUTE(.) : 0;
    *ctrport.dir/source/ctr_renderer.o(.text.ctrDrawSurface)
    . += (ABSOLUTE(.) < ABSOLUTE(0x145e0c)) ? ABSOLUTE(0x145e0c) - ABSOLUTE(.) : 0;
    *ctrport.dir/source/ctr_renderer.o(.text.ctrDrawSurfaceColor)
    . += (ABSOLUTE(.) < ABSOLUTE(0x145f2c)) ? ABSOLUTE(0x145f2c) - ABSOLUTE(.) : 0;
    *ctrport.dir/source/ctr_renderer.o(.text.ctrDrawSurfaceTiled)
    . += (ABSOLUTE(.) < ABSOLUTE(0x146208)) ? ABSOLUTE(0x146208) - ABSOLUTE(.) : 0;
    *ctrport.dir/source/ctr_renderer.o(.text.skipReplayOps)
    . += (ABSOLUTE(.) < ABSOLUTE(0x146b1c)) ? ABSOLUTE(0x146b1c) - ABSOLUTE(.) : 0;
    *ctrport.dir/source/ctr_renderer.o(.text.skipReplayInto)
    . += (ABSOLUTE(.) < ABSOLUTE(0x146f00)) ? ABSOLUTE(0x146f00) - ABSOLUTE(.) : 0;
    *ctrport.dir/source/ctr_renderer.o(.text.skipSync)
    . += (ABSOLUTE(.) < ABSOLUTE(0x147110)) ? ABSOLUTE(0x147110) - ABSOLUTE(.) : 0;
    *ctrport.dir/source/ctr_renderer.o(.text.skipSettle)
    . += (ABSOLUTE(.) < ABSOLUTE(0x14727c)) ? ABSOLUTE(0x14727c) - ABSOLUTE(.) : 0;
    *ctrport.dir/source/ctr_renderer.o(.text.skipResolveRealRefs)
    . += (ABSOLUTE(.) < ABSOLUTE(0x147430)) ? ABSOLUTE(0x147430) - ABSOLUTE(.) : 0;
    *ctrport.dir/source/ctr_renderer.o(.text.clearBoundTarget)
    . += (ABSOLUTE(.) < ABSOLUTE(0x147a18)) ? ABSOLUTE(0x147a18) - ABSOLUTE(.) : 0;
    *ctrport.dir/source/ctr_renderer.o(.text.bindSurface)
    . += (ABSOLUTE(.) < ABSOLUTE(0x147de0)) ? ABSOLUTE(0x147de0) - ABSOLUTE(.) : 0;
    *ctrport.dir/source/ctr_renderer.o(.text.materializeRecorded)
    . += (ABSOLUTE(.) < ABSOLUTE(0x1485d8)) ? ABSOLUTE(0x1485d8) - ABSOLUTE(.) : 0;
    *ctrport.dir/source/ctr_renderer.o(.text.drawTowerStrips)
    . += (ABSOLUTE(.) < ABSOLUTE(0x14a848)) ? ABSOLUTE(0x14a848) - ABSOLUTE(.) : 0;
    *ctrport.dir/source/ctr_renderer.o(.text.flushLazy)
    . += (ABSOLUTE(.) < ABSOLUTE(0x14ade8)) ? ABSOLUTE(0x14ade8) - ABSOLUTE(.) : 0;
    *ctrport.dir/source/ctr_renderer.o(.text.flushLazyUsing)
    . += (ABSOLUTE(.) < ABSOLUTE(0x14aedc)) ? ABSOLUTE(0x14aedc) - ABSOLUTE(.) : 0;
    *ctrport.dir/source/ctr_renderer.o(.text.deferSurfaceFree)
    . += (ABSOLUTE(.) < ABSOLUTE(0x14b388)) ? ABSOLUTE(0x14b388) - ABSOLUTE(.) : 0;
    *ctrport.dir/source/ctr_renderer.o(.text.surfaceTexture)
    . += (ABSOLUTE(.) < ABSOLUTE(0x14b638)) ? ABSOLUTE(0x14b638) - ABSOLUTE(.) : 0;
    *ctrport.dir/source/ctr_renderer.o(.text.surfaceSpritePage)
    . += (ABSOLUTE(.) < ABSOLUTE(0x14b788)) ? ABSOLUTE(0x14b788) - ABSOLUTE(.) : 0;
    HIDDEN(__hotpin_19 = ABSOLUTE(.));
    *ctrport.dir/source/ctr_renderer.o(.text.acquireTpagPage)
    . += (ABSOLUTE(.) < ABSOLUTE(0x14b7fc)) ? ABSOLUTE(0x14b7fc) - ABSOLUTE(.) : 0;
    *ctrport.dir/source/ctr_renderer.o(.text.drawTexScrollBatch)
    . += (ABSOLUTE(.) < ABSOLUTE(0x14c0a4)) ? ABSOLUTE(0x14c0a4) - ABSOLUTE(.) : 0;
    *ctrport.dir/source/ctr_renderer.o(.text.palBuildTable)
    . += (ABSOLUTE(.) < ABSOLUTE(0x14d778)) ? ABSOLUTE(0x14d778) - ABSOLUTE(.) : 0;
    *ctrport.dir/source/ctr_renderer.o(.text.palPlanFor)
    . += (ABSOLUTE(.) < ABSOLUTE(0x14d9a8)) ? ABSOLUTE(0x14d9a8) - ABSOLUTE(.) : 0;
    *ctrport.dir/source/ctr_renderer.o(.text.palTileTexSlow)
    . += (ABSOLUTE(.) < ABSOLUTE(0x151298)) ? ABSOLUTE(0x151298) - ABSOLUTE(.) : 0;
    *ctrport.dir/source/ctr_renderer.o(.text.drawProphecyBatch)
    . += (ABSOLUTE(.) < ABSOLUTE(0x151a84)) ? ABSOLUTE(0x151a84) - ABSOLUTE(.) : 0;
    *ctrport.dir/source/ctr_renderer.o(.text.drawShoujoBatch)
    . += (ABSOLUTE(.) < ABSOLUTE(0x15231c)) ? ABSOLUTE(0x15231c) - ABSOLUTE(.) : 0;
    HIDDEN(__hotpin_20 = ABSOLUTE(.));
    *ctrport.dir/source/ctr_renderer.o(.text.flushBatch)
    . += (ABSOLUTE(.) < ABSOLUTE(0x155258)) ? ABSOLUTE(0x155258) - ABSOLUTE(.) : 0;
    *ctrport.dir/source/ctr_renderer.o(.text.addHoldDraw)
    . += (ABSOLUTE(.) < ABSOLUTE(0x155320)) ? ABSOLUTE(0x155320) - ABSOLUTE(.) : 0;
    *ctrport.dir/source/ctr_renderer.o(.text.allocSurfaceSlot)
    . += (ABSOLUTE(.) < ABSOLUTE(0x155404)) ? ABSOLUTE(0x155404) - ABSOLUTE(.) : 0;
    *ctrport.dir/source/ctr_renderer.o(.text.initRequiredLinearTexture)
    . += (ABSOLUTE(.) < ABSOLUTE(0x155598)) ? ABSOLUTE(0x155598) - ABSOLUTE(.) : 0;
    *ctrport.dir/source/ctr_renderer.o(.text.unparkSurface)
    . += (ABSOLUTE(.) < ABSOLUTE(0x1558e8)) ? ABSOLUTE(0x1558e8) - ABSOLUTE(.) : 0;
    *ctrport.dir/source/ctr_renderer.o(.text.touchSurface)
    . += (ABSOLUTE(.) < ABSOLUTE(0x155a84)) ? ABSOLUTE(0x155a84) - ABSOLUTE(.) : 0;
    *ctrport.dir/source/ctr_renderer.o(.text.addHoldClose)
    . += (ABSOLUTE(.) < ABSOLUTE(0x155b54)) ? ABSOLUTE(0x155b54) - ABSOLUTE(.) : 0;
    *ctrport.dir/source/ctr_renderer.o(.text.smartLinearBegin)
    . += (ABSOLUTE(.) < ABSOLUTE(0x155c18)) ? ABSOLUTE(0x155c18) - ABSOLUTE(.) : 0;
    *ctrport.dir/source/ctr_renderer.o(.text.smartLinearEnd)
    . += (ABSOLUTE(.) < ABSOLUTE(0x155d28)) ? ABSOLUTE(0x155d28) - ABSOLUTE(.) : 0;
    *ctrport.dir/source/ctr_renderer.o(.text.setProjectionFromEngine)
    . += (ABSOLUTE(.) < ABSOLUTE(0x155ed4)) ? ABSOLUTE(0x155ed4) - ABSOLUTE(.) : 0;
    *ctrport.dir/source/ctr_renderer.o(.text.ctrSetMatrix)
    *ctrport.dir/source/ctr_renderer.o(.text.setGuiCamera)
    *ctrport.dir/source/ctr_renderer.o(.text.ctrSetGuiProjection)
    *ctrport.dir/source/ctr_renderer.o(.text.restoreState)
    . += (ABSOLUTE(.) < ABSOLUTE(0x156438)) ? ABSOLUTE(0x156438) - ABSOLUTE(.) : 0;
    *ctrport.dir/source/ctr_renderer.o(.text.relocateVram.part.0)
    . += (ABSOLUTE(.) < ABSOLUTE(0x156d78)) ? ABSOLUTE(0x156d78) - ABSOLUTE(.) : 0;
    *ctrport.dir/source/ctr_renderer.o(.text.yieldMirrors)
    . += (ABSOLUTE(.) < ABSOLUTE(0x156eec)) ? ABSOLUTE(0x156eec) - ABSOLUTE(.) : 0;
    *ctrport.dir/source/ctr_renderer.o(.text.initVramTarget)
    . += (ABSOLUTE(.) < ABSOLUTE(0x156f74)) ? ABSOLUTE(0x156f74) - ABSOLUTE(.) : 0;
    *ctrport.dir/source/ctr_renderer.o(.text.probeSurface.isra.0)
    . += (ABSOLUTE(.) < ABSOLUTE(0x1570b0)) ? ABSOLUTE(0x1570b0) - ABSOLUTE(.) : 0;
    *ctrport.dir/source/ctr_renderer.o(.text.makeShrinkStrip)
    . += (ABSOLUTE(.) < ABSOLUTE(0x157158)) ? ABSOLUTE(0x157158) - ABSOLUTE(.) : 0;
    *ctrport.dir/source/ctr_renderer.o(.text.reclaimVram)
    . += (ABSOLUTE(.) < ABSOLUTE(0x157578)) ? ABSOLUTE(0x157578) - ABSOLUTE(.) : 0;
    *ctrport.dir/source/ctr_renderer.o(.text.readSurface)
    *ctrport.dir/source/ctr_renderer.o(.text.saveScreenshot)
    . += (ABSOLUTE(.) < ABSOLUTE(0x157d30)) ? ABSOLUTE(0x157d30) - ABSOLUTE(.) : 0;
    HIDDEN(__hotpin_21 = ABSOLUTE(.));
    *ctrport.dir/source/ctr_renderer.o(.text.setViewport)
    . += (ABSOLUTE(.) < ABSOLUTE(0x157e44)) ? ABSOLUTE(0x157e44) - ABSOLUTE(.) : 0;
    *ctrport.dir/source/ctr_renderer.o(.text.ctrTextureSetStage)
    . += (ABSOLUTE(.) < ABSOLUTE(0x157efc)) ? ABSOLUTE(0x157efc) - ABSOLUTE(.) : 0;
    *ctrport.dir/source/ctr_renderer.o(.text.setUniform.part.0)
    . += (ABSOLUTE(.) < ABSOLUTE(0x1580e8)) ? ABSOLUTE(0x1580e8) - ABSOLUTE(.) : 0;
    *ctrport.dir/source/ctr_renderer.o(.text.ctrShaderSetUniformFArray)
    . += (ABSOLUTE(.) < ABSOLUTE(0x158114)) ? ABSOLUTE(0x158114) - ABSOLUTE(.) : 0;
    *ctrport.dir/source/ctr_renderer.o(.text.ctrShaderSetUniformF)
    . += (ABSOLUTE(.) < ABSOLUTE(0x158158)) ? ABSOLUTE(0x158158) - ABSOLUTE(.) : 0;
    *ctrport.dir/source/ctr_renderer.o(.text.ctrShaderSetUniformI)
    . += (ABSOLUTE(.) < ABSOLUTE(0x1581bc)) ? ABSOLUTE(0x1581bc) - ABSOLUTE(.) : 0;
    *ctrport.dir/source/ctr_renderer.o(.text.ctrGpuSetShader)
    . += (ABSOLUTE(.) < ABSOLUTE(0x1584b0)) ? ABSOLUTE(0x1584b0) - ABSOLUTE(.) : 0;
    *ctrport.dir/source/ctr_renderer.o(.text.ctrGpuSetFog)
    . += (ABSOLUTE(.) < ABSOLUTE(0x158524)) ? ABSOLUTE(0x158524) - ABSOLUTE(.) : 0;
    *ctrport.dir/source/ctr_renderer.o(.text.ctrGpuSetColorWriteEnable)
    . += (ABSOLUTE(.) < ABSOLUTE(0x1585d0)) ? ABSOLUTE(0x1585d0) - ABSOLUTE(.) : 0;
    *ctrport.dir/source/ctr_renderer.o(.text.ctrGpuSetAlphaTestRef)
    . += (ABSOLUTE(.) < ABSOLUTE(0x15862c)) ? ABSOLUTE(0x15862c) - ABSOLUTE(.) : 0;
    *ctrport.dir/source/ctr_renderer.o(.text.ctrGpuSetAlphaTestEnable)
    . += (ABSOLUTE(.) < ABSOLUTE(0x158688)) ? ABSOLUTE(0x158688) - ABSOLUTE(.) : 0;
    *ctrport.dir/source/ctr_renderer.o(.text.ctrGpuSetTexFilter)
    . += (ABSOLUTE(.) < ABSOLUTE(0x1586b8)) ? ABSOLUTE(0x1586b8) - ABSOLUTE(.) : 0;
    *ctrport.dir/source/ctr_renderer.o(.text.ctrFlush)
    . += (ABSOLUTE(.) < ABSOLUTE(0x1586bc)) ? ABSOLUTE(0x1586bc) - ABSOLUTE(.) : 0;
    *ctrport.dir/source/ctr_renderer.o(.text.ctrEndView)
    . += (ABSOLUTE(.) < ABSOLUTE(0x15870c)) ? ABSOLUTE(0x15870c) - ABSOLUTE(.) : 0;
    *ctrport.dir/source/ctr_renderer.o(.text.ctrSurfaceFree)
    . += (ABSOLUTE(.) < ABSOLUTE(0x1587d8)) ? ABSOLUTE(0x1587d8) - ABSOLUTE(.) : 0;
    *ctrport.dir/source/ctr_renderer.o(.text.ctrDeleteSprite)
    . += (ABSOLUTE(.) < ABSOLUTE(0x158a04)) ? ABSOLUTE(0x158a04) - ABSOLUTE(.) : 0;
    *ctrport.dir/source/ctr_renderer.o(.text.ctrSurfaceSetPixels)
    . += (ABSOLUTE(.) < ABSOLUTE(0x158d24)) ? ABSOLUTE(0x158d24) - ABSOLUTE(.) : 0;
    *ctrport.dir/source/ctr_renderer.o(.text.reserveGxCommands.part.0.constprop.0)
    . += (ABSOLUTE(.) < ABSOLUTE(0x158dd8)) ? ABSOLUTE(0x158dd8) - ABSOLUTE(.) : 0;
    *ctrport.dir/source/ctr_renderer.o(.text.mirrorHotTiles)
    . += (ABSOLUTE(.) < ABSOLUTE(0x159048)) ? ABSOLUTE(0x159048) - ABSOLUTE(.) : 0;
    *ctrport.dir/source/ctr_renderer.o(.text.queueTextureCopy)
    . += (ABSOLUTE(.) < ABSOLUTE(0x1590f0)) ? ABSOLUTE(0x1590f0) - ABSOLUTE(.) : 0;
    HIDDEN(__hotpin_22 = ABSOLUTE(.));
    *ctrport.dir/source/ctr_renderer.o(.text.splitFrame)
    . += (ABSOLUTE(.) < ABSOLUTE(0x159210)) ? ABSOLUTE(0x159210) - ABSOLUTE(.) : 0;
    *ctrport.dir/source/ctr_renderer.o(.text.flushPendingStore)
    . += (ABSOLUTE(.) < ABSOLUTE(0x1593a8)) ? ABSOLUTE(0x1593a8) - ABSOLUTE(.) : 0;
    *ctrport.dir/source/ctr_renderer.o(.text.releaseIdleScratches)
    . += (ABSOLUTE(.) < ABSOLUTE(0x1596f0)) ? ABSOLUTE(0x1596f0) - ABSOLUTE(.) : 0;
    *ctrport.dir/source/ctr_renderer.o(.text.demoteSurfaces)
    . += (ABSOLUTE(.) < ABSOLUTE(0x159c5c)) ? ABSOLUTE(0x159c5c) - ABSOLUTE(.) : 0;
    *ctrport.dir/source/ctr_renderer.o(.text.loadSpill)
    . += (ABSOLUTE(.) < ABSOLUTE(0x159cf8)) ? ABSOLUTE(0x159cf8) - ABSOLUTE(.) : 0;
    HIDDEN(__hotpin_23 = ABSOLUTE(.));
    *ctrport.dir/source/ctr_renderer.o(.text.reserveBatch)
    . += (ABSOLUTE(.) < ABSOLUTE(0x15a360)) ? ABSOLUTE(0x15a360) - ABSOLUTE(.) : 0;
    *ctrport.dir/source/ctr_renderer.o(.text.emitPrimitiveLine)
    . += (ABSOLUTE(.) < ABSOLUTE(0x15a5f8)) ? ABSOLUTE(0x15a5f8) - ABSOLUTE(.) : 0;
    *ctrport.dir/source/ctr_renderer.o(.text.bindTarget.part.0)
    . += (ABSOLUTE(.) < ABSOLUTE(0x15a904)) ? ABSOLUTE(0x15a904) - ABSOLUTE(.) : 0;
    *ctrport.dir/source/ctr_renderer.o(.text.demoteSurface)
    . += (ABSOLUTE(.) < ABSOLUTE(0x15aac0)) ? ABSOLUTE(0x15aac0) - ABSOLUTE(.) : 0;
    *ctrport.dir/source/ctr_renderer.o(.text.scratchFor)
    . += (ABSOLUTE(.) < ABSOLUTE(0x15b1e0)) ? ABSOLUTE(0x15b1e0) - ABSOLUTE(.) : 0;
    *ctrport.dir/source/ctr_renderer.o(.text.spillSurfaceLater)
    . += (ABSOLUTE(.) < ABSOLUTE(0x15b2c4)) ? ABSOLUTE(0x15b2c4) - ABSOLUTE(.) : 0;
    *ctrport.dir/source/ctr_renderer.o(.text.spillSurfaceTexture)
    . += (ABSOLUTE(.) < ABSOLUTE(0x15b3f0)) ? ABSOLUTE(0x15b3f0) - ABSOLUTE(.) : 0;
    *ctrport.dir/source/ctr_renderer.o(.text.initSurfaceTexture)
    . += (ABSOLUTE(.) < ABSOLUTE(0x15bb6c)) ? ABSOLUTE(0x15bb6c) - ABSOLUTE(.) : 0;
    *ctrport.dir/source/ctr_renderer.o(.text.createSurface)
    . += (ABSOLUTE(.) < ABSOLUTE(0x15bcd8)) ? ABSOLUTE(0x15bcd8) - ABSOLUTE(.) : 0;
    *ctrport.dir/source/ctr_renderer.o(.text.ctrCreateSurface)
    . += (ABSOLUTE(.) < ABSOLUTE(0x15bd48)) ? ABSOLUTE(0x15bd48) - ABSOLUTE(.) : 0;
    *ctrport.dir/source/ctr_renderer.o(.text.promoteRecorded)
    . += (ABSOLUTE(.) < ABSOLUTE(0x15c318)) ? ABSOLUTE(0x15c318) - ABSOLUTE(.) : 0;
    *ctrport.dir/source/ctr_renderer.o(.text.probeRun.isra.0)
    . += (ABSOLUTE(.) < ABSOLUTE(0x15c3a8)) ? ABSOLUTE(0x15c3a8) - ABSOLUTE(.) : 0;
    *ctrport.dir/source/ctr_renderer.o(.text.ctrGpuResetShader)
    . += (ABSOLUTE(.) < ABSOLUTE(0x15c480)) ? ABSOLUTE(0x15c480) - ABSOLUTE(.) : 0;
    *ctrport.dir/source/ctr_renderer.o(.text.ctrEndGUI)
    . += (ABSOLUTE(.) < ABSOLUTE(0x15c4d0)) ? ABSOLUTE(0x15c4d0) - ABSOLUTE(.) : 0;
    *ctrport.dir/source/ctr_renderer.o(.text.ctrTextureGetUVs)
    . += (ABSOLUTE(.) < ABSOLUTE(0x15c604)) ? ABSOLUTE(0x15c604) - ABSOLUTE(.) : 0;
    *ctrport.dir/source/ctr_renderer.o(.text.ctrTextureGetTexelHeight)
    . += (ABSOLUTE(.) < ABSOLUTE(0x15c6bc)) ? ABSOLUTE(0x15c6bc) - ABSOLUTE(.) : 0;
    *ctrport.dir/source/ctr_renderer.o(.text.ctrTextureGetTexelWidth)
    . += (ABSOLUTE(.) < ABSOLUTE(0x15c774)) ? ABSOLUTE(0x15c774) - ABSOLUTE(.) : 0;
    *ctrport.dir/source/ctr_renderer.o(.text.drawWindowed)
    . += (ABSOLUTE(.) < ABSOLUTE(0x15c998)) ? ABSOLUTE(0x15c998) - ABSOLUTE(.) : 0;
    HIDDEN(__hotpin_24 = ABSOLUTE(.));
    *ctrport.dir/source/ctr_renderer.o(.text.emitPageRegion)
    . += (ABSOLUTE(.) < ABSOLUTE(0x15ea50)) ? ABSOLUTE(0x15ea50) - ABSOLUTE(.) : 0;
    *ctrport.dir/source/ctr_renderer.o(.text.castleQuad)
    . += (ABSOLUTE(.) < ABSOLUTE(0x15f030)) ? ABSOLUTE(0x15f030) - ABSOLUTE(.) : 0;
    HIDDEN(__hotpin_25 = ABSOLUTE(.));
    *ctrport.dir/source/ctr_renderer.o(.text.emitQuad)
    . += (ABSOLUTE(.) < ABSOLUTE(0x15f324)) ? ABSOLUTE(0x15f324) - ABSOLUTE(.) : 0;
    *ctrport.dir/source/ctr_renderer.o(.text.emitRecSurface)
    . += (ABSOLUTE(.) < ABSOLUTE(0x15f49c)) ? ABSOLUTE(0x15f49c) - ABSOLUTE(.) : 0;
    *ctrport.dir/source/ctr_renderer.o(.text.emitSurfaceTexQuad)
    . += (ABSOLUTE(.) < ABSOLUTE(0x15f7b0)) ? ABSOLUTE(0x15f7b0) - ABSOLUTE(.) : 0;
    *ctrport.dir/source/ctr_renderer.o(.text.ctrSurfaceCopy)
    . += (ABSOLUTE(.) < ABSOLUTE(0x160668)) ? ABSOLUTE(0x160668) - ABSOLUTE(.) : 0;
    *ctrport.dir/source/ctr_renderer.o(.text.ctrCreateSpriteFromSurface)
    *ctrport.dir/source/ctr_renderer.o(.text.tpaggrow_slot_ctr_renderer_smartCopyQuad)
    . += (ABSOLUTE(.) < ABSOLUTE(0x160b50)) ? ABSOLUTE(0x160b50) - ABSOLUTE(.) : 0;
    *ctrport.dir/source/ctr_renderer.o(.text.smartCopyQuad)
    . += (ABSOLUTE(.) < ABSOLUTE(0x160bc8)) ? ABSOLUTE(0x160bc8) - ABSOLUTE(.) : 0;
    HIDDEN(__hotpin_26 = ABSOLUTE(.));
    *ctrport.dir/source/ctr_renderer.o(.text.emitPageTiles)
    . += (ABSOLUTE(.) < ABSOLUTE(0x161800)) ? ABSOLUTE(0x161800) - ABSOLUTE(.) : 0;
    HIDDEN(__hotpin_27 = ABSOLUTE(.));
    *ctrport.dir/source/ctr_renderer.o(.text.smartEmitAveraged)
    . += (ABSOLUTE(.) < ABSOLUTE(0x162960)) ? ABSOLUTE(0x162960) - ABSOLUTE(.) : 0;
    HIDDEN(__hotpin_28 = ABSOLUTE(.));
    *ctrport.dir/source/ctr_renderer.o(.text.emitPageRegionVisible)
    . += (ABSOLUTE(.) < ABSOLUTE(0x1631b4)) ? ABSOLUTE(0x1631b4) - ABSOLUTE(.) : 0;
    *ctrport.dir/source/ctr_renderer.o(.text.crtCell)
    . += (ABSOLUTE(.) < ABSOLUTE(0x163424)) ? ABSOLUTE(0x163424) - ABSOLUTE(.) : 0;
    *ctrport.dir/source/ctr_renderer.o(.text.emitShrinkQuad)
    . += (ABSOLUTE(.) < ABSOLUTE(0x16349c)) ? ABSOLUTE(0x16349c) - ABSOLUTE(.) : 0;
    *ctrport.dir/source/ctr_renderer.o(.text.shrinkRows)
    . += (ABSOLUTE(.) < ABSOLUTE(0x163740)) ? ABSOLUTE(0x163740) - ABSOLUTE(.) : 0;
    *ctrport.dir/source/ctr_renderer.o(.text.smartShowBoxes.isra.0)
    . += (ABSOLUTE(.) < ABSOLUTE(0x1638fc)) ? ABSOLUTE(0x1638fc) - ABSOLUTE(.) : 0;
    *ctrport.dir/source/ctr_renderer.o(.text.blitApp)
    . += (ABSOLUTE(.) < ABSOLUTE(0x163a20)) ? ABSOLUTE(0x163a20) - ABSOLUTE(.) : 0;
    *ctrport.dir/source/ctr_renderer.o(.text.emitRect)
    . += (ABSOLUTE(.) < ABSOLUTE(0x163aa4)) ? ABSOLUTE(0x163aa4) - ABSOLUTE(.) : 0;
    *ctrport.dir/source/ctr_renderer.o(.text.ctrDrawRectangle)
    . += (ABSOLUTE(.) < ABSOLUTE(0x1642bc)) ? ABSOLUTE(0x1642bc) - ABSOLUTE(.) : 0;
    *ctrport.dir/source/ctr_renderer.o(.text.ctrDrawLineColor)
    . += (ABSOLUTE(.) < ABSOLUTE(0x1645a4)) ? ABSOLUTE(0x1645a4) - ABSOLUTE(.) : 0;
    *ctrport.dir/source/ctr_renderer.o(.text.ctrDrawLine)
    . += (ABSOLUTE(.) < ABSOLUTE(0x1645ac)) ? ABSOLUTE(0x1645ac) - ABSOLUTE(.) : 0;
    *ctrport.dir/source/ctr_renderer.o(.text.ctrDrawRectangleColor)
    . += (ABSOLUTE(.) < ABSOLUTE(0x1647e8)) ? ABSOLUTE(0x1647e8) - ABSOLUTE(.) : 0;
    *ctrport.dir/source/ctr_renderer.o(.text.ctrDrawTriangle)
    . += (ABSOLUTE(.) < ABSOLUTE(0x164fe0)) ? ABSOLUTE(0x164fe0) - ABSOLUTE(.) : 0;
    *ctrport.dir/source/ctr_renderer.o(.text.ctrDrawTriangleFan)
    . += (ABSOLUTE(.) < ABSOLUTE(0x1651fc)) ? ABSOLUTE(0x1651fc) - ABSOLUTE(.) : 0;
    *ctrport.dir/source/ctr_renderer.o(.text.ctrDrawLines)
    . += (ABSOLUTE(.) < ABSOLUTE(0x1657ac)) ? ABSOLUTE(0x1657ac) - ABSOLUTE(.) : 0;
    *ctrport.dir/source/ctr_renderer.o(.text.presentBottom)
    . += (ABSOLUTE(.) < ABSOLUTE(0x166354)) ? ABSOLUTE(0x166354) - ABSOLUTE(.) : 0;
    HIDDEN(__hotpin_29 = ABSOLUTE(.));
    *ctrport.dir/source/ctr_renderer.o(.text.ctrDrawSprite)
    . += (ABSOLUTE(.) < ABSOLUTE(0x167408)) ? ABSOLUTE(0x167408) - ABSOLUTE(.) : 0;
    *ctrport.dir/source/ctr_renderer.o(.text.emitWaveRun.part.0)
    . += (ABSOLUTE(.) < ABSOLUTE(0x167618)) ? ABSOLUTE(0x167618) - ABSOLUTE(.) : 0;
    *ctrport.dir/source/ctr_renderer.o(.text.rainbowRegion)
    . += (ABSOLUTE(.) < ABSOLUTE(0x167cd8)) ? ABSOLUTE(0x167cd8) - ABSOLUTE(.) : 0;
    *ctrport.dir/source/ctr_renderer.o(.text.ctrDrawSpritePos)
    . += (ABSOLUTE(.) < ABSOLUTE(0x167f10)) ? ABSOLUTE(0x167f10) - ABSOLUTE(.) : 0;
    HIDDEN(__hotpin_30 = ABSOLUTE(.));
    *ctrport.dir/source/ctr_renderer.o(.text.drawTextImpl)
    . += (ABSOLUTE(.) < ABSOLUTE(0x16a8b0)) ? ABSOLUTE(0x16a8b0) - ABSOLUTE(.) : 0;
    *ctrport.dir/source/ctr_renderer.o(.text.ctrDrawText)
    . += (ABSOLUTE(.) < ABSOLUTE(0x16a8dc)) ? ABSOLUTE(0x16a8dc) - ABSOLUTE(.) : 0;
    *ctrport.dir/source/ctr_renderer.o(.text.ctrDrawTextColor)
    . += (ABSOLUTE(.) < ABSOLUTE(0x16a8e0)) ? ABSOLUTE(0x16a8e0) - ABSOLUTE(.) : 0;
    *ctrport.dir/source/ctr_renderer.o(.text.ctrDrawSpriteTiled)
    . += (ABSOLUTE(.) < ABSOLUTE(0x16b280)) ? ABSOLUTE(0x16b280) - ABSOLUTE(.) : 0;
    HIDDEN(__hotpin_31 = ABSOLUTE(.));
    *ctrport.dir/source/ctr_renderer.o(.text.ctrDrawSpritePartColor)
    . += (ABSOLUTE(.) < ABSOLUTE(0x16b734)) ? ABSOLUTE(0x16b734) - ABSOLUTE(.) : 0;
    *ctrport.dir/source/ctr_renderer.o(.text.ctrDrawSpritePart)
    . += (ABSOLUTE(.) < ABSOLUTE(0x16b758)) ? ABSOLUTE(0x16b758) - ABSOLUTE(.) : 0;
    HIDDEN(__hotpin_32 = ABSOLUTE(.));
    *ctrport.dir/source/ctr_renderer.o(.text.CtrRenderer_endFrame.part.0)
    . += (ABSOLUTE(.) < ABSOLUTE(0x16d2a4)) ? ABSOLUTE(0x16d2a4) - ABSOLUTE(.) : 0;
    *ctrport.dir/source/ctr_renderer.o(.text.resolveTextureHandle.part.0.constprop.0)
    . += (ABSOLUTE(.) < ABSOLUTE(0x16d69c)) ? ABSOLUTE(0x16d69c) - ABSOLUTE(.) : 0;
    *ctrport.dir/source/ctr_renderer.o(.text.submitPrimitive)
    . += (ABSOLUTE(.) < ABSOLUTE(0x16daf0)) ? ABSOLUTE(0x16daf0) - ABSOLUTE(.) : 0;
    *ctrport.dir/source/ctr_renderer.o(.text.ctrPrimitiveEnd)
    . += (ABSOLUTE(.) < ABSOLUTE(0x16db34)) ? ABSOLUTE(0x16db34) - ABSOLUTE(.) : 0;
    *ctrport.dir/source/ctr_renderer.o(.text.ctrDrawVertexBuffer)
    . += (ABSOLUTE(.) < ABSOLUTE(0x16e8d8)) ? ABSOLUTE(0x16e8d8) - ABSOLUTE(.) : 0;
    *ctrport.dir/source/ctr_renderer.o(.text.remakeSurface)
    . += (ABSOLUTE(.) < ABSOLUTE(0x16eba0)) ? ABSOLUTE(0x16eba0) - ABSOLUTE(.) : 0;
    *ctrport.dir/source/ctr_renderer.o(.text.remakeNativeSurfaces)
    . += (ABSOLUTE(.) < ABSOLUTE(0x16f0c0)) ? ABSOLUTE(0x16f0c0) - ABSOLUTE(.) : 0;
    *ctrport.dir/source/ctr_renderer.o(.text.ctrSurfaceResize)
    . += (ABSOLUTE(.) < ABSOLUTE(0x16f2a0)) ? ABSOLUTE(0x16f2a0) - ABSOLUTE(.) : 0;
    *ctrport.dir/source/ctr_renderer.o(.text.ctrEnsureApplicationSurface)
    . += (ABSOLUTE(.) < ABSOLUTE(0x16f354)) ? ABSOLUTE(0x16f354) - ABSOLUTE(.) : 0;
    *ctrport.dir/source/ctr_renderer.o(.text.ctrBeginView)
    . += (ABSOLUTE(.) < ABSOLUTE(0x16f408)) ? ABSOLUTE(0x16f408) - ABSOLUTE(.) : 0;
    *ctrport.dir/source/ctr_renderer.o(.text.ctrBeginGUI)
    . += (ABSOLUTE(.) < ABSOLUTE(0x16f590)) ? ABSOLUTE(0x16f590) - ABSOLUTE(.) : 0;
    *ctrport.dir/source/ctr_renderer.o(.text.ctrBeginFrame)
    . += (ABSOLUTE(.) < ABSOLUTE(0x16f630)) ? ABSOLUTE(0x16f630) - ABSOLUTE(.) : 0;
    *ctrport.dir/source/ctr_renderer.o(.text.ctrClearScreen)
    . += (ABSOLUTE(.) < ABSOLUTE(0x16f6c8)) ? ABSOLUTE(0x16f6c8) - ABSOLUTE(.) : 0;
    *ctrport.dir/source/ctr_renderer.o(.text.windowRecordedSurface.isra.0)
    . += (ABSOLUTE(.) < ABSOLUTE(0x16fe6c)) ? ABSOLUTE(0x16fe6c) - ABSOLUTE(.) : 0;
    *ctrport.dir/source/ctr_renderer.o(.text.ctrSetRenderTarget)
    . += (ABSOLUTE(.) < ABSOLUTE(0x170614)) ? ABSOLUTE(0x170614) - ABSOLUTE(.) : 0;
    *ctrport.dir/source/ctr_renderer.o(.text.ctrGpuSetBlendMode)
    . += (ABSOLUTE(.) < ABSOLUTE(0x1706e8)) ? ABSOLUTE(0x1706e8) - ABSOLUTE(.) : 0;
    *ctrport.dir/source/ctr_renderer.o(.text.ctrGpuSetBlendModeExt)
    . += (ABSOLUTE(.) < ABSOLUTE(0x17078c)) ? ABSOLUTE(0x17078c) - ABSOLUTE(.) : 0;
    *ctrport.dir/source/ctr_renderer.o(.text.ctrGpuSetBlendEnable)
    . += (ABSOLUTE(.) < ABSOLUTE(0x1707ec)) ? ABSOLUTE(0x1707ec) - ABSOLUTE(.) : 0;
    *ctrport.dir/source/ctr_renderer.o(.text.skipRecordRead)
    . += (ABSOLUTE(.) < ABSOLUTE(0x170a68)) ? ABSOLUTE(0x170a68) - ABSOLUTE(.) : 0;
    *ctrport.dir/source/ctr_renderer.o(.text.ctrSurfaceGetPixels)
    . += (ABSOLUTE(.) < ABSOLUTE(0x170c38)) ? ABSOLUTE(0x170c38) - ABSOLUTE(.) : 0;
    *ctrport.dir/source/ctr_renderer.o(.text.probeRead)
    . += (ABSOLUTE(.) < ABSOLUTE(0x170e8c)) ? ABSOLUTE(0x170e8c) - ABSOLUTE(.) : 0;
    *ctrport.dir/source/ctr_renderer.o(.text.probeCompare)
    . += (ABSOLUTE(.) < ABSOLUTE(0x171668)) ? ABSOLUTE(0x171668) - ABSOLUTE(.) : 0;
    *ctrport.dir/source/ctr_renderer.o(.text.skipSurfaceGetTexture)
    . += (ABSOLUTE(.) < ABSOLUTE(0x171700)) ? ABSOLUTE(0x171700) - ABSOLUTE(.) : 0;
    *ctrport.dir/source/ctr_renderer.o(.text.skipCreateSpriteFromSurface)
    . += (ABSOLUTE(.) < ABSOLUTE(0x1717a0)) ? ABSOLUTE(0x1717a0) - ABSOLUTE(.) : 0;
    *ctrport.dir/source/ctr_renderer.o(.text.skipRecOp)
    . += (ABSOLUTE(.) < ABSOLUTE(0x171e8c)) ? ABSOLUTE(0x171e8c) - ABSOLUTE(.) : 0;
    *ctrport.dir/source/ctr_renderer.o(.text.skipSurfaceCopy)
    . += (ABSOLUTE(.) < ABSOLUTE(0x1722d0)) ? ABSOLUTE(0x1722d0) - ABSOLUTE(.) : 0;
    *ctrport.dir/source/ctr_renderer.o(.text.skipAction)
    . += (ABSOLUTE(.) < ABSOLUTE(0x1725c8)) ? ABSOLUTE(0x1725c8) - ABSOLUTE(.) : 0;
    *ctrport.dir/source/ctr_renderer.o(.text.skipReadOp)
    . += (ABSOLUTE(.) < ABSOLUTE(0x1727b4)) ? ABSOLUTE(0x1727b4) - ABSOLUTE(.) : 0;
    *ctrport.dir/source/ctr_renderer.o(.text.skipDrawSurfaceColor)
    . += (ABSOLUTE(.) < ABSOLUTE(0x1728cc)) ? ABSOLUTE(0x1728cc) - ABSOLUTE(.) : 0;
    *ctrport.dir/source/ctr_renderer.o(.text.skipDrawSurface)
    . += (ABSOLUTE(.) < ABSOLUTE(0x1729d8)) ? ABSOLUTE(0x1729d8) - ABSOLUTE(.) : 0;
    *ctrport.dir/source/ctr_renderer.o(.text.skipDrawVertexBuffer)
    . += (ABSOLUTE(.) < ABSOLUTE(0x172afc)) ? ABSOLUTE(0x172afc) - ABSOLUTE(.) : 0;
    *ctrport.dir/source/ctr_renderer.o(.text.skipPrimitiveEnd)
    . += (ABSOLUTE(.) < ABSOLUTE(0x172cb4)) ? ABSOLUTE(0x172cb4) - ABSOLUTE(.) : 0;
    *ctrport.dir/source/ctr_renderer.o(.text.skipClearScreen)
    . += (ABSOLUTE(.) < ABSOLUTE(0x172f18)) ? ABSOLUTE(0x172f18) - ABSOLUTE(.) : 0;
    *ctrport.dir/source/ctr_renderer.o(.text.skipDrawTriangleFan)
    . += (ABSOLUTE(.) < ABSOLUTE(0x172ff8)) ? ABSOLUTE(0x172ff8) - ABSOLUTE(.) : 0;
    *ctrport.dir/source/ctr_renderer.o(.text.skipDrawText)
    . += (ABSOLUTE(.) < ABSOLUTE(0x17310c)) ? ABSOLUTE(0x17310c) - ABSOLUTE(.) : 0;
    *ctrport.dir/source/ctr_renderer.o(.text.skipDrawLines)
    . += (ABSOLUTE(.) < ABSOLUTE(0x1731f4)) ? ABSOLUTE(0x1731f4) - ABSOLUTE(.) : 0;
    *ctrport.dir/source/ctr_renderer.o(.text.skipDrawTextColor)
    . += (ABSOLUTE(.) < ABSOLUTE(0x173330)) ? ABSOLUTE(0x173330) - ABSOLUTE(.) : 0;
    *ctrport.dir/source/ctr_renderer.o(.text.skipDrawRectangle)
    . += (ABSOLUTE(.) < ABSOLUTE(0x173414)) ? ABSOLUTE(0x173414) - ABSOLUTE(.) : 0;
    *ctrport.dir/source/ctr_renderer.o(.text.skipDrawLine)
    . += (ABSOLUTE(.) < ABSOLUTE(0x173500)) ? ABSOLUTE(0x173500) - ABSOLUTE(.) : 0;
    *ctrport.dir/source/ctr_renderer.o(.text.skipDrawLineColor)
    . += (ABSOLUTE(.) < ABSOLUTE(0x1735f4)) ? ABSOLUTE(0x1735f4) - ABSOLUTE(.) : 0;
    *ctrport.dir/source/ctr_renderer.o(.text.skipDrawRectangleColor)
    . += (ABSOLUTE(.) < ABSOLUTE(0x1736fc)) ? ABSOLUTE(0x1736fc) - ABSOLUTE(.) : 0;
    *ctrport.dir/source/ctr_renderer.o(.text.skipDrawSpritePos)
    . += (ABSOLUTE(.) < ABSOLUTE(0x17382c)) ? ABSOLUTE(0x17382c) - ABSOLUTE(.) : 0;
    *ctrport.dir/source/ctr_renderer.o(.text.skipDrawSprite)
    . += (ABSOLUTE(.) < ABSOLUTE(0x173940)) ? ABSOLUTE(0x173940) - ABSOLUTE(.) : 0;
    *ctrport.dir/source/ctr_renderer.o(.text.skipDrawTriangle)
    . += (ABSOLUTE(.) < ABSOLUTE(0x173a5c)) ? ABSOLUTE(0x173a5c) - ABSOLUTE(.) : 0;
    *ctrport.dir/source/ctr_renderer.o(.text.skipDrawSpriteTiled)
    . += (ABSOLUTE(.) < ABSOLUTE(0x173bb0)) ? ABSOLUTE(0x173bb0) - ABSOLUTE(.) : 0;
    *ctrport.dir/source/ctr_renderer.o(.text.skipDrawSpritePart)
    . += (ABSOLUTE(.) < ABSOLUTE(0x173d0c)) ? ABSOLUTE(0x173d0c) - ABSOLUTE(.) : 0;
    *ctrport.dir/source/ctr_renderer.o(.text.skipDrawSpritePartColor)
    . += (ABSOLUTE(.) < ABSOLUTE(0x173e88)) ? ABSOLUTE(0x173e88) - ABSOLUTE(.) : 0;
    *ctrport.dir/source/ctr_renderer.o(.text.skipDrawSurfaceTiled)
    *ctrport.dir/source/ctr_renderer.o(.text.CtrRenderer_startFlickerProbe)
    . += (ABSOLUTE(.) < ABSOLUTE(0x1744ec)) ? ABSOLUTE(0x1744ec) - ABSOLUTE(.) : 0;
    *ctrport.dir/source/ctr_renderer.o(.text.CtrRenderer_loadFlickerProbe)
    . += (ABSOLUTE(.) < ABSOLUTE(0x174570)) ? ABSOLUTE(0x174570) - ABSOLUTE(.) : 0;
    *ctrport.dir/source/ctr_renderer.o(.text.CtrRenderer_flickerProbeDone)
    . += (ABSOLUTE(.) < ABSOLUTE(0x17457c)) ? ABSOLUTE(0x17457c) - ABSOLUTE(.) : 0;
    *ctrport.dir/source/ctr_renderer.o(.text.CtrRenderer_endFlickerProbe)
    . += (ABSOLUTE(.) < ABSOLUTE(0x1745d8)) ? ABSOLUTE(0x1745d8) - ABSOLUTE(.) : 0;
    *ctrport.dir/source/ctr_renderer.o(.text.CtrRenderer_beginFrame)
    *ctrport.dir/source/ctr_renderer.o(.text.selfTestMirrorCancel)
    *ctrport.dir/source/ctr_renderer.o(.text.selfTestSmart)
    *ctrport.dir/source/ctr_renderer.o(.text.CtrRenderer_endFrame)
    *ctrport.dir/source/ctr_renderer.o(.text.CtrRenderer_setDisplay)
    *ctrport.dir/source/ctr_renderer.o(.text.CtrRenderer_yieldBottomScreen)
    *ctrport.dir/source/ctr_renderer.o(.text.CtrRenderer_dialogueShown)
    *ctrport.dir/source/ctr_renderer.o(.text.CtrRenderer_getDisplayCaps)
    *ctrport.dir/source/ctr_renderer.o(.text.CtrRenderer_setFrameRate)
    *ctrport.dir/source/ctr_renderer.o(.text.CtrRenderer_skipPresent)
    *ctrport.dir/source/ctr_renderer.o(.text.CtrRenderer_setFrameSkip)
    *ctrport.dir/source/ctr_renderer.o(.text.CtrRenderer_setFrameSkipPolicy)
    *ctrport.dir/source/ctr_renderer.o(.text.CtrRenderer_setFrameSkipKeepApp)
    *ctrport.dir/source/ctr_renderer.o(.text.CtrRenderer_setFrameSkipOverlap)
    *ctrport.dir/source/ctr_renderer.o(.text.CtrRenderer_setFrameSkipRecord)
    *ctrport.dir/source/ctr_renderer.o(.text.CtrRenderer_takeSkipRecStats)
    *ctrport.dir/source/ctr_renderer.o(.text.CtrRenderer_setHalfRate)
    *ctrport.dir/source/ctr_renderer.o(.text.CtrRenderer_setFrameSkipLevels)
    *ctrport.dir/source/ctr_renderer.o(.text.CtrRenderer_setForceMaterialize)
    *ctrport.dir/source/ctr_renderer.o(.text.CtrRenderer_setSurfaceReaders)
    *ctrport.dir/source/ctr_renderer.o(.text.CtrRenderer_setSliderOverride)
    *ctrport.dir/source/ctr_renderer.o(.text.CtrRenderer_frameSkipped)
    *ctrport.dir/source/ctr_renderer.o(.text.CtrRenderer_takeSkipStats)
    *ctrport.dir/source/ctr_renderer.o(.text.CtrRenderer_getSkipTotals)
    *ctrport.dir/source/ctr_renderer.o(.text.CtrRenderer_probeTextures)
    *ctrport.dir/source/ctr_renderer.o(.text.CtrRenderer_probeNextFrame)
    *ctrport.dir/source/ctr_renderer.o(.text.CtrRenderer_traceNextFrame)
    *ctrport.dir/source/ctr_renderer.o(.text.CtrRenderer_requestScreenshot)
    *ctrport.dir/source/ctr_renderer.o(.text.CtrRenderer_requestPlayerScreenshot)
    *ctrport.dir/source/ctr_renderer.o(.text.CtrRenderer_requestScreenshotSuffixed)
    *ctrport.dir/source/ctr_renderer.o(.text.CtrRenderer_screenshotCaptured)
    *ctrport.dir/source/ctr_renderer.o(.text.CtrRenderer_screenshotTimingAffected)
    *ctrport.dir/source/ctr_renderer.o(.text.CtrRenderer_requestSurfaceShot)
    *ctrport.dir/source/ctr_renderer.o(.text.CtrRenderer_surfaceShotMs)
    *ctrport.dir/source/ctr_renderer.o(.text.CtrRenderer_getStats)
    . += (ABSOLUTE(.) < ABSOLUTE(0x178070)) ? ABSOLUTE(0x178070) - ABSOLUTE(.) : 0;
    *ctrport.dir/source/ctr_renderer.o(.text.CtrRenderer_logStats)
    . += (ABSOLUTE(.) < ABSOLUTE(0x1783f8)) ? ABSOLUTE(0x1783f8) - ABSOLUTE(.) : 0;
    *ctrport.dir/source/ctr_renderer.o(.text.CtrRenderer_createVideoSurface)
    . += (ABSOLUTE(.) < ABSOLUTE(0x178628)) ? ABSOLUTE(0x178628) - ABSOLUTE(.) : 0;
    *ctrport.dir/source/ctr_renderer.o(.text.CtrRenderer_uploadVideoFrame)
    . += (ABSOLUTE(.) < ABSOLUTE(0x178eb4)) ? ABSOLUTE(0x178eb4) - ABSOLUTE(.) : 0;
    *ctrport.dir/source/ctr_renderer.o(.text.CtrRenderer_fillVideoSurface)
    . += (ABSOLUTE(.) < ABSOLUTE(0x17910c)) ? ABSOLUTE(0x17910c) - ABSOLUTE(.) : 0;
    *ctrport.dir/source/ctr_renderer.o(.text.CtrRenderer_fenceDone)
    . += (ABSOLUTE(.) < ABSOLUTE(0x179128)) ? ABSOLUTE(0x179128) - ABSOLUTE(.) : 0;
    *ctrport.dir/source/ctr_renderer.o(.text.CtrRenderer_releaseVideo)
    . += (ABSOLUTE(.) < ABSOLUTE(0x179188)) ? ABSOLUTE(0x179188) - ABSOLUTE(.) : 0;
    *ctrport.dir/source/ctr_renderer.o(.text.ctrDestroy)
    . += (ABSOLUTE(.) < ABSOLUTE(0x1796dc)) ? ABSOLUTE(0x1796dc) - ABSOLUTE(.) : 0;
    *ctrport.dir/source/ctr_renderer.o(.text.CtrRenderer_prefetchRoom)
    . += (ABSOLUTE(.) < ABSOLUTE(0x1796e8)) ? ABSOLUTE(0x1796e8) - ABSOLUTE(.) : 0;
    *ctrport.dir/source/ctr_renderer.o(.text.CtrRenderer_stopBackgroundWork)
    . += (ABSOLUTE(.) < ABSOLUTE(0x1796f0)) ? ABSOLUTE(0x1796f0) - ABSOLUTE(.) : 0;
    *ctrport.dir/source/ctr_renderer.o(.text.CtrRenderer_leaveForExit)
    . += (ABSOLUTE(.) < ABSOLUTE(0x179714)) ? ABSOLUTE(0x179714) - ABSOLUTE(.) : 0;
    *ctrport.dir/source/ctr_renderer.o(.text.CtrRenderer_create)
    . += (ABSOLUTE(.) < ABSOLUTE(0x179c50)) ? ABSOLUTE(0x179c50) - ABSOLUTE(.) : 0;
    *ctrport.dir/source/ctr_renderer.o(.text.CtrRenderer_selfTest)
    . += (ABSOLUTE(.) < ABSOLUTE(0x17bfc0)) ? ABSOLUTE(0x17bfc0) - ABSOLUTE(.) : 0;
    *ctrport.dir/source/ctr_safe_save.o(.text.sidePath)
    . += (ABSOLUTE(.) < ABSOLUTE(0x17c018)) ? ABSOLUTE(0x17c018) - ABSOLUTE(.) : 0;
    *ctrport.dir/source/ctr_safe_save.o(.text.sameContents)
    . += (ABSOLUTE(.) < ABSOLUTE(0x17c0f8)) ? ABSOLUTE(0x17c0f8) - ABSOLUTE(.) : 0;
    *ctrport.dir/source/ctr_safe_save.o(.text.CtrSafeSave_failed)
    . += (ABSOLUTE(.) < ABSOLUTE(0x17c110)) ? ABSOLUTE(0x17c110) - ABSOLUTE(.) : 0;
    *ctrport.dir/source/ctr_safe_save.o(.text.CtrSafeSave_recover)
    . += (ABSOLUTE(.) < ABSOLUTE(0x17c1e4)) ? ABSOLUTE(0x17c1e4) - ABSOLUTE(.) : 0;
    *ctrport.dir/source/ctr_safe_save.o(.text.CtrSafeSave_forgetBackup)
    . += (ABSOLUTE(.) < ABSOLUTE(0x17c254)) ? ABSOLUTE(0x17c254) - ABSOLUTE(.) : 0;
    *ctrport.dir/source/ctr_safe_save.o(.text.CtrSafeSave_write)
    . += (ABSOLUTE(.) < ABSOLUTE(0x17c4d4)) ? ABSOLUTE(0x17c4d4) - ABSOLUTE(.) : 0;
    *ctrport.dir/source/ctr_screenshot_path.o(.text.CtrScreenshot_nextPath)
    . += (ABSOLUTE(.) < ABSOLUTE(0x17c628)) ? ABSOLUTE(0x17c628) - ABSOLUTE(.) : 0;
    *ctrport.dir/source/ctr_startup_clock.o(.text.CtrStartup_elapsedUs)
    . += (ABSOLUTE(.) < ABSOLUTE(0x17c6c4)) ? ABSOLUTE(0x17c6c4) - ABSOLUTE(.) : 0;
    *ctrport.dir/source/ctr_startup_clock.o(.text.CtrStartup_libctruUs)
    . += (ABSOLUTE(.) < ABSOLUTE(0x17c6d4)) ? ABSOLUTE(0x17c6d4) - ABSOLUTE(.) : 0;
    *ctrport.dir/source/ctr_startup_clock.o(.text.__wrap___libctru_init)
    . += (ABSOLUTE(.) < ABSOLUTE(0x17c798)) ? ABSOLUTE(0x17c798) - ABSOLUTE(.) : 0;
    *ctrport.dir/source/ctr_startup_clock.o(.text.CtrStartup_stamp)
    . += (ABSOLUTE(.) < ABSOLUTE(0x17c91c)) ? ABSOLUTE(0x17c91c) - ABSOLUTE(.) : 0;
    *ctrport.dir/source/ctr_texture_pack.o(.text.timedWrite)
    . += (ABSOLUTE(.) < ABSOLUTE(0x17c9cc)) ? ABSOLUTE(0x17c9cc) - ABSOLUTE(.) : 0;
    *ctrport.dir/source/ctr_texture_pack.o(.text.writeCompleteMarker)
    . += (ABSOLUTE(.) < ABSOLUTE(0x17cb38)) ? ABSOLUTE(0x17cb38) - ABSOLUTE(.) : 0;
    *ctrport.dir/source/ctr_texture_pack.o(.text.sdTest)
    . += (ABSOLUTE(.) < ABSOLUTE(0x17cfc4)) ? ABSOLUTE(0x17cfc4) - ABSOLUTE(.) : 0;
    *ctrport.dir/source/ctr_texture_pack.o(.text.lockWorker)
    . += (ABSOLUTE(.) < ABSOLUTE(0x17d024)) ? ABSOLUTE(0x17d024) - ABSOLUTE(.) : 0;
    *ctrport.dir/source/ctr_texture_pack.o(.text.trimLastPiece)
    . += (ABSOLUTE(.) < ABSOLUTE(0x17d08c)) ? ABSOLUTE(0x17d08c) - ABSOLUTE(.) : 0;
    *ctrport.dir/source/ctr_texture_pack.o(.text.freeWorker)
    . += (ABSOLUTE(.) < ABSOLUTE(0x17d17c)) ? ABSOLUTE(0x17d17c) - ABSOLUTE(.) : 0;
    *ctrport.dir/source/ctr_texture_pack.o(.text.writePieces.constprop.0)
    . += (ABSOLUTE(.) < ABSOLUTE(0x17d21c)) ? ABSOLUTE(0x17d21c) - ABSOLUTE(.) : 0;
    *ctrport.dir/source/ctr_texture_pack.o(.text.convertTileSlow.constprop.0)
    . += (ABSOLUTE(.) < ABSOLUTE(0x17d3fc)) ? ABSOLUTE(0x17d3fc) - ABSOLUTE(.) : 0;
    *ctrport.dir/source/ctr_texture_pack.o(.text.chooseRowFormats)
    . += (ABSOLUTE(.) < ABSOLUTE(0x17da5c)) ? ABSOLUTE(0x17da5c) - ABSOLUTE(.) : 0;
    *ctrport.dir/source/ctr_texture_pack.o(.text.takeStrip)
    . += (ABSOLUTE(.) < ABSOLUTE(0x17daa8)) ? ABSOLUTE(0x17daa8) - ABSOLUTE(.) : 0;
    *ctrport.dir/source/ctr_texture_pack.o(.text.appendBytes)
    . += (ABSOLUTE(.) < ABSOLUTE(0x17ddd0)) ? ABSOLUTE(0x17ddd0) - ABSOLUTE(.) : 0;
    *ctrport.dir/source/ctr_texture_pack.o(.text.startThread)
    . += (ABSOLUTE(.) < ABSOLUTE(0x17df50)) ? ABSOLUTE(0x17df50) - ABSOLUTE(.) : 0;
    *ctrport.dir/source/ctr_texture_pack.o(.text.CtrPack_setDataWinPath)
    . += (ABSOLUTE(.) < ABSOLUTE(0x17e0f4)) ? ABSOLUTE(0x17e0f4) - ABSOLUTE(.) : 0;
    *ctrport.dir/source/ctr_texture_pack.o(.text.CtrPack_setExact)
    . += (ABSOLUTE(.) < ABSOLUTE(0x17e13c)) ? ABSOLUTE(0x17e13c) - ABSOLUTE(.) : 0;
    *ctrport.dir/source/ctr_texture_pack.o(.text.CtrPack_lossy)
    . += (ABSOLUTE(.) < ABSOLUTE(0x17e150)) ? ABSOLUTE(0x17e150) - ABSOLUTE(.) : 0;
    *ctrport.dir/source/ctr_texture_pack.o(.text.CtrPack_setTestRun)
    . += (ABSOLUTE(.) < ABSOLUTE(0x17e190)) ? ABSOLUTE(0x17e190) - ABSOLUTE(.) : 0;
    *ctrport.dir/source/ctr_texture_pack.o(.text.CtrPack_init)
    . += (ABSOLUTE(.) < ABSOLUTE(0x17e264)) ? ABSOLUTE(0x17e264) - ABSOLUTE(.) : 0;
    *ctrport.dir/source/ctr_texture_pack.o(.text.CtrPack_keyFor)
    . += (ABSOLUTE(.) < ABSOLUTE(0x17e280)) ? ABSOLUTE(0x17e280) - ABSOLUTE(.) : 0;
    *ctrport.dir/source/ctr_texture_pack.o(.text.CtrPack_gpuFormat)
    . += (ABSOLUTE(.) < ABSOLUTE(0x17e2a0)) ? ABSOLUTE(0x17e2a0) - ABSOLUTE(.) : 0;
    *ctrport.dir/source/ctr_texture_pack.o(.text.CtrPack_texelBytes)
    . += (ABSOLUTE(.) < ABSOLUTE(0x17e2b8)) ? ABSOLUTE(0x17e2b8) - ABSOLUTE(.) : 0;
    *ctrport.dir/source/ctr_texture_pack.o(.text.CtrPack_layoutGrid)
    . += (ABSOLUTE(.) < ABSOLUTE(0x17e340)) ? ABSOLUTE(0x17e340) - ABSOLUTE(.) : 0;
    *ctrport.dir/source/ctr_texture_pack.o(.text.CtrPack_parseHeader.part.0)
    . += (ABSOLUTE(.) < ABSOLUTE(0x17e5c8)) ? ABSOLUTE(0x17e5c8) - ABSOLUTE(.) : 0;
    *ctrport.dir/source/ctr_texture_pack.o(.text.CtrPack_convertTile)
    . += (ABSOLUTE(.) < ABSOLUTE(0x17ebb4)) ? ABSOLUTE(0x17ebb4) - ABSOLUTE(.) : 0;
    *ctrport.dir/source/ctr_texture_pack.o(.text.packRow)
    . += (ABSOLUTE(.) < ABSOLUTE(0x17ef24)) ? ABSOLUTE(0x17ef24) - ABSOLUTE(.) : 0;
    *ctrport.dir/source/ctr_texture_pack.o(.text.CtrPack_imageInfo)
    . += (ABSOLUTE(.) < ABSOLUTE(0x17f0b4)) ? ABSOLUTE(0x17f0b4) - ABSOLUTE(.) : 0;
    *ctrport.dir/source/ctr_texture_pack.o(.text.CtrPack_decodeRows)
    . += (ABSOLUTE(.) < ABSOLUTE(0x17f318)) ? ABSOLUTE(0x17f318) - ABSOLUTE(.) : 0;
    *ctrport.dir/source/ctr_texture_pack.o(.text.CtrPack_parseHeader)
    . += (ABSOLUTE(.) < ABSOLUTE(0x17f32c)) ? ABSOLUTE(0x17f32c) - ABSOLUTE(.) : 0;
    HIDDEN(__hotpin_33 = ABSOLUTE(.));
    *ctrport.dir/source/ctr_texture_pack.o(.text.CtrPack_checkTile)
    . += (ABSOLUTE(.) < ABSOLUTE(0x17f3cc)) ? ABSOLUTE(0x17f3cc) - ABSOLUTE(.) : 0;
    *ctrport.dir/source/ctr_texture_pack.o(.text.CtrPack_openFile)
    . += (ABSOLUTE(.) < ABSOLUTE(0x17f4a8)) ? ABSOLUTE(0x17f4a8) - ABSOLUTE(.) : 0;
    *ctrport.dir/source/ctr_texture_pack.o(.text.CtrPack_fileSize)
    . += (ABSOLUTE(.) < ABSOLUTE(0x17f4f8)) ? ABSOLUTE(0x17f4f8) - ABSOLUTE(.) : 0;
    *ctrport.dir/source/ctr_texture_pack.o(.text.CtrPacked_new)
    . += (ABSOLUTE(.) < ABSOLUTE(0x17f668)) ? ABSOLUTE(0x17f668) - ABSOLUTE(.) : 0;
    *ctrport.dir/source/ctr_texture_pack.o(.text.CtrPacked_adopt)
    . += (ABSOLUTE(.) < ABSOLUTE(0x17f6e0)) ? ABSOLUTE(0x17f6e0) - ABSOLUTE(.) : 0;
    *ctrport.dir/source/ctr_texture_pack.o(.text.buildPage)
    . += (ABSOLUTE(.) < ABSOLUTE(0x180780)) ? ABSOLUTE(0x180780) - ABSOLUTE(.) : 0;
    *ctrport.dir/source/ctr_texture_pack.o(.text.CtrPacked_free)
    . += (ABSOLUTE(.) < ABSOLUTE(0x1807c4)) ? ABSOLUTE(0x1807c4) - ABSOLUTE(.) : 0;
    *ctrport.dir/source/ctr_texture_pack.o(.text.CtrPacked_pieceSize)
    . += (ABSOLUTE(.) < ABSOLUTE(0x1807e8)) ? ABSOLUTE(0x1807e8) - ABSOLUTE(.) : 0;
    *ctrport.dir/source/ctr_texture_pack.o(.text.CtrPacked_at)
    . += (ABSOLUTE(.) < ABSOLUTE(0x180848)) ? ABSOLUTE(0x180848) - ABSOLUTE(.) : 0;
    *ctrport.dir/source/ctr_texture_pack.o(.text.CtrPacked_read)
    . += (ABSOLUTE(.) < ABSOLUTE(0x180908)) ? ABSOLUTE(0x180908) - ABSOLUTE(.) : 0;
    *ctrport.dir/source/ctr_texture_pack.o(.text.CtrPack_readFile)
    . += (ABSOLUTE(.) < ABSOLUTE(0x180a94)) ? ABSOLUTE(0x180a94) - ABSOLUTE(.) : 0;
    *ctrport.dir/source/ctr_texture_pack.o(.text.findExisting.constprop.0)
    . += (ABSOLUTE(.) < ABSOLUTE(0x180cc8)) ? ABSOLUTE(0x180cc8) - ABSOLUTE(.) : 0;
    *ctrport.dir/source/ctr_texture_pack.o(.text.workerMain)
    . += (ABSOLUTE(.) < ABSOLUTE(0x181334)) ? ABSOLUTE(0x181334) - ABSOLUTE(.) : 0;
    *ctrport.dir/source/ctr_texture_pack.o(.text.CtrPack_isComplete)
    . += (ABSOLUTE(.) < ABSOLUTE(0x181410)) ? ABSOLUTE(0x181410) - ABSOLUTE(.) : 0;
    *ctrport.dir/source/ctr_texture_pack.o(.text.CtrPack_cachePath)
    . += (ABSOLUTE(.) < ABSOLUTE(0x181438)) ? ABSOLUTE(0x181438) - ABSOLUTE(.) : 0;
    *ctrport.dir/source/ctr_texture_pack.o(.text.CtrPack_makeCacheDir)
    . += (ABSOLUTE(.) < ABSOLUTE(0x18144c)) ? ABSOLUTE(0x18144c) - ABSOLUTE(.) : 0;
    *ctrport.dir/source/ctr_texture_pack.o(.text.CtrPack_removeFile)
    . += (ABSOLUTE(.) < ABSOLUTE(0x1814b4)) ? ABSOLUTE(0x1814b4) - ABSOLUTE(.) : 0;
    *ctrport.dir/source/ctr_texture_pack.o(.text.CtrPack_forgetCache)
    . += (ABSOLUTE(.) < ABSOLUTE(0x181560)) ? ABSOLUTE(0x181560) - ABSOLUTE(.) : 0;
    *ctrport.dir/source/ctr_texture_pack.o(.text.CtrPack_sdWriteTest)
    . += (ABSOLUTE(.) < ABSOLUTE(0x18189c)) ? ABSOLUTE(0x18189c) - ABSOLUTE(.) : 0;
    *ctrport.dir/source/ctr_texture_pack.o(.text.CtrPackWorker_setUseSyscore)
    . += (ABSOLUTE(.) < ABSOLUTE(0x1818ac)) ? ABSOLUTE(0x1818ac) - ABSOLUTE(.) : 0;
    *ctrport.dir/source/ctr_texture_pack.o(.text.CtrPackWorker_start)
    . += (ABSOLUTE(.) < ABSOLUTE(0x181de8)) ? ABSOLUTE(0x181de8) - ABSOLUTE(.) : 0;
    *ctrport.dir/source/ctr_texture_pack.o(.text.CtrPackWorker_progress)
    . += (ABSOLUTE(.) < ABSOLUTE(0x181e2c)) ? ABSOLUTE(0x181e2c) - ABSOLUTE(.) : 0;
    *ctrport.dir/source/ctr_texture_pack.o(.text.CtrPackWorker_memoryStats)
    . += (ABSOLUTE(.) < ABSOLUTE(0x181e6c)) ? ABSOLUTE(0x181e6c) - ABSOLUTE(.) : 0;
    *ctrport.dir/source/ctr_texture_pack.o(.text.CtrPackWorker_threadCount)
    . += (ABSOLUTE(.) < ABSOLUTE(0x181e74)) ? ABSOLUTE(0x181e74) - ABSOLUTE(.) : 0;
    *ctrport.dir/source/ctr_texture_pack.o(.text.CtrPackWorker_poll)
    . += (ABSOLUTE(.) < ABSOLUTE(0x181ed0)) ? ABSOLUTE(0x181ed0) - ABSOLUTE(.) : 0;
    *ctrport.dir/source/ctr_texture_pack.o(.text.CtrPackWorker_hurry)
    . += (ABSOLUTE(.) < ABSOLUTE(0x181ee8)) ? ABSOLUTE(0x181ee8) - ABSOLUTE(.) : 0;
    *ctrport.dir/source/ctr_texture_pack.o(.text.CtrPackWorker_setKeepPacked)
    . += (ABSOLUTE(.) < ABSOLUTE(0x181ef0)) ? ABSOLUTE(0x181ef0) - ABSOLUTE(.) : 0;
    *ctrport.dir/source/ctr_texture_pack.o(.text.CtrPackWorker_stop)
    . += (ABSOLUTE(.) < ABSOLUTE(0x182168)) ? ABSOLUTE(0x182168) - ABSOLUTE(.) : 0;
    *ctrport.dir/source/ctr_texture_pack_screen.o(.text.drawCentered)
    . += (ABSOLUTE(.) < ABSOLUTE(0x18238c)) ? ABSOLUTE(0x18238c) - ABSOLUTE(.) : 0;
    *ctrport.dir/source/ctr_texture_pack_screen.o(.text.drawEye)
    . += (ABSOLUTE(.) < ABSOLUTE(0x1828d0)) ? ABSOLUTE(0x1828d0) - ABSOLUTE(.) : 0;
    *ctrport.dir/source/ctr_texture_pack_screen.o(.text.CtrPackScreen_run)
    . += (ABSOLUTE(.) < ABSOLUTE(0x183124)) ? ABSOLUTE(0x183124) - ABSOLUTE(.) : 0;
    *ctrport.dir/source/ctr_textures.o(.text.idleForPromotion)
    . += (ABSOLUTE(.) < ABSOLUTE(0x183240)) ? ABSOLUTE(0x183240) - ABSOLUTE(.) : 0;
    *ctrport.dir/source/ctr_textures.o(.text.mayRead)
    . += (ABSOLUTE(.) < ABSOLUTE(0x1832bc)) ? ABSOLUTE(0x1832bc) - ABSOLUTE(.) : 0;
    *ctrport.dir/source/ctr_textures.o(.text.anyRequestedMissing)
    . += (ABSOLUTE(.) < ABSOLUTE(0x18335c)) ? ABSOLUTE(0x18335c) - ABSOLUTE(.) : 0;
    *ctrport.dir/source/ctr_textures.o(.text.clearRequested)
    . += (ABSOLUTE(.) < ABSOLUTE(0x183390)) ? ABSOLUTE(0x183390) - ABSOLUTE(.) : 0;
    *ctrport.dir/source/ctr_textures.o(.text.dropMirror)
    . += (ABSOLUTE(.) < ABSOLUTE(0x183418)) ? ABSOLUTE(0x183418) - ABSOLUTE(.) : 0;
    *ctrport.dir/source/ctr_textures.o(.text.saveRoomMemory)
    . += (ABSOLUTE(.) < ABSOLUTE(0x183610)) ? ABSOLUTE(0x183610) - ABSOLUTE(.) : 0;
    *ctrport.dir/source/ctr_textures.o(.text.cacheFile)
    . += (ABSOLUTE(.) < ABSOLUTE(0x183828)) ? ABSOLUTE(0x183828) - ABSOLUTE(.) : 0;
    *ctrport.dir/source/ctr_textures.o(.text.describeSteps)
    . += (ABSOLUTE(.) < ABSOLUTE(0x183990)) ? ABSOLUTE(0x183990) - ABSOLUTE(.) : 0;
    *ctrport.dir/source/ctr_textures.o(.text.pageImage.constprop.0)
    . += (ABSOLUTE(.) < ABSOLUTE(0x183a4c)) ? ABSOLUTE(0x183a4c) - ABSOLUTE(.) : 0;
    *ctrport.dir/source/ctr_textures.o(.text.oldestEvictable.constprop.0)
    . += (ABSOLUTE(.) < ABSOLUTE(0x183b34)) ? ABSOLUTE(0x183b34) - ABSOLUTE(.) : 0;
    *ctrport.dir/source/ctr_textures.o(.text.loadRoomMemory)
    . += (ABSOLUTE(.) < ABSOLUTE(0x183e38)) ? ABSOLUTE(0x183e38) - ABSOLUTE(.) : 0;
    *ctrport.dir/source/ctr_textures.o(.text.logLoad.isra.0)
    . += (ABSOLUTE(.) < ABSOLUTE(0x183eb4)) ? ABSOLUTE(0x183eb4) - ABSOLUTE(.) : 0;
    *ctrport.dir/source/ctr_textures.o(.text.initTile.isra.0)
    . += (ABSOLUTE(.) < ABSOLUTE(0x183f14)) ? ABSOLUTE(0x183f14) - ABSOLUTE(.) : 0;
    *ctrport.dir/source/ctr_textures.o(.text.finishRecording)
    . += (ABSOLUTE(.) < ABSOLUTE(0x184194)) ? ABSOLUTE(0x184194) - ABSOLUTE(.) : 0;
    *ctrport.dir/source/ctr_textures.o(.text.setLayout)
    . += (ABSOLUTE(.) < ABSOLUTE(0x184240)) ? ABSOLUTE(0x184240) - ABSOLUTE(.) : 0;
    *ctrport.dir/source/ctr_textures.o(.text.takeView)
    . += (ABSOLUTE(.) < ABSOLUTE(0x1843bc)) ? ABSOLUTE(0x1843bc) - ABSOLUTE(.) : 0;
    *ctrport.dir/source/ctr_textures.o(.text.layoutFromDataWin.isra.0)
    . += (ABSOLUTE(.) < ABSOLUTE(0x184470)) ? ABSOLUTE(0x184470) - ABSOLUTE(.) : 0;
    *ctrport.dir/source/ctr_textures.o(.text.shedCacheFiles)
    . += (ABSOLUTE(.) < ABSOLUTE(0x1844a0)) ? ABSOLUTE(0x1844a0) - ABSOLUTE(.) : 0;
    *ctrport.dir/source/ctr_textures.o(.text.evictUsedBefore)
    . += (ABSOLUTE(.) < ABSOLUTE(0x18465c)) ? ABSOLUTE(0x18465c) - ABSOLUTE(.) : 0;
    *ctrport.dir/source/ctr_textures.o(.text.evictTile)
    . += (ABSOLUTE(.) < ABSOLUTE(0x184708)) ? ABSOLUTE(0x184708) - ABSOLUTE(.) : 0;
    *ctrport.dir/source/ctr_textures.o(.text.loadImageLayout)
    . += (ABSOLUTE(.) < ABSOLUTE(0x184854)) ? ABSOLUTE(0x184854) - ABSOLUTE(.) : 0;
    *ctrport.dir/source/ctr_textures.o(.text.CtrTextures_takeHot)
    . += (ABSOLUTE(.) < ABSOLUTE(0x184894)) ? ABSOLUTE(0x184894) - ABSOLUTE(.) : 0;
    *ctrport.dir/source/ctr_textures.o(.text.CtrTextures_addMirror)
    . += (ABSOLUTE(.) < ABSOLUTE(0x184958)) ? ABSOLUTE(0x184958) - ABSOLUTE(.) : 0;
    *ctrport.dir/source/ctr_textures.o(.text.CtrTextures_noteMirrorCopy)
    . += (ABSOLUTE(.) < ABSOLUTE(0x18497c)) ? ABSOLUTE(0x18497c) - ABSOLUTE(.) : 0;
    *ctrport.dir/source/ctr_textures.o(.text.CtrTextures_releaseMirrors)
    . += (ABSOLUTE(.) < ABSOLUTE(0x184a04)) ? ABSOLUTE(0x184a04) - ABSOLUTE(.) : 0;
    *ctrport.dir/source/ctr_textures.o(.text.CtrTextures_forgetRoomMemory)
    . += (ABSOLUTE(.) < ABSOLUTE(0x184a5c)) ? ABSOLUTE(0x184a5c) - ABSOLUTE(.) : 0;
    *ctrport.dir/source/ctr_textures.o(.text.CtrTextures_hashTexels)
    . += (ABSOLUTE(.) < ABSOLUTE(0x184ab0)) ? ABSOLUTE(0x184ab0) - ABSOLUTE(.) : 0;
    *ctrport.dir/source/ctr_textures.o(.text.CtrTextures_roomThrashing)
    . += (ABSOLUTE(.) < ABSOLUTE(0x184ab8)) ? ABSOLUTE(0x184ab8) - ABSOLUTE(.) : 0;
    *ctrport.dir/source/ctr_textures.o(.text.CtrTextures_forgiveThrashing)
    . += (ABSOLUTE(.) < ABSOLUTE(0x184ac4)) ? ABSOLUTE(0x184ac4) - ABSOLUTE(.) : 0;
    *ctrport.dir/source/ctr_textures.o(.text.CtrTextures_lendBudget)
    . += (ABSOLUTE(.) < ABSOLUTE(0x184b3c)) ? ABSOLUTE(0x184b3c) - ABSOLUTE(.) : 0;
    *ctrport.dir/source/ctr_textures.o(.text.CtrTextures_returnBudget)
    . += (ABSOLUTE(.) < ABSOLUTE(0x184b50)) ? ABSOLUTE(0x184b50) - ABSOLUTE(.) : 0;
    *ctrport.dir/source/ctr_textures.o(.text.CtrTextures_init)
    . += (ABSOLUTE(.) < ABSOLUTE(0x184d74)) ? ABSOLUTE(0x184d74) - ABSOLUTE(.) : 0;
    *ctrport.dir/source/ctr_textures.o(.text.CtrTextures_evictOldestIdle)
    . += (ABSOLUTE(.) < ABSOLUTE(0x184e70)) ? ABSOLUTE(0x184e70) - ABSOLUTE(.) : 0;
    *ctrport.dir/source/ctr_textures.o(.text.CtrTextures_evictOldest)
    . += (ABSOLUTE(.) < ABSOLUTE(0x184e78)) ? ABSOLUTE(0x184e78) - ABSOLUTE(.) : 0;
    *ctrport.dir/source/ctr_textures.o(.text.allocateTile)
    . += (ABSOLUTE(.) < ABSOLUTE(0x185198)) ? ABSOLUTE(0x185198) - ABSOLUTE(.) : 0;
    *ctrport.dir/source/ctr_textures.o(.text.settleRead)
    . += (ABSOLUTE(.) < ABSOLUTE(0x1852b8)) ? ABSOLUTE(0x1852b8) - ABSOLUTE(.) : 0;
    *ctrport.dir/source/ctr_textures.o(.text.releaseRead)
    . += (ABSOLUTE(.) < ABSOLUTE(0x1853d0)) ? ABSOLUTE(0x1853d0) - ABSOLUTE(.) : 0;
    *ctrport.dir/source/ctr_textures.o(.text.loadPackInfo.part.0)
    . += (ABSOLUTE(.) < ABSOLUTE(0x1856d8)) ? ABSOLUTE(0x1856d8) - ABSOLUTE(.) : 0;
    *ctrport.dir/source/ctr_textures.o(.text.relieveFailedAlloc)
    . += (ABSOLUTE(.) < ABSOLUTE(0x185894)) ? ABSOLUTE(0x185894) - ABSOLUTE(.) : 0;
    *ctrport.dir/source/ctr_textures.o(.text.keepPacked)
    . += (ABSOLUTE(.) < ABSOLUTE(0x185a00)) ? ABSOLUTE(0x185a00) - ABSOLUTE(.) : 0;
    *ctrport.dir/source/ctr_textures.o(.text.collectWholeRead)
    . += (ABSOLUTE(.) < ABSOLUTE(0x185b20)) ? ABSOLUTE(0x185b20) - ABSOLUTE(.) : 0;
    *ctrport.dir/source/ctr_textures.o(.text.CtrTextures_stopWorker)
    . += (ABSOLUTE(.) < ABSOLUTE(0x185ba4)) ? ABSOLUTE(0x185ba4) - ABSOLUTE(.) : 0;
    *ctrport.dir/source/ctr_textures.o(.text.CtrTextures_destroy)
    . += (ABSOLUTE(.) < ABSOLUTE(0x185da4)) ? ABSOLUTE(0x185da4) - ABSOLUTE(.) : 0;
    *ctrport.dir/source/ctr_textures.o(.text.distrustPack)
    . += (ABSOLUTE(.) < ABSOLUTE(0x185e80)) ? ABSOLUTE(0x185e80) - ABSOLUTE(.) : 0;
    *ctrport.dir/source/ctr_textures.o(.text.reserveForRead)
    . += (ABSOLUTE(.) < ABSOLUTE(0x185f74)) ? ABSOLUTE(0x185f74) - ABSOLUTE(.) : 0;
    *ctrport.dir/source/ctr_textures.o(.text.queueDecode.part.0)
    . += (ABSOLUTE(.) < ABSOLUTE(0x1861a4)) ? ABSOLUTE(0x1861a4) - ABSOLUTE(.) : 0;
    *ctrport.dir/source/ctr_textures.o(.text.queueRead)
    . += (ABSOLUTE(.) < ABSOLUTE(0x186310)) ? ABSOLUTE(0x186310) - ABSOLUTE(.) : 0;
    *ctrport.dir/source/ctr_textures.o(.text.installTile)
    . += (ABSOLUTE(.) < ABSOLUTE(0x18651c)) ? ABSOLUTE(0x18651c) - ABSOLUTE(.) : 0;
    *ctrport.dir/source/ctr_textures.o(.text.loadFromPacked)
    . += (ABSOLUTE(.) < ABSOLUTE(0x1865d8)) ? ABSOLUTE(0x1865d8) - ABSOLUTE(.) : 0;
    *ctrport.dir/source/ctr_textures.o(.text.loadRequestedFrom)
    . += (ABSOLUTE(.) < ABSOLUTE(0x1876ac)) ? ABSOLUTE(0x1876ac) - ABSOLUTE(.) : 0;
    HIDDEN(__hotpin_34 = ABSOLUTE(.));
    *ctrport.dir/source/ctr_textures.o(.text.CtrTextures_ensureTilesBut.part.0)
    . += (ABSOLUTE(.) < ABSOLUTE(0x187978)) ? ABSOLUTE(0x187978) - ABSOLUTE(.) : 0;
    *ctrport.dir/source/ctr_textures.o(.text.loadImageRow)
    . += (ABSOLUTE(.) < ABSOLUTE(0x187e38)) ? ABSOLUTE(0x187e38) - ABSOLUTE(.) : 0;
    *ctrport.dir/source/ctr_textures.o(.text.readAhead.part.0)
    . += (ABSOLUTE(.) < ABSOLUTE(0x188230)) ? ABSOLUTE(0x188230) - ABSOLUTE(.) : 0;
    *ctrport.dir/source/ctr_textures.o(.text.CtrTextures_evictLeastRecent)
    . += (ABSOLUTE(.) < ABSOLUTE(0x188364)) ? ABSOLUTE(0x188364) - ABSOLUTE(.) : 0;
    *ctrport.dir/source/ctr_textures.o(.text.CtrTextures_acquire)
    . += (ABSOLUTE(.) < ABSOLUTE(0x188438)) ? ABSOLUTE(0x188438) - ABSOLUTE(.) : 0;
    *ctrport.dir/source/ctr_textures.o(.text.markTpag)
    . += (ABSOLUTE(.) < ABSOLUTE(0x188624)) ? ABSOLUTE(0x188624) - ABSOLUTE(.) : 0;
    *ctrport.dir/source/ctr_textures.o(.text.markSprite)
    . += (ABSOLUTE(.) < ABSOLUTE(0x1886b4)) ? ABSOLUTE(0x1886b4) - ABSOLUTE(.) : 0;
    *ctrport.dir/source/ctr_textures.o(.text.markInstances)
    . += (ABSOLUTE(.) < ABSOLUTE(0x188788)) ? ABSOLUTE(0x188788) - ABSOLUTE(.) : 0;
    *ctrport.dir/source/ctr_textures.o(.text.CtrTextures_beginFrame)
    . += (ABSOLUTE(.) < ABSOLUTE(0x189774)) ? ABSOLUTE(0x189774) - ABSOLUTE(.) : 0;
    *ctrport.dir/source/ctr_textures.o(.text.markTiles.part.0)
    . += (ABSOLUTE(.) < ABSOLUTE(0x1897f8)) ? ABSOLUTE(0x1897f8) - ABSOLUTE(.) : 0;
    *ctrport.dir/source/ctr_textures.o(.text.CtrTextures_ensureTiles)
    . += (ABSOLUTE(.) < ABSOLUTE(0x189850)) ? ABSOLUTE(0x189850) - ABSOLUTE(.) : 0;
    HIDDEN(__hotpin_35 = ABSOLUTE(.));
    *ctrport.dir/source/ctr_textures.o(.text.CtrTextures_ensureTilesBut)
    . += (ABSOLUTE(.) < ABSOLUTE(0x189888)) ? ABSOLUTE(0x189888) - ABSOLUTE(.) : 0;
    *ctrport.dir/source/ctr_textures.o(.text.CtrTextures_prefetchRoom)
    . += (ABSOLUTE(.) < ABSOLUTE(0x189f90)) ? ABSOLUTE(0x189f90) - ABSOLUTE(.) : 0;
    *ctrport.dir/source/ctr_textures.o(.text.CtrTextures_logStats)
    . += (ABSOLUTE(.) < ABSOLUTE(0x18a144)) ? ABSOLUTE(0x18a144) - ABSOLUTE(.) : 0;
    *ctrport.dir/source/ctr_tile_reader.o(.text.wakeReader)
    . += (ABSOLUTE(.) < ABSOLUTE(0x18a14c)) ? ABSOLUTE(0x18a14c) - ABSOLUTE(.) : 0;
    *ctrport.dir/source/ctr_tile_reader.o(.text.closeFiles)
    . += (ABSOLUTE(.) < ABSOLUTE(0x18a1dc)) ? ABSOLUTE(0x18a1dc) - ABSOLUTE(.) : 0;
    *ctrport.dir/source/ctr_tile_reader.o(.text.shedFiles)
    . += (ABSOLUTE(.) < ABSOLUTE(0x18a1e0)) ? ABSOLUTE(0x18a1e0) - ABSOLUTE(.) : 0;
    *ctrport.dir/source/ctr_tile_reader.o(.text.writeWhole)
    . += (ABSOLUTE(.) < ABSOLUTE(0x18a288)) ? ABSOLUTE(0x18a288) - ABSOLUTE(.) : 0;
    *ctrport.dir/source/ctr_tile_reader.o(.text.handOn)
    . += (ABSOLUTE(.) < ABSOLUTE(0x18a3c0)) ? ABSOLUTE(0x18a3c0) - ABSOLUTE(.) : 0;
    *ctrport.dir/source/ctr_tile_reader.o(.text.decoderMain)
    . += (ABSOLUTE(.) < ABSOLUTE(0x18a64c)) ? ABSOLUTE(0x18a64c) - ABSOLUTE(.) : 0;
    *ctrport.dir/source/ctr_tile_reader.o(.text.perform.part.0.constprop.0)
    . += (ABSOLUTE(.) < ABSOLUTE(0x18aa2c)) ? ABSOLUTE(0x18aa2c) - ABSOLUTE(.) : 0;
    *ctrport.dir/source/ctr_tile_reader.o(.text.readerMain)
    . += (ABSOLUTE(.) < ABSOLUTE(0x18accc)) ? ABSOLUTE(0x18accc) - ABSOLUTE(.) : 0;
    *ctrport.dir/source/ctr_tile_reader.o(.text.CtrTileReader_heapReserve)
    . += (ABSOLUTE(.) < ABSOLUTE(0x18acd4)) ? ABSOLUTE(0x18acd4) - ABSOLUTE(.) : 0;
    *ctrport.dir/source/ctr_tile_reader.o(.text.CtrTileReader_tileData)
    . += (ABSOLUTE(.) < ABSOLUTE(0x18ad04)) ? ABSOLUTE(0x18ad04) - ABSOLUTE(.) : 0;
    *ctrport.dir/source/ctr_tile_reader.o(.text.CtrTileReader_start)
    . += (ABSOLUTE(.) < ABSOLUTE(0x18ae1c)) ? ABSOLUTE(0x18ae1c) - ABSOLUTE(.) : 0;
    *ctrport.dir/source/ctr_tile_reader.o(.text.CtrTileReader_stop)
    . += (ABSOLUTE(.) < ABSOLUTE(0x18af68)) ? ABSOLUTE(0x18af68) - ABSOLUTE(.) : 0;
    *ctrport.dir/source/ctr_tile_reader.o(.text.CtrTileReader_decodes)
    . += (ABSOLUTE(.) < ABSOLUTE(0x18af80)) ? ABSOLUTE(0x18af80) - ABSOLUTE(.) : 0;
    *ctrport.dir/source/ctr_tile_reader.o(.text.CtrTileReader_writeFile)
    . += (ABSOLUTE(.) < ABSOLUTE(0x18afdc)) ? ABSOLUTE(0x18afdc) - ABSOLUTE(.) : 0;
    *ctrport.dir/source/ctr_tile_reader.o(.text.CtrTileReader_newRead)
    . += (ABSOLUTE(.) < ABSOLUTE(0x18b014)) ? ABSOLUTE(0x18b014) - ABSOLUTE(.) : 0;
    *ctrport.dir/source/ctr_tile_reader.o(.text.CtrTileReader_queue)
    . += (ABSOLUTE(.) < ABSOLUTE(0x18b074)) ? ABSOLUTE(0x18b074) - ABSOLUTE(.) : 0;
    *ctrport.dir/source/ctr_tile_reader.o(.text.CtrTileReader_queueDecode)
    . += (ABSOLUTE(.) < ABSOLUTE(0x18b0f8)) ? ABSOLUTE(0x18b0f8) - ABSOLUTE(.) : 0;
    *ctrport.dir/source/ctr_tile_reader.o(.text.CtrTileReader_finished)
    . += (ABSOLUTE(.) < ABSOLUTE(0x18b13c)) ? ABSOLUTE(0x18b13c) - ABSOLUTE(.) : 0;
    *ctrport.dir/source/ctr_tile_reader.o(.text.CtrTileReader_addTile)
    . += (ABSOLUTE(.) < ABSOLUTE(0x18b1b4)) ? ABSOLUTE(0x18b1b4) - ABSOLUTE(.) : 0;
    *ctrport.dir/source/ctr_tile_reader.o(.text.CtrTileReader_unqueue)
    . += (ABSOLUTE(.) < ABSOLUTE(0x18b270)) ? ABSOLUTE(0x18b270) - ABSOLUTE(.) : 0;
    *ctrport.dir/source/ctr_tile_reader.o(.text.CtrTileReader_wait)
    . += (ABSOLUTE(.) < ABSOLUTE(0x18b4cc)) ? ABSOLUTE(0x18b4cc) - ABSOLUTE(.) : 0;
    *ctrport.dir/source/ctr_tile_reader.o(.text.CtrTileReader_release)
    . += (ABSOLUTE(.) < ABSOLUTE(0x18b658)) ? ABSOLUTE(0x18b658) - ABSOLUTE(.) : 0;
    *ctrport.dir/source/ctr_video.o(.text.ctrVideoInit)
    . += (ABSOLUTE(.) < ABSOLUTE(0x18b660)) ? ABSOLUTE(0x18b660) - ABSOLUTE(.) : 0;
    *ctrport.dir/source/ctr_video.o(.text.ctrVideoQuit)
    . += (ABSOLUTE(.) < ABSOLUTE(0x18b664)) ? ABSOLUTE(0x18b664) - ABSOLUTE(.) : 0;
    *ctrport.dir/source/ctr_video.o(.text.ctrVideoExtractAudio)
    . += (ABSOLUTE(.) < ABSOLUTE(0x18b66c)) ? ABSOLUTE(0x18b66c) - ABSOLUTE(.) : 0;
    *ctrport.dir/source/ctr_video.o(.text.ctrVideoAudioInFile)
    . += (ABSOLUTE(.) < ABSOLUTE(0x18b680)) ? ABSOLUTE(0x18b680) - ABSOLUTE(.) : 0;
    *ctrport.dir/source/ctr_video.o(.text.ctrVideoIsPaused)
    . += (ABSOLUTE(.) < ABSOLUTE(0x18b68c)) ? ABSOLUTE(0x18b68c) - ABSOLUTE(.) : 0;
    *ctrport.dir/source/ctr_video.o(.text.ctrVideoDuration)
    . += (ABSOLUTE(.) < ABSOLUTE(0x18b698)) ? ABSOLUTE(0x18b698) - ABSOLUTE(.) : 0;
    *ctrport.dir/source/ctr_video.o(.text.ctrVideoWidth)
    . += (ABSOLUTE(.) < ABSOLUTE(0x18b6a4)) ? ABSOLUTE(0x18b6a4) - ABSOLUTE(.) : 0;
    *ctrport.dir/source/ctr_video.o(.text.ctrVideoHeight)
    . += (ABSOLUTE(.) < ABSOLUTE(0x18b6b0)) ? ABSOLUTE(0x18b6b0) - ABSOLUTE(.) : 0;
    *ctrport.dir/source/ctr_video.o(.text.tickClock)
    . += (ABSOLUTE(.) < ABSOLUTE(0x18b8f8)) ? ABSOLUTE(0x18b8f8) - ABSOLUTE(.) : 0;
    *ctrport.dir/source/ctr_video.o(.text.ctrVideoPosition)
    . += (ABSOLUTE(.) < ABSOLUTE(0x18b948)) ? ABSOLUTE(0x18b948) - ABSOLUTE(.) : 0;
    *ctrport.dir/source/ctr_video.o(.text.ctrVideoSetMasterClock)
    . += (ABSOLUTE(.) < ABSOLUTE(0x18ba4c)) ? ABSOLUTE(0x18ba4c) - ABSOLUTE(.) : 0;
    *ctrport.dir/source/ctr_video.o(.text.ctrVideoResume)
    . += (ABSOLUTE(.) < ABSOLUTE(0x18ba78)) ? ABSOLUTE(0x18ba78) - ABSOLUTE(.) : 0;
    *ctrport.dir/source/ctr_video.o(.text.ctrVideoPause)
    . += (ABSOLUTE(.) < ABSOLUTE(0x18baa0)) ? ABSOLUTE(0x18baa0) - ABSOLUTE(.) : 0;
    *ctrport.dir/source/ctr_video.o(.text.ctrVideoIsRunning)
    . += (ABSOLUTE(.) < ABSOLUTE(0x18bae8)) ? ABSOLUTE(0x18bae8) - ABSOLUTE(.) : 0;
    *ctrport.dir/source/ctr_video.o(.text.ctrVideoCreateSurface)
    . += (ABSOLUTE(.) < ABSOLUTE(0x18bb7c)) ? ABSOLUTE(0x18bb7c) - ABSOLUTE(.) : 0;
    *ctrport.dir/source/ctr_video.o(.text.paintStack)
    . += (ABSOLUTE(.) < ABSOLUTE(0x18bba8)) ? ABSOLUTE(0x18bba8) - ABSOLUTE(.) : 0;
    *ctrport.dir/source/ctr_video.o(.text.trace)
    . += (ABSOLUTE(.) < ABSOLUTE(0x18bbec)) ? ABSOLUTE(0x18bbec) - ABSOLUTE(.) : 0;
    *ctrport.dir/source/ctr_video.o(.text.post)
    . += (ABSOLUTE(.) < ABSOLUTE(0x18bc78)) ? ABSOLUTE(0x18bc78) - ABSOLUTE(.) : 0;
    *ctrport.dir/source/ctr_video.o(.text.flushMessages)
    . += (ABSOLUTE(.) < ABSOLUTE(0x18bd18)) ? ABSOLUTE(0x18bd18) - ABSOLUTE(.) : 0;
    *ctrport.dir/source/ctr_video.o(.text.ctrVideoUpdate)
    . += (ABSOLUTE(.) < ABSOLUTE(0x18c254)) ? ABSOLUTE(0x18c254) - ABSOLUTE(.) : 0;
    *ctrport.dir/source/ctr_video.o(.text.freeBuffers)
    . += (ABSOLUTE(.) < ABSOLUTE(0x18c2b8)) ? ABSOLUTE(0x18c2b8) - ABSOLUTE(.) : 0;
    *ctrport.dir/source/ctr_video.o(.text.ctrVideoClose)
    . += (ABSOLUTE(.) < ABSOLUTE(0x18c548)) ? ABSOLUTE(0x18c548) - ABSOLUTE(.) : 0;
    *ctrport.dir/source/ctr_video.o(.text.armSlot)
    . += (ABSOLUTE(.) < ABSOLUTE(0x18c5e0)) ? ABSOLUTE(0x18c5e0) - ABSOLUTE(.) : 0;
    *ctrport.dir/source/ctr_video.o(.text.publishSlot)
    . += (ABSOLUTE(.) < ABSOLUTE(0x18c9d0)) ? ABSOLUTE(0x18c9d0) - ABSOLUTE(.) : 0;
    *ctrport.dir/source/ctr_video.o(.text.acquireSlot.part.0)
    . += (ABSOLUTE(.) < ABSOLUTE(0x18caa8)) ? ABSOLUTE(0x18caa8) - ABSOLUTE(.) : 0;
    *ctrport.dir/source/ctr_video.o(.text.noticeLine.constprop.0)
    . += (ABSOLUTE(.) < ABSOLUTE(0x18cb6c)) ? ABSOLUTE(0x18cb6c) - ABSOLUTE(.) : 0;
    *ctrport.dir/source/ctr_video.o(.text.ctrVideoDraw)
    . += (ABSOLUTE(.) < ABSOLUTE(0x18d01c)) ? ABSOLUTE(0x18d01c) - ABSOLUTE(.) : 0;
    *ctrport.dir/source/ctr_video.o(.text.ctrVideoSetLoop)
    . += (ABSOLUTE(.) < ABSOLUTE(0x18d048)) ? ABSOLUTE(0x18d048) - ABSOLUTE(.) : 0;
    *ctrport.dir/source/ctr_video.o(.text.renderInto)
    . += (ABSOLUTE(.) < ABSOLUTE(0x18d1c0)) ? ABSOLUTE(0x18d1c0) - ABSOLUTE(.) : 0;
    *ctrport.dir/source/ctr_video.o(.text.onVideoAptEvent)
    . += (ABSOLUTE(.) < ABSOLUTE(0x18d2ac)) ? ABSOLUTE(0x18d2ac) - ABSOLUTE(.) : 0;
    *ctrport.dir/source/ctr_video.o(.text.readUe)
    . += (ABSOLUTE(.) < ABSOLUTE(0x18d380)) ? ABSOLUTE(0x18d380) - ABSOLUTE(.) : 0;
    *ctrport.dir/source/ctr_video.o(.text.decodeMain)
    . += (ABSOLUTE(.) < ABSOLUTE(0x18e340)) ? ABSOLUTE(0x18e340) - ABSOLUTE(.) : 0;
    *ctrport.dir/source/ctr_video.o(.text.ctrVideoOpen)
    . += (ABSOLUTE(.) < ABSOLUTE(0x18f008)) ? ABSOLUTE(0x18f008) - ABSOLUTE(.) : 0;
    *ctrport.dir/source/ctr_video.o(.text.CtrVideo_setFrameClock)
    . += (ABSOLUTE(.) < ABSOLUTE(0x18f018)) ? ABSOLUTE(0x18f018) - ABSOLUTE(.) : 0;
    *ctrport.dir/source/ctr_video.o(.text.CtrVideo_debugSuspend)
    . += (ABSOLUTE(.) < ABSOLUTE(0x18f118)) ? ABSOLUTE(0x18f118) - ABSOLUTE(.) : 0;
    *ctrport.dir/source/ctr_video.o(.text.VideoDecoder_createBackend)
    . += (ABSOLUTE(.) < ABSOLUTE(0x18f184)) ? ABSOLUTE(0x18f184) - ABSOLUTE(.) : 0;
    *ctrport.dir/source/ctr_watchdog.o(.text.put)
    . += (ABSOLUTE(.) < ABSOLUTE(0x18f200)) ? ABSOLUTE(0x18f200) - ABSOLUTE(.) : 0;
    *ctrport.dir/source/ctr_watchdog.o(.text.writeReport)
    . += (ABSOLUTE(.) < ABSOLUTE(0x18f648)) ? ABSOLUTE(0x18f648) - ABSOLUTE(.) : 0;
    *ctrport.dir/source/ctr_watchdog.o(.text.watchdogMain)
    . += (ABSOLUTE(.) < ABSOLUTE(0x18f758)) ? ABSOLUTE(0x18f758) - ABSOLUTE(.) : 0;
    *ctrport.dir/source/ctr_watchdog.o(.text.onAptEvent)
    . += (ABSOLUTE(.) < ABSOLUTE(0x18f808)) ? ABSOLUTE(0x18f808) - ABSOLUTE(.) : 0;
    HIDDEN(__hotpin_36 = ABSOLUTE(.));
    *ctrport.dir/source/ctr_watchdog.o(.text.__wrap___malloc_lock)
    . += (ABSOLUTE(.) < ABSOLUTE(0x18f844)) ? ABSOLUTE(0x18f844) - ABSOLUTE(.) : 0;
    HIDDEN(__hotpin_37 = ABSOLUTE(.));
    *ctrport.dir/source/ctr_watchdog.o(.text.__wrap___malloc_unlock)
    . += (ABSOLUTE(.) < ABSOLUTE(0x18f860)) ? ABSOLUTE(0x18f860) - ABSOLUTE(.) : 0;
    *ctrport.dir/source/ctr_watchdog.o(.text.CtrWatchdog_stop)
    . += (ABSOLUTE(.) < ABSOLUTE(0x18f8cc)) ? ABSOLUTE(0x18f8cc) - ABSOLUTE(.) : 0;
    *ctrport.dir/source/ctr_watchdog.o(.text.CtrWatchdog_watch)
    . += (ABSOLUTE(.) < ABSOLUTE(0x18f8e8)) ? ABSOLUTE(0x18f8e8) - ABSOLUTE(.) : 0;
    *ctrport.dir/source/ctr_watchdog.o(.text.CtrWatchdog_mark)
    . += (ABSOLUTE(.) < ABSOLUTE(0x18f944)) ? ABSOLUTE(0x18f944) - ABSOLUTE(.) : 0;
    *ctrport.dir/source/ctr_watchdog.o(.text.CtrWatchdog_nameThread)
    . += (ABSOLUTE(.) < ABSOLUTE(0x18fa18)) ? ABSOLUTE(0x18fa18) - ABSOLUTE(.) : 0;
    *ctrport.dir/source/ctr_watchdog.o(.text.CtrWatchdog_start)
    . += (ABSOLUTE(.) < ABSOLUTE(0x18fb74)) ? ABSOLUTE(0x18fb74) - ABSOLUTE(.) : 0;
    *ctrport.dir/source/ctr_watchdog.o(.text.CtrWatchdog_progress)
    . += (ABSOLUTE(.) < ABSOLUTE(0x18fb84)) ? ABSOLUTE(0x18fb84) - ABSOLUTE(.) : 0;
    *ctrport.dir/source/ctr_watchdog.o(.text.CtrWatchdog_watching)
    . += (ABSOLUTE(.) < ABSOLUTE(0x18fba0)) ? ABSOLUTE(0x18fba0) - ABSOLUTE(.) : 0;
    *ctrport.dir/source/ctr_watchdog.o(.text.CtrWatchdog_phase)
    . += (ABSOLUTE(.) < ABSOLUTE(0x18fbb0)) ? ABSOLUTE(0x18fbb0) - ABSOLUTE(.) : 0;
    *ctrport.dir/source/ctr_watchdog.o(.text.CtrWatchdog_threadNameOf)
    . += (ABSOLUTE(.) < ABSOLUTE(0x18fc08)) ? ABSOLUTE(0x18fc08) - ABSOLUTE(.) : 0;
    *ctrport.dir/source/ctr_watchdog.o(.text.CtrWatchdog_lastReport)
    . += (ABSOLUTE(.) < ABSOLUTE(0x18fc28)) ? ABSOLUTE(0x18fc28) - ABSOLUTE(.) : 0;
    *ctrport.dir/source/ctr_watchdog.o(.text.CtrWatchdog_note)
    . += (ABSOLUTE(.) < ABSOLUTE(0x18fc6c)) ? ABSOLUTE(0x18fc6c) - ABSOLUTE(.) : 0;
    *ctrport.dir/source/main.o(.text.loadTicks)
    . += (ABSOLUTE(.) < ABSOLUTE(0x18fc70)) ? ABSOLUTE(0x18fc70) - ABSOLUTE(.) : 0;
    *ctrport.dir/source/main.o(.text.exitAfterScreen)
    . += (ABSOLUTE(.) < ABSOLUTE(0x18fdc8)) ? ABSOLUTE(0x18fdc8) - ABSOLUTE(.) : 0;
    *ctrport.dir/source/main.o(.text.logMemory)
    . += (ABSOLUTE(.) < ABSOLUTE(0x18fe74)) ? ABSOLUTE(0x18fe74) - ABSOLUTE(.) : 0;
    *ctrport.dir/source/main.o(.text.dataVersionProgress)
    . += (ABSOLUTE(.) < ABSOLUTE(0x18fe80)) ? ABSOLUTE(0x18fe80) - ABSOLUTE(.) : 0;
    *ctrport.dir/source/main.o(.text.loadAutoshotFrames)
    . += (ABSOLUTE(.) < ABSOLUTE(0x18ff30)) ? ABSOLUTE(0x18ff30) - ABSOLUTE(.) : 0;
    *ctrport.dir/source/main.o(.text.osGetMemRegionSize)
    . += (ABSOLUTE(.) < ABSOLUTE(0x18ff44)) ? ABSOLUTE(0x18ff44) - ABSOLUTE(.) : 0;
    *ctrport.dir/source/main.o(.text.setupNotices.part.0)
    *ctrport.dir/source/main.o(.text.fatalScreen)
    *ctrport.dir/source/main.o(.text.outOfMemoryScreen)
    . += (ABSOLUTE(.) < ABSOLUTE(0x1904c8)) ? ABSOLUTE(0x1904c8) - ABSOLUTE(.) : 0;
    *ctrport.dir/source/main.o(.text.allocStringsBuffer)
    . += (ABSOLUTE(.) < ABSOLUTE(0x1904e4)) ? ABSOLUTE(0x1904e4) - ABSOLUTE(.) : 0;
    *ctrport.dir/source/main.o(.text.__wrap_abort)
    . += (ABSOLUTE(.) < ABSOLUTE(0x190520)) ? ABSOLUTE(0x190520) - ABSOLUTE(.) : 0;
    *ctrport.dir/source/main.o(.text.startup.main)
    . += (ABSOLUTE(.) < ABSOLUTE(0x1949ec)) ? ABSOLUTE(0x1949ec) - ABSOLUTE(.) : 0;
    *ctrport.dir/source/stb_impl.o(.text.stbi__refill_buffer)
    . += (ABSOLUTE(.) < ABSOLUTE(0x194a50)) ? ABSOLUTE(0x194a50) - ABSOLUTE(.) : 0;
    *ctrport.dir/source/stb_impl.o(.text.stbi__bitreverse16)
    . += (ABSOLUTE(.) < ABSOLUTE(0x194abc)) ? ABSOLUTE(0x194abc) - ABSOLUTE(.) : 0;
    *ctrport.dir/source/stb_impl.o(.text.stbi__fill_bits)
    . += (ABSOLUTE(.) < ABSOLUTE(0x194b18)) ? ABSOLUTE(0x194b18) - ABSOLUTE(.) : 0;
    *ctrport.dir/source/stb_impl.o(.text.stbi__zhuffman_decode)
    . += (ABSOLUTE(.) < ABSOLUTE(0x194c6c)) ? ABSOLUTE(0x194c6c) - ABSOLUTE(.) : 0;
    *ctrport.dir/source/stb_impl.o(.text.stbi__zbuild_huffman)
    . += (ABSOLUTE(.) < ABSOLUTE(0x194e54)) ? ABSOLUTE(0x194e54) - ABSOLUTE(.) : 0;
    *ctrport.dir/source/stb_impl.o(.text.stbi__vertical_flip)
    . += (ABSOLUTE(.) < ABSOLUTE(0x194f08)) ? ABSOLUTE(0x194f08) - ABSOLUTE(.) : 0;
    *ctrport.dir/source/stb_impl.o(.text.stbi__skip)
    . += (ABSOLUTE(.) < ABSOLUTE(0x194f60)) ? ABSOLUTE(0x194f60) - ABSOLUTE(.) : 0;
    *ctrport.dir/source/stb_impl.o(.text.stbi__create_png_alpha_expand8)
    . += (ABSOLUTE(.) < ABSOLUTE(0x194fe0)) ? ABSOLUTE(0x194fe0) - ABSOLUTE(.) : 0;
    *ctrport.dir/source/stb_impl.o(.text.stbi__zexpand.part.0)
    . += (ABSOLUTE(.) < ABSOLUTE(0x195088)) ? ABSOLUTE(0x195088) - ABSOLUTE(.) : 0;
    *ctrport.dir/source/stb_impl.o(.text.stbi__malloc_mad3.constprop.0)
    . += (ABSOLUTE(.) < ABSOLUTE(0x195128)) ? ABSOLUTE(0x195128) - ABSOLUTE(.) : 0;
    *ctrport.dir/source/stb_impl.o(.text.stbi__create_png_image_raw)
    . += (ABSOLUTE(.) < ABSOLUTE(0x195890)) ? ABSOLUTE(0x195890) - ABSOLUTE(.) : 0;
    *ctrport.dir/source/stb_impl.o(.text.stbi__get16be)
    . += (ABSOLUTE(.) < ABSOLUTE(0x195950)) ? ABSOLUTE(0x195950) - ABSOLUTE(.) : 0;
    *ctrport.dir/source/stb_impl.o(.text.stbi__get32be)
    . += (ABSOLUTE(.) < ABSOLUTE(0x195aac)) ? ABSOLUTE(0x195aac) - ABSOLUTE(.) : 0;
    *ctrport.dir/source/stb_impl.o(.text.stbi__compute_huffman_codes)
    . += (ABSOLUTE(.) < ABSOLUTE(0x195d7c)) ? ABSOLUTE(0x195d7c) - ABSOLUTE(.) : 0;
    *ctrport.dir/source/stb_impl.o(.text.stbi__parse_zlib)
    . += (ABSOLUTE(.) < ABSOLUTE(0x19635c)) ? ABSOLUTE(0x19635c) - ABSOLUTE(.) : 0;
    *ctrport.dir/source/stb_impl.o(.text.stbi_zlib_decode_malloc_guesssize_headerflag)
    . += (ABSOLUTE(.) < ABSOLUTE(0x196410)) ? ABSOLUTE(0x196410) - ABSOLUTE(.) : 0;
    *ctrport.dir/source/stb_impl.o(.text.stbi__parse_png_file)
    . += (ABSOLUTE(.) < ABSOLUTE(0x197610)) ? ABSOLUTE(0x197610) - ABSOLUTE(.) : 0;
    *ctrport.dir/source/stb_impl.o(.text.stbi__do_png)
    . += (ABSOLUTE(.) < ABSOLUTE(0x198be4)) ? ABSOLUTE(0x198be4) - ABSOLUTE(.) : 0;
    *ctrport.dir/source/stb_impl.o(.text.stbi__load_and_postprocess_8bit)
    . += (ABSOLUTE(.) < ABSOLUTE(0x198dd0)) ? ABSOLUTE(0x198dd0) - ABSOLUTE(.) : 0;
    *ctrport.dir/source/stb_impl.o(.text.stbi_load_from_memory)
    /* Engine, vendor and libraries, in link order. */
    . += (ABSOLUTE(.) < ABSOLUTE(0x198e28)) ? ABSOLUTE(0x198e28) - ABSOLUTE(.) : 0;
    HIDDEN(__hotpin_38 = ABSOLUTE(.));
    *(EXCLUDE_FILE(*ctrport.dir/source/*.o) .text.*)
    /* .fini (crti, crtn) where the base had it, at the end of the code; 3dsx.ld puts it at the end of .text. */
    . += (ABSOLUTE(.) < ABSOLUTE(0x306534)) ? ABSOLUTE(0x306534) - ABSOLUTE(.) : 0;
    HIDDEN(__hotpin_39 = ABSOLUTE(.));
    KEEP(*(.fini))
    . += (ABSOLUTE(.) < ABSOLUTE(0x306550)) ? ABSOLUTE(0x306550) - ABSOLUTE(.) : 0;
    HIDDEN(__hotpin_40 = ABSOLUTE(.));
  }
}
INSERT AFTER .text;

SECTIONS
{
  /* New platform code that is not hot, after the frozen late sections. */
  .text.pinrest :
  {
    *ctrport.dir/source/ctr_audio_system.o(.text.blobStreaming)
    *ctrport.dir/source/ctr_renderer.o(.text.ctrApplyProjection)
    *ctrport.dir/source/ctr_renderer.o(.text.skipReleaseRead)
    *ctrport.dir/source/ctr_renderer.o(.text.applyAlphaTest)
    *ctrport.dir/source/ctr_renderer.o(.text.ctrDrawVertex)
    *ctrport.dir/source/ctr_renderer.o(.text.prophecyStageTexture)
    *(.text.*)
  }
}
INSERT AFTER .heapfrag;

/* The hot set must start where it is pinned: growth past the fill stops the link here. */
ASSERT(__hotpin_0 == 0x10a058, "hotpin: ctrUpdate would start past 0x10a058: regenerate the pad or build with -DCTRPORT_HOTPIN=OFF")
ASSERT(__hotpin_1 == 0x127d34, "hotpin: postLine would start past 0x127d34: regenerate the pad or build with -DCTRPORT_HOTPIN=OFF")
ASSERT(__hotpin_2 == 0x1297c8, "hotpin: CtrLz_decompress would start past 0x1297c8: regenerate the pad or build with -DCTRPORT_HOTPIN=OFF")
ASSERT(__hotpin_3 == 0x12a8fc, "hotpin: CtrMemory_calloc would start past 0x12a8fc: regenerate the pad or build with -DCTRPORT_HOTPIN=OFF")
ASSERT(__hotpin_4 == 0x12ada4, "hotpin: __wrap__free_r would start past 0x12ada4: regenerate the pad or build with -DCTRPORT_HOTPIN=OFF")
ASSERT(__hotpin_5 == 0x131f2c, "hotpin: lerpColor would start past 0x131f2c: regenerate the pad or build with -DCTRPORT_HOTPIN=OFF")
ASSERT(__hotpin_6 == 0x1334bc, "hotpin: recordingSurface would start past 0x1334bc: regenerate the pad or build with -DCTRPORT_HOTPIN=OFF")
ASSERT(__hotpin_7 == 0x133f4c, "hotpin: nativeSpans would start past 0x133f4c: regenerate the pad or build with -DCTRPORT_HOTPIN=OFF")
ASSERT(__hotpin_8 == 0x134600, "hotpin: setBlendFunc would start past 0x134600: regenerate the pad or build with -DCTRPORT_HOTPIN=OFF")
ASSERT(__hotpin_9 == 0x1357c8, "hotpin: smartTexelSide.part.0 would start past 0x1357c8: regenerate the pad or build with -DCTRPORT_HOTPIN=OFF")
ASSERT(__hotpin_10 == 0x135868, "hotpin: quadOutsideView.part.0 would start past 0x135868: regenerate the pad or build with -DCTRPORT_HOTPIN=OFF")
ASSERT(__hotpin_11 == 0x136268, "hotpin: smartNote.constprop.0 would start past 0x136268: regenerate the pad or build with -DCTRPORT_HOTPIN=OFF")
ASSERT(__hotpin_12 == 0x1383bc, "hotpin: fontReach would start past 0x1383bc: regenerate the pad or build with -DCTRPORT_HOTPIN=OFF")
ASSERT(__hotpin_13 == 0x138ed8, "hotpin: Renderer_applyProjection would start past 0x138ed8: regenerate the pad or build with -DCTRPORT_HOTPIN=OFF")
ASSERT(__hotpin_14 == 0x139a34, "hotpin: uploadProjection would start past 0x139a34: regenerate the pad or build with -DCTRPORT_HOTPIN=OFF")
ASSERT(__hotpin_15 == 0x139fc8, "hotpin: applyEyeViewport would start past 0x139fc8: regenerate the pad or build with -DCTRPORT_HOTPIN=OFF")
ASSERT(__hotpin_16 == 0x13b5d4, "hotpin: gridSnapQuad.part.0 would start past 0x13b5d4: regenerate the pad or build with -DCTRPORT_HOTPIN=OFF")
ASSERT(__hotpin_17 == 0x13b984, "hotpin: smartSpriteFine.part.0 would start past 0x13b984: regenerate the pad or build with -DCTRPORT_HOTPIN=OFF")
ASSERT(__hotpin_18 == 0x1406f8, "hotpin: replayRecorded would start past 0x1406f8: regenerate the pad or build with -DCTRPORT_HOTPIN=OFF")
ASSERT(__hotpin_19 == 0x14b788, "hotpin: acquireTpagPage would start past 0x14b788: regenerate the pad or build with -DCTRPORT_HOTPIN=OFF")
ASSERT(__hotpin_20 == 0x15231c, "hotpin: flushBatch would start past 0x15231c: regenerate the pad or build with -DCTRPORT_HOTPIN=OFF")
ASSERT(__hotpin_21 == 0x157d30, "hotpin: setViewport would start past 0x157d30: regenerate the pad or build with -DCTRPORT_HOTPIN=OFF")
ASSERT(__hotpin_22 == 0x1590f0, "hotpin: splitFrame would start past 0x1590f0: regenerate the pad or build with -DCTRPORT_HOTPIN=OFF")
ASSERT(__hotpin_23 == 0x159cf8, "hotpin: reserveBatch would start past 0x159cf8: regenerate the pad or build with -DCTRPORT_HOTPIN=OFF")
ASSERT(__hotpin_24 == 0x15c998, "hotpin: emitPageRegion would start past 0x15c998: regenerate the pad or build with -DCTRPORT_HOTPIN=OFF")
ASSERT(__hotpin_25 == 0x15f030, "hotpin: emitQuad would start past 0x15f030: regenerate the pad or build with -DCTRPORT_HOTPIN=OFF")
ASSERT(__hotpin_26 == 0x160bc8, "hotpin: emitPageTiles would start past 0x160bc8: regenerate the pad or build with -DCTRPORT_HOTPIN=OFF")
ASSERT(__hotpin_27 == 0x161800, "hotpin: smartEmitAveraged would start past 0x161800: regenerate the pad or build with -DCTRPORT_HOTPIN=OFF")
ASSERT(__hotpin_28 == 0x162960, "hotpin: emitPageRegionVisible would start past 0x162960: regenerate the pad or build with -DCTRPORT_HOTPIN=OFF")
ASSERT(__hotpin_29 == 0x166354, "hotpin: ctrDrawSprite would start past 0x166354: regenerate the pad or build with -DCTRPORT_HOTPIN=OFF")
ASSERT(__hotpin_30 == 0x167f10, "hotpin: drawTextImpl would start past 0x167f10: regenerate the pad or build with -DCTRPORT_HOTPIN=OFF")
ASSERT(__hotpin_31 == 0x16b280, "hotpin: ctrDrawSpritePartColor would start past 0x16b280: regenerate the pad or build with -DCTRPORT_HOTPIN=OFF")
ASSERT(__hotpin_32 == 0x16b758, "hotpin: CtrRenderer_endFrame.part.0 would start past 0x16b758: regenerate the pad or build with -DCTRPORT_HOTPIN=OFF")
ASSERT(__hotpin_33 == 0x17f32c, "hotpin: CtrPack_checkTile would start past 0x17f32c: regenerate the pad or build with -DCTRPORT_HOTPIN=OFF")
ASSERT(__hotpin_34 == 0x1876ac, "hotpin: CtrTextures_ensureTilesBut.part.0 would start past 0x1876ac: regenerate the pad or build with -DCTRPORT_HOTPIN=OFF")
ASSERT(__hotpin_35 == 0x189850, "hotpin: CtrTextures_ensureTilesBut would start past 0x189850: regenerate the pad or build with -DCTRPORT_HOTPIN=OFF")
ASSERT(__hotpin_36 == 0x18f808, "hotpin: __wrap___malloc_lock would start past 0x18f808: regenerate the pad or build with -DCTRPORT_HOTPIN=OFF")
ASSERT(__hotpin_37 == 0x18f844, "hotpin: __wrap___malloc_unlock would start past 0x18f844: regenerate the pad or build with -DCTRPORT_HOTPIN=OFF")
ASSERT(__hotpin_38 == 0x198e28, "hotpin: the engine block would start past 0x198e28: regenerate the pad or build with -DCTRPORT_HOTPIN=OFF")
ASSERT(__hotpin_39 == 0x306534, "hotpin: .fini would start past 0x306534: regenerate the pad or build with -DCTRPORT_HOTPIN=OFF")
ASSERT(__hotpin_40 == 0x306550, "hotpin: .fatalflush would start past 0x306550: regenerate the pad or build with -DCTRPORT_HOTPIN=OFF")
